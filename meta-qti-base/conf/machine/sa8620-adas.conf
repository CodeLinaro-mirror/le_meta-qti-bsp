## meta-qti-base/conf/machine/sa8620-adas.conf
```bitbake
#@TYPE: Machine
#@NAME: sa8620-adas
#@DESCRIPTION: Machine configuration for QTI sa8620-adas

BASEMACHINE = "sa8620-adas"
include conf/machine/include/sa7255.inc

DEFAULTTUNE = "aarch64"
include conf/machine/include/arm/arch-armv8a.inc

RECOVERY_IMAGE = "0"

EXTRA_IMAGEDEPENDS += "edk2"
CLANG_BIN="${SRC_DIR_ROOT}/prebuilts/clang/host/linux-x86/clang-r416183b/bin/"

PREFERRED_PROVIDER_virtual/kernel = "linux-qcom"
PREFERRED_PROVIDER_virtual/kernel-headers = "linux-qcom-headers"
PREFERRED_VERSION_linux-qcom = "6.6"
preferred-kernel = "PREFERRED_VERSION_linux-qcom"
kernel-version = "${PREFERRED_VERSION_linux-qcom}"

KERNEL_ARCH = "gen4auto"
KERNEL_IMAGE_HEADER_VERSION = "2"
KERNEL_BASE = "0x80000000"
KERNEL_TAGS_OFFSET = "0x1e00000"
KERNEL_CONFIG = "defconfig"

KERNEL_CMD_PARAMS = "rw rootwait console=ttyMSM0,115200,n8 no_console_suspend=1 androidboot.hardware=qcom androidboot.console=ttyMSM0 lpm_levels.sleep_disabled=1 msm_rtb.filter=0x237 earlycon=qcom_geni,0x99c000 qcom_geni_serial.con_enabled=1 fips=0 notests nokaslr ignore_loglevel firmware_class.path=/firmware/vm/boot systemd.gpt_auto=0 cgroup.memory=nokmem,nosocket rcupdate.rcu_expedited=1 rcu_nocbs=0-7 rcupdate.rcu_normal_after_boot=0 "
KERNEL_CMD_PARAMS:append = "${@bb.utils.contains('MACHINE_FEATURES', 'early-ramdisk-init', ' rdinit=/sbin/early-ramdisk-init early-ramdisk.mode=0 ', '', d)}"
KERNEL_CMD_PARAMS:remove = "${@bb.utils.contains_any('VARIANT', 'perf user', 'console=ttyMSM0,115200,n8', '', d)}"
KERNEL_CMD_PARAMS:remove = "${@bb.utils.contains_any('VARIANT', 'perf user', 'earlycon=qcom_geni,0x99c000 qcom_geni_serial.con_enabled=1', '', d)}"
KERNEL_CMD_PARAMS:remove = "${@bb.utils.contains('IMAGE_FEATURES', 'read-only-rootfs', 'rw', '', d)}"
KERNEL_CMD_PARAMS:append = "${@bb.utils.contains('IMAGE_FEATURES', 'read-only-rootfs', 'ro', '', d)}"

KERNEL_IMAGETYPE = "Image"

OOT_DTBS = "sa8620p-ride/sa8620p-ride.dtb"

MACHINE_FEATURES:remove = "\
    qti-vmm \
    early-ramdisk-init \
    qti-multimedia \
    qti-security \
    qti-audio-ar \
"
```

## meta-qti-base/conf/machine/sa8650-adas.conf
```bitbake
#@TYPE: Machine
#@NAME: sa8650-adas
#@DESCRIPTION: Machine configuration for QTI sa8650-adas

BASEMACHINE = "sa8650-adas"
include conf/machine/include/sa8775.inc

DEFAULTTUNE = "aarch64"
include conf/machine/include/arm/arch-armv8a.inc

RECOVERY_IMAGE = "0"

EXTRA_IMAGEDEPENDS += "edk2"
CLANG_BIN="${SRC_DIR_ROOT}/prebuilts/clang/host/linux-x86/clang-r416183b/bin/"

PREFERRED_PROVIDER_virtual/kernel = "linux-qcom"
PREFERRED_PROVIDER_virtual/kernel-headers = "linux-qcom-headers"
PREFERRED_VERSION_linux-qcom = "6.6"
preferred-kernel = "PREFERRED_VERSION_linux-qcom"
kernel-version = "${PREFERRED_VERSION_linux-qcom}"

KERNEL_ARCH = "gen4auto"
KERNEL_IMAGE_HEADER_VERSION = "2"
KERNEL_BASE = "0x80000000"
KERNEL_TAGS_OFFSET = "0x1e00000"
KERNEL_CONFIG = "defconfig"
KERNEL_MACHINE_DTB = "arch/arm64/boot/dts/qcom/sa8775p-ride.dtb"

KERNEL_CMD_PARAMS = "rw rootwait console=ttyMSM0,115200,n8 no_console_suspend=1 androidboot.hardware=qcom androidboot.console=ttyMSM0 lpm_levels.sleep_disabled=1 msm_rtb.filter=0x237 earlycon=qcom_geni,0xa8c000 fips=0 notests nokaslr ignore_loglevel firmware_class.path=/firmware/vm/boot systemd.gpt_auto=0 cgroup.memory=nokmem,nosocket systemd.unified_cgroup_hierarchy=1 qcom_scm.download_mode=1"
KERNEL_CMD_PARAMS:append = "${@bb.utils.contains('MACHINE_FEATURES', 'early-ramdisk-init', ' rdinit=/sbin/early-ramdisk-init early-ramdisk.mode=0 ', '', d)}"
KERNEL_CMD_PARAMS:remove = "${@bb.utils.contains_any('VARIANT', 'perf user', 'console=ttyMSM0,115200,n8', '', d)}"
KERNEL_CMD_PARAMS:remove = "${@bb.utils.contains_any('VARIANT', 'perf user', 'earlycon=qcom_geni,0xa8c000', '', d)}"
KERNEL_CMD_PARAMS:remove = "${@bb.utils.contains('IMAGE_FEATURES', 'read-only-rootfs', 'rw', '', d)}"

KERNEL_IMAGETYPE = "Image"

OOT_DTBS = "centos-stream-9/arch/arm64/boot/dts/qcom/sa8775p-ride-fw-managed.dtb.overlay"

MACHINE_FEATURES:remove = "\
    qti-multimedia \
    qti-display \
    qti-audio \
    qti-vmm \
    qti-camera \
    qti-safety \
    qti-vnw \
    early-ramdisk-init \
    qti-gunyah \
    qti-compute-platform \
"
```

## meta-qti-base/conf/machine/sa8775-flex.conf
```bitbake
#@TYPE: Machine
#@NAME: sa8775-flex
#@DESCRIPTION: Machine configuration for QTI sa8775-flex

BASEMACHINE = "sa8775-flex"
include conf/machine/include/sa8775.inc

DEFAULTTUNE = "aarch64"
include conf/machine/include/arm/arch-armv8a.inc

RECOVERY_IMAGE = "0"

EXTRA_IMAGEDEPENDS += "edk2"
CLANG_BIN="${SRC_DIR_ROOT}/prebuilts/clang/host/linux-x86/clang-r416183b/bin/"

PREFERRED_PROVIDER_virtual/kernel = "linux-qcom"
PREFERRED_PROVIDER_virtual/kernel-headers = "linux-qcom-headers"
PREFERRED_VERSION_linux-qcom = "6.6"
preferred-kernel = "PREFERRED_VERSION_linux-qcom"
kernel-version = "${PREFERRED_VERSION_linux-qcom}"

KERNEL_IMAGE_HEADER_VERSION = "2"
KERNEL_BASE = "0x80000000"
KERNEL_TAGS_OFFSET = "0x1e00000"
KERNEL_CONFIG = "defconfig"
KERNEL_BASE_DTB = "arch/arm64/boot/dts/qcom/sa8255p-ride.dtb"

KERNEL_CMD_PARAMS = "rw rootwait console=ttyMSM0,115200,n8 no_console_suspend=1 androidboot.hardware=qcom androidboot.console=ttyMSM0 lpm_levels.sleep_disabled=1 msm_rtb.filter=0x237 earlycon=qcom_geni,0xa8c000 fips=0 notests nokaslr firmware_class.path=/firmware/vm/boot systemd.gpt_auto=0 cgroup.memory=nokmem,nosocket systemd.unified_cgroup_hierarchy=1 qcom_scm.download_mode=1"
KERNEL_CMD_PARAMS:append = "${@bb.utils.contains('MACHINE_FEATURES', 'early-ramdisk-init', ' rdinit=/sbin/early-ramdisk-init early-ramdisk.mode=0 ', '', d)}"
KERNEL_CMD_PARAMS:remove = "${@bb.utils.contains_any('VARIANT', 'perf user', 'console=ttyMSM0,115200,n8', '', d)}"
KERNEL_CMD_PARAMS:remove = "${@bb.utils.contains_any('VARIANT', 'perf user', 'earlycon=qcom_geni,0xa8c000', '', d)}"
KERNEL_CMD_PARAMS:remove = "${@bb.utils.contains('IMAGE_FEATURES', 'read-only-rootfs', 'rw', '', d)}"

KERNEL_IMAGETYPE = "Image"

OOT_DTBS = "out/sa8255p-ride-overlay.dtb"

MACHINE_FEATURES:remove = "\
    qti-multimedia \
    qti-audio \
    qti-vmm \
    qti-camera \
    qti-safety \
    qti-vnw \
    early-ramdisk-init \
    qti-compute-platform \
"
```

## meta-qti-base/conf/machine/sa8775.conf
```bitbake
#@TYPE: Machine
#@NAME: sa8775
#@DESCRIPTION: Machine configuration for QTI sa8775

BASEMACHINE = "sa8775"
include conf/machine/include/sa8775.inc

DEFAULTTUNE = "aarch64"
include conf/machine/include/arm/arch-armv8a.inc

RECOVERY_IMAGE = "0"

EXTRA_IMAGEDEPENDS += "edk2"
CLANG_BIN="${SRC_DIR_ROOT}/prebuilts/clang/host/linux-x86/clang-r416183b/bin/"

PREFERRED_PROVIDER_virtual/kernel = "linux-ark"
PREFERRED_PROVIDER_virtual/kernel-headers = "linux-ark-headers"
PREFERRED_VERSION_linux-ark = "5.14"
preferred-kernel = "${@oe.utils.ifelse(d.getVar('PREFERRED_PROVIDER_virtual/kernel') == 'linux-ark', 'PREFERRED_VERSION_linux-ark', 'PREFERRED_VERSION_linux-msm')}"
kernel-version = "${@oe.utils.ifelse(d.getVar('PREFERRED_PROVIDER_virtual/kernel') == 'linux-ark', '5.14', '5.4')}"

KERNEL_IMAGE_HEADER_VERSION = "2"
KERNEL_BASE = "0x80000000"
KERNEL_TAGS_OFFSET = "0x1e00000"
KERNEL_CONFIG = "defconfig"
RH_KERNEL_NAME = "rh-kernel-5.14"
KERNEL_BASE_DTB = "arch/arm64/boot/dts/qcom/sa8775p-ride-fw-managed.dtb"
EARLY_RAMDISK_MODE = "${@bb.utils.contains_any('VARIANT', 'perf user', '1', '0', d)}"

KERNEL_CMD_PARAMS = "rw rootwait console=ttyMSM0,115200,n8 no_console_suspend=1 androidboot.hardware=qcom androidboot.console=ttyMSM0 lpm_levels.sleep_disabled=1 msm_rtb.filter=0x237 earlycon=qcom_geni,0xa8c000 fips=0 notests nokaslr ignore_loglevel firmware_class.path=/firmware/vm/boot systemd.gpt_auto=0 cgroup.memory=nokmem,nosocket systemd.unified_cgroup_hierarchy=1 "
KERNEL_CMD_PARAMS:append = "${@bb.utils.contains('MACHINE_FEATURES', 'early-ramdisk-init', ' rdinit=/sbin/early-ramdisk-init early-ramdisk.mode=${EARLY_RAMDISK_MODE} ', '', d)}"
KERNEL_CMD_PARAMS:remove = "${@bb.utils.contains_any('VARIANT', 'perf user', 'console=ttyMSM0,115200,n8', '', d)}"
KERNEL_CMD_PARAMS:remove = "${@bb.utils.contains_any('VARIANT', 'perf user', 'earlycon=qcom_geni,0xa8c000', '', d)}"
KERNEL_CMD_PARAMS:remove = "${@bb.utils.contains('IMAGE_FEATURES', 'read-only-rootfs', 'rw', '', d)}"

KERNEL_IMAGETYPE = "Image.gz"

OOT_DTBS = "out/sa8775p-ride-fw-managed-overlay.dtb \
            sa8775p-ride-mx/sa8775p-ride-mx.dtb"

EARLY_RAMDISK_KERNEL_MODULES = "\
    kernel-module-pinctrl-msm-${KERNEL_VERSION} \
    kernel-module-qcom-geni-se-${KERNEL_VERSION} \
    kernel-module-qcom-geni-serial-${KERNEL_VERSION} \
    kernel-module-qcom-ipcc-${KERNEL_VERSION} \
    kernel-module-phy-qcom-qmp-ufs-${KERNEL_VERSION} \
    kernel-module-ufs-qcom-${KERNEL_VERSION} \
    kernel-module-governor-simpleondemand-${KERNEL_VERSION} \
    kernel-module-ufshcd-core-${KERNEL_VERSION} \
    kernel-module-ufshcd-pltfrm-${KERNEL_VERSION} \
    kernel-module-pinctrl-sa8775p-${KERNEL_VERSION} \
    kernel-module-aquantia-${KERNEL_VERSION}  \
    kernel-module-marvell-${KERNEL_VERSION} \
    kernel-module-virtio-mmio-${KERNEL_VERSION} \
    kernel-module-ipv6-${KERNEL_VERSION} \
"

EXTERNAL_BOOTUP_KERNEL_MODULES = " \
    kernel-module-phy-qcom-qmp-usb-${KERNEL_VERSION} \
    kernel-module-dwc3-qcom-${KERNEL_VERSION} \
    kernel-module-dwc3-${KERNEL_VERSION} \
    kernel-module-usb-storage-${KERNEL_VERSION} \
    kernel-module-uas-${KERNEL_VERSION} \
    kernel-module-phy-qcom-snps-femto-v2-${KERNEL_VERSION} \
"

EARLY_RAMDISK_KERNEL_MODULES:append = " \
    ${@bb.utils.contains('DISTRO_FEATURES', 'qti-external-boot', '${EXTERNAL_BOOTUP_KERNEL_MODULES}', '', d)} \
"

ROOT_HOME = "/root"

MACHINE_FEATURES:append = " qti-rideware"
```

## meta-qti-distro/conf/distro/auto-gvm-dpk.conf
```bitbake
require ${QTI_METAPATH_DISTRO}/conf/distro/auto-gvm.conf

DISTRO_NAME = "auto gvm dpk"

PRODUCT ?= "${MACHINE}-dpk"

DISTRO_FEATURES:remove = "qti-gstdeinterlace qti-gstqvrate qti-gstqvais"

DISTRO_FEATURES:append = " qti-vndbinder"
```

## meta-qti-distro/conf/distro/auto-gvm-headless.conf
```bitbake
require conf/distro/include/auto-common.inc

DISTRO_NAME = "auto gvm headless"

PRODUCT = "${MACHINE}-headless"
PRODUCT:quin-gvm-gen4-5 = "gvm-gen4-5-hl"

DEPLOY_NAME_BASE:quin-gvm-gen4-5 = "${PRODUCT}"

BBMASK:quin-tgvm-gen4 += "meta-qti-bsp/meta-qti-distro/recipes-core/images/machine-image-initramfs.bb"

DISTRO_FEATURES:append = " qti-hypervisor"
DISTRO_FEATURES:remove = " wifi"
DISTRO_FEATURES:append:quin-tgvm-gen4 = " selinux"
DISTRO_FEATURES_NATIVE:append:quin-tgvm-gen4 = " selinux"

DISTRO_FEATURES:append = " \
    qti-core \
    qti-data \
    qti-extra \
    qti-graphics \
    qti-ml \
    qti-security \
    qti-avb \
    qti-fde \
"

# Preferred refpolicy
PREFERRED_PROVIDER_virtual/refpolicy = "refpolicy-targeted"
DEFAULT_ENFORCING = "enforcing"

DISTRO_FEATURES:remove:quin-gvm-gen4-5 = " \
    qti-extra \
    qti-graphics \
    qti-ml \
    qti-bluetooth \
    qti-fde \
"
```

## meta-qti-distro/conf/distro/auto-gvm-qcvirtio.conf
```bitbake
require ${QTI_METAPATH_DISTRO}/conf/distro/auto-gvm.conf

DISTRO_NAME = "auto-gvm-qcvirtio"

DISTRO_FEATURES += "qcvirtio-gvm"
DISTRO_FEATURES:remove = "qti-avb"
```

## meta-qti-distro/conf/distro/auto-gvm-virtio.conf
```bitbake
require conf/distro/include/auto-common.inc

DISTRO_NAME = "Auto Gvm VirtIO"

PRODUCT = "${MACHINE}"

DISTRO_FEATURES:append = " \
    qti-adsp \
    qti-cdsp \
    qti-cdsp1 \
    qti-core \
    qti-data \
    qti-extra \
    qti-tools \
    qti-security \
    qti-avb \
    qti-virtio \
    ab-boot-support \
"
BBMASK += "meta-qti-bsp/meta-qti-distro/recipes-core/images/machine-image-initramfs.bb"
BBMASK += "meta-qti-bsp-prop/meta-qti-headless-prop/recipes-security/mink/mink.bb"
BBMASK += "meta-qti-bsp/meta-qti-headless/recipes-kernel/linux-msm/linux-msm_6.1.bb"
BBMASK += "meta-qti-bsp/meta-qti-headless/recipes-kernel/toolchain/kernel-toolchain-native_5.15.bb"
BBMASK += "meta-qti-bsp-prop/meta-qti-headless-prop/recipes-kernel/kernel-devicetree/kernel-devicetree.bb"

# Switch package format to rpm for GVM
PACKAGE_CLASSES = "package_rpm"
```

## meta-qti-distro/conf/distro/auto-gvm.conf
```bitbake
require conf/distro/include/auto-common.inc

DISTRO_NAME = "auto gvm"

DISTRO_FEATURES:append = " \
    qti-adsp \
    qti-audio \
    qti-audio-ar \
    qti-camera \
    qti-cdsp \
    qti-cdsp1 \
    qti-core \
    qti-data \
    qti-display \
    qti-extra \
    qti-graphics \
    qti-ml \
    qti-multimedia \
    qti-security \
    qti-vnw \
    qti-tools \
    qti-avb \
    qti-fde \
    qti-fastcv \
    ab-boot-support \
"

DISTRO_FEATURES:remove:quin-gvm-gen4-2 = "\
    qti-audio \
    qti-ml \
"

DISTRO_FEATURES:remove:qtiquingvm8295 = "\
    qti-audio-ar \
    qti-ml \
"

DISTRO_FEATURES:remove:quin-gvm-lemans = "\
    qti-audio \
    qti-ml \
"
DISTRO_FEATURES:remove:gh-gvm-lemans = "\
    qti-audio \
    qti-audio-ar \
    qti-ml \
    qti-multimedia \
    qti-display \
    qti-camera \
"

DISTRO_FEATURES:remove:quin-gvm-monaco = "\
    qti-audio \
    qti-ml \
"

DISTRO_FEATURES:remove:quin-gvm-gen4-2 = "wifi"
DISTRO_FEATURES:remove:quin-gvm-lemans = "wifi"
DISTRO_FEATURES:remove:gh-gvm-lemans = "wifi"
DISTRO_FEATURES:remove:qtiquingvm8295 = "wifi"
DISTRO_FEATURES:remove:quin-gvm-gen4 = "wifi"
DISTRO_FEATURES:remove:quin-gvm-monaco = "wifi"

# Switch package format to rpm for GVM
PACKAGE_CLASSES = "package_rpm"
```

## meta-qti-distro/conf/distro/auto-qcvirtio.conf
```bitbake
require conf/distro/auto.conf

DISTRO_NAME = "auto-qcvirtio"

DISTRO_FEATURES += "qcvirtio opengl"

# Don't use QTI's gstreamer
BBMASK .= "|meta-qti-bsp/meta-qti-base/recipes-multimedia/gstreamer"
```

## meta-qti-distro/conf/distro/auto-sa8775.conf
```bitbake
require conf/distro/include/auto-common.inc
DISTRO_NAME = "auto sa8775"

DISTRO_FEATURES:append = " \
    qti-core \
    qti-security \
    qti-tools \
    qti-usermode-camera \
"
```

## meta-qti-distro/conf/distro/auto-trout.conf
```bitbake
require conf/distro/auto.conf

DISTRO_NAME = "auto-trout"

DISTRO_FEATURES += "qcvirtio opengl"

# Don't use QTI's gstreamer
BBMASK .= "|meta-qti-bsp/meta-qti-base/recipes-multimedia/gstreamer"
```

## meta-qti-distro/conf/distro/auto.conf
```bitbake
require conf/distro/include/auto-common.inc

DISTRO_NAME = "auto"

DISTRO_FEATURES:append:sa81x5 = "${@bb.utils.contains_any('VARIANT', 'perf user', ' early_init', '', d)}"

DISTRO_FEATURES:append = " \
    qti-adsp \
    qti-audio \
    qti-bluetooth \
    qti-fastcv \
    qti-audio-ar \
    qti-camera \
    qti-cdsp \
    qti-core \
    qti-data \
    qti-display \
    qti-extra \
    qti-graphics \
    qti-ml \
    qti-multimedia \
    qti-security \
    qti-tools \
    qti-vnw \
    qti-location \
    qti-avb \
    ab-boot-support \
"

DISTRO_FEATURES:remove = "\
    qti-location \
    early-eth \
    ipa3 \
"

DISTRO_FEATURES:remove:monaco = "\
    qti-ml \
    qti-multimedia \
    qti-security \
    qti-audio \
    qti-bluetooth \
    qti-fastcv \
    qti-audio-ar \
    qti-camera \
    qti-display \
    qti-graphics \
    qti-vnw \
    qti-extra \
    qti-avb \
    qti-lxc \
"

# Disable qti-avb on minimal as the feature not need
DISTRO_FEATURES:remove:pn-core-image-minimal = "qti-avb"
DISTRO_FEATURES:remove:sa8775 = "qti-avb"

# Enable usermode drivers
DISTRO_FEATURES:append:sa8775 = "\
    qti-usermode-display \
"
```
