## meta-qti-distro/conf/distro/include/auto-common.inc
```bitbake
BASEDISTRO ?= "msm"
require conf/distro/include/msm.inc

require conf/distro/include/security_flags.inc

require conf/distro/include/distro_features.inc

DISTRO_NAME = "automotive"
DISTROOVERRIDES =. "automotive:"
# Support SDP
ID_LIKE = "automotive"

PRODUCT ?= "${MACHINE}" 
DEPLOY_NAME_BASE = "${PRODUCT}-automotive"
IMAGE_NAME = "${IMAGE_BASENAME}-${PRODUCT}${IMAGE_VERSION_SUFFIX}"
IMAGE_LINK_NAME = "${IMAGE_BASENAME}-${PRODUCT}"

PERSIST_IMAGE_ROOTFS_SIZE ?= "128M"

VIRTUAL-RUNTIME_dev_manager = "udev"
VIRTUAL-RUNTIME_init_manager = "systemd"

INCOMPATIBLE_LICENSE = "${@bb.utils.contains('LAYERSERIES_COMPAT_yocto', 'dunfell', 'GPL-3.0 LGPL-3.0 AGPL-3.0', 'GPL-3.0-only LGPL-3.0-only AGPL-3.0-only', d)}"

IMAGE_FEATURES:append = " read-only-rootfs"

LICENSE_FLAGS_ACCEPTED += "commercial_gstreamer1.0-libav commercial_gstreamer1.0-omx"
LICENSE_FLAGS_ACCEPTED += "commercial_gstreamer1.0-plugins-ugly commercial_opencore-amr"
LICENSE_FLAGS_ACCEPTED += "commercial_ffmpeg"

include ${DISTRO_INC_FILES}

# Sizes for EXT4 (in bytes)
SYSTEM_SIZE_EXT4 ?= "100000000"
SYSTEMRW_SIZE_EXT4 ?= "8388608"
USERDATA_SIZE_EXT4 ?= "2000000000"
CACHE_SIZE_EXT4 ?= "80000000"
PERSIST_IMAGE_ROOTFS_SIZE ?= "128M"

BB_DANGLINGAPPENDS_WARNONLY = "yes"
```

## meta-qti-distro/conf/distro/include/distro_features.inc
```bitbake
# Support systemd-user-session
DISTRO_FEATURES:append = " pam"
#SA8797 RUMI bringup remove pam.
DISTRO_FEATURES:remove:sa8797 = "pam"

# Video
DISTRO_FEATURES:append:sa6155 = " qti-carcamsrc qti-omx"
DISTRO_FEATURES:append:sa81x5-rt = " qti-carcamsrc qti-omx"
DISTRO_FEATURES:append:sa81x5 = " qti-carcamsrc qti-fastcv qti-omx"
DISTRO_FEATURES:append:sa8295 = " qti-codec2"
DISTRO_FEATURES:append:qtiquingvm = " qti-omx qti-gstqeavb"
DISTRO_FEATURES:append:qtiquingvm8295 = " qti-codec2 qti-gstdeinterlace qti-gstqeavb qti-gstqvrate qti-gstqvais"
DISTRO_FEATURES:append:quin-gvm-gen4 = " qti-codec2 qti-gstqeavb qti-gstdeinterlace"
DISTRO_FEATURES:append:quin-gvm-gen4-2 = " qti-codec2 qti-gstdeinterlace qti-gstqeavb qti-gstqvrate qti-gstqvais"
DISTRO_FEATURES:append:quin-gvm-lemans = " qti-codec2 qti-gstdeinterlace qti-gstqeavb qti-gstqvrate qti-gstqvais qti-gstqcarcamsrc"
DISTRO_FEATURES:append:quin-gvm-monaco = " qti-codec2 qti-gstdeinterlace qti-gstqeavb"

# Camera
DISTRO_FEATURES:append:quin-gvm-lemans = " qti-qcx"
DISTRO_FEATURES:append:quin-gvm-monaco = " qti-qcx"

# Display
DISTRO_FEATURES:append = " wayland"


# Use synergy, disable bluez
DISTRO_FEATURES_BACKFILL_CONSIDERED += "bluez5 bluetooth"

#Enable persist-image
DISTRO_FEATURES:append = " persist-image "

DISTRO_FEATURES:append = " qti-early-eth"
#DISTRO_FEATURES:append = " early_init"
#DISTRO_FEATURES:append = " early_userspace"


DISTRO_FEATURES:append = " hibernation"

# Use systemd init manager.
DISTRO_FEATURES:append = " systemd ${@bb.utils.contains('LAYERSERIES_CORENAMES', 'scarthgap', 'usrmerge', '', d)}"
DISTRO_FEATURES_BACKFILL_CONSIDERED += "sysvinit"

DISTRO_FEATURES:append = " vulkan"

# WLAN
DISTRO_FEATURES:append = " qti-wlan wifi"
DISTRO_FEATURES:remove:sa8797 = "wifi"

# BT
DISTRO_FEATURES:append:qtiquingvm8295 = " qti-bluetooth"
DISTRO_FEATURES:append:quin-gvm-gen4 = " qti-bluetooth"
DISTRO_FEATURES:append:quin-gvm-gen4-2 = " qti-bluetooth"
DISTRO_FEATURES:append:quin-gvm-lemans = " qti-bluetooth"
DISTRO_FEATURES:append:quin-gvm-monaco = " qti-bluetooth"

# SELinux
DISTRO_FEATURES:append:sa8775 = " selinux"
DISTRO_FEATURES:append:sa7255 = " selinux"
DISTRO_FEATURES:append:quin-gvm-lemans = " selinux"
DISTRO_FEATURES_NATIVE:append:sa8775 = " selinux"
DISTRO_FEATURES_NATIVE:append:sa7255 = " selinux"
DISTRO_FEATURES_NATIVE:append:quin-gvm-lemans = " selinux"

# Preferred refpolicy
PREFERRED_PROVIDER_virtual/refpolicy:sa8775 = "selinux-policy"
PREFERRED_PROVIDER_virtual/refpolicy:sa7255 = "selinux-policy"
PREFERRED_PROVIDER_virtual/refpolicy:quin-gvm-lemans = "selinux-policy"
DEFAULT_ENFORCING:sa8775 = "enforcing"
DEFAULT_ENFORCING:sa7255 = "enforcing"
DEFAULT_ENFORCING:quin-gvm-lemans = "enforcing"
PREFERRED_VERSION_selinux-policy:sa8775 = "1.0"
PREFERRED_VERSION_selinux-policy:sa7255 = "1.0"
PREFERRED_VERSION_selinux-policy:quin-gvm-lemans = "2.0"
```

## meta-qti-distro/conf/distro/include/non-gplv3-license.inc
```bitbake
# Eliminate gpl3 gdbm dependency
PACKAGECONFIG:remove:pn-perl = "gdbm"
PACKAGECONFIG:remove:pn-python3 = "gdbm"

# Eliminate gpl3 kbd-keymaps-pine dependency
RRECOMMENDS:${PN}-keymaps:remove:pn-kbd = "${PN}-keymaps-pine"

EXTRA_IMAGE_FEATURES:remove:pn-machine-image = "package-management"
```
