## meta-qti-base/conf/machine/include/gvm-bbmask.inc
```bitbake
# BBMASK drops some recipe that checksum file not found in this target
BBMASK:quin-gvm-gen4 += "meta-qti-bsp/meta-qti-extra/recipes-location/"
BBMASK:quin-gvm-gen4 += "meta-qti-bsp/meta-qti-base/recipes-audio/audiolite-dlkm/audiolite-devicetree_git.bb"
BBMASK:quin-gvm-gen4 += "meta-qti-bsp/meta-qti-base/recipes-audio/audiolite-dlkm/audiolite-dlkm_git.bb"
BBMASK:quin-gvm-gen4 += "meta-qti-bsp/meta-qti-base/recipes-camera/cameradlkm/cameradlkm_0.2.bb"
BBMASK:quin-gvm-gen4 += "meta-qti-bsp/meta-qti-base/recipes-core/bootkpi-logging/bootkpi-logging.bb"
BBMASK:quin-gvm-gen4 += "meta-qti-bsp/meta-qti-base/recipes-core/reboot-daemon/reboot-daemon_2.0.bb"
BBMASK:quin-gvm-gen4 += "meta-qti-bsp/meta-qti-base/recipes-data/aurix-can/aurix-can_git.bb"
BBMASK:quin-gvm-gen4 += "meta-qti-bsp/meta-qti-base/recipes-data/dataeth-dlkm/dataeth-dlkm_git.bb"
BBMASK:quin-gvm-gen4 += "meta-qti-bsp/meta-qti-base/recipes-data/emac-dwc-eqos/emac-dwc-eqos_git.bb"
BBMASK:quin-gvm-gen4 += "meta-qti-bsp/meta-qti-base/recipes-graphics/wayland/weston_10.0.%.bbappend"
BBMASK:quin-gvm-gen4 += "meta-qti-bsp/meta-qti-base/recipes-kernel/edk2/edk2_git.bb"
BBMASK:quin-gvm-gen4 += "meta-qti-bsp/meta-qti-base/recipes-kernel/oot-dtbo/oot-dtbo.bb"
BBMASK:quin-gvm-gen4 += "meta-qti-bsp/meta-qti-base/recipes-kernel/linux-msm/linux-msm-headers_6.12.bb"
BBMASK:quin-gvm-gen4 += "meta-qti-bsp/meta-qti-base/recipes-kiumd/dspfirmware-mount/dspfirmware-mount_git.bb"
BBMASK:quin-gvm-gen4 += "meta-qti-bsp/meta-qti-base/recipes-kiumd/gvm-net-config/gvm-net-config_git.bb"
BBMASK:quin-gvm-gen4 += "meta-qti-bsp/meta-qti-base/recipes-kiumd/kiumd-headers/kiumd-headers_git.bb"
BBMASK:quin-gvm-gen4 += "meta-qti-bsp/meta-qti-base/recipes-kiumd/safelinux-cfg-modules/safelinux-cfg-modules_git.bb"
BBMASK:quin-gvm-gen4 += "meta-qti-bsp/meta-qti-base/recipes-multimedia/ffmpeg/ffmpeg_5.0.%.bbappend"
BBMASK:quin-gvm-gen4 += "meta-qti-bsp/meta-qti-base/recipes-multimedia/media/media_0.1.bb"
BBMASK:quin-gvm-gen4 += "meta-qti-bsp/meta-qti-base/recipes-multimedia/virtio-video/virtio-video-header_git.bb"
BBMASK:quin-gvm-gen4 += "meta-qti-bsp/meta-qti-base/recipes-safelinux-dbg-modules/safelinux-dbg-modules/safelinux-dbg-modules_git.bb"
BBMASK:quin-gvm-gen4 += "meta-qti-bsp/meta-qti-base/recipes-security/security-modules/safelinux-sec-modules_git.bb"
BBMASK:quin-gvm-gen4 += "meta-qti-bsp/meta-qti-base/recipes-virt/gunyah-drivers/gunyah-drivers_git.bb"
BBMASK:quin-gvm-gen4 += "meta-qti-bsp/meta-qti-base/recipes-virt/hyp-udmabuf/hyp-udmabuf_git.bb"
BBMASK:quin-gvm-gen4 += "meta-qti-bsp/meta-qti-base/recipes-virt/msmhab/msmhab_git.bb"
BBMASK:quin-gvm-gen4 += "meta-qti-bsp/meta-qti-base/recipes-virt/qcrosvm/qcrosvm_git.bb"
BBMASK:quin-gvm-gen4 += "meta-qti-bsp/meta-qti-base/recipes-virt/safelinux-system-cfg/safelinux-system-cfg_git.bb"
BBMASK:quin-gvm-gen4 += "meta-qti-bsp/meta-qti-base/recipes-virt/vhost-device/vhost-device-i2c_0.1.0.bb"
BBMASK:quin-gvm-gen4 += "meta-qti-bsp/meta-qti-base/recipes-virt/vhost-user-lib/vhost-user-lib_git.bb"
BBMASK:quin-gvm-gen4 += "meta-qti-bsp/meta-qti-base/recipes-virt/vhost-user-q/vhost-user-q_git.bb"
BBMASK:quin-gvm-gen4 += "meta-qti-bsp/meta-qti-base/recipes-virt/vhost-user-scmi/vhost-user-scmi_git.bb"
BBMASK:quin-gvm-gen4 += "meta-qti-bsp/meta-qti-extra/recipes-devtools/gtest/googletest_git.bbappend"
BBMASK:quin-gvm-gen4 += "meta-qti-bsp/meta-qti-extra/recipes-security/refpolicy/refpolicy-mcs_%.bbappend"
BBMASK:quin-gvm-gen4 += "meta-qti-bsp/meta-qti-extra/recipes-security/selinux/libsemanage_%.bbappend"
BBMASK:quin-gvm-gen4 += "meta-qti-bsp/meta-qti-extra/recipes-security/selinux-policy/selinux-policy.bb"
BBMASK:quin-gvm-gen4 += "meta-qti-bsp/meta-qti-extra/recipes-test/khab-test/khab-unit-test.bb"
BBMASK:quin-gvm-gen4 += "meta-qti-bsp/meta-qti-extra/recipes-test/virt-clk-ut/virt-clk-ut.bb"
BBMASK:quin-gvm-gen4 += "meta-qti-bsp/meta-qti-extra/recipes-test/virt-fastrpc-ut/virt-fastrpc-ut_git.bb"
BBMASK:quin-gvm-gen4 += "meta-qti-bsp/meta-qti-extra/recipes-test/virtio-i2c-test/virtio-i2c-test.bb"
BBMASK:quin-gvm-gen4 += "meta-qti-bsp/meta-qti-extra/recipes-test/virt-reg-ut/virt-reg-ut.bb"
BBMASK:quin-gvm-gen4 += "meta-qti-bsp/meta-qti-extra/recipes-test/virt-spmi-ut/virt-spmi-ut.bb"

# BBMASK drops some recipe that checksum file not found in quin-gvm-lemans target
BBMASK:quin-gvm-lemans += "meta-qti-bsp/meta-qti-base/recipes-audio/audiolite-dlkm/audiolite-devicetree_git.bb"
BBMASK:quin-gvm-lemans += "meta-qti-bsp/meta-qti-base/recipes-audio/audiolite-dlkm/audiolite-dlkm_git.bb"
BBMASK:quin-gvm-lemans += "meta-qti-bsp/meta-qti-base/recipes-camera/cameradlkm/cameradlkm_0.1.bb"
BBMASK:quin-gvm-lemans += "meta-qti-bsp/meta-qti-base/recipes-camera/cameradlkm/cameradlkm_0.2.bb"
BBMASK:quin-gvm-lemans += "meta-qti-bsp/meta-qti-base/recipes-core/bootkpi-logging/bootkpi-logging.bb"
BBMASK:quin-gvm-lemans += "meta-qti-bsp/meta-qti-base/recipes-core/reboot-daemon/reboot-daemon_2.0.bb"
BBMASK:quin-gvm-lemans += "meta-qti-bsp/meta-qti-base/recipes-data/aurix-can/aurix-can_git.bb"
BBMASK:quin-gvm-lemans += "meta-qti-bsp/meta-qti-base/recipes-data/avb-utils/avb-utils_1.0.bb"
BBMASK:quin-gvm-lemans += "meta-qti-bsp/meta-qti-base/recipes-data/dataeth-dlkm/dataeth-dlkm_git.bb"
BBMASK:quin-gvm-lemans += "meta-qti-bsp/meta-qti-base/recipes-data/eavb/eavb-fe-virtio_git.bb"
BBMASK:quin-gvm-lemans += "meta-qti-bsp/meta-qti-base/recipes-data/emac-dwc-eqos/emac-dwc-eqos_git.bb"
BBMASK:quin-gvm-lemans += "meta-qti-bsp/meta-qti-base/recipes-kernel/edk2/edk2_git.bb"
BBMASK:quin-gvm-lemans += "meta-qti-bsp/meta-qti-base/recipes-kernel/linux-msm/linux-msm_5.15.bb"
BBMASK:quin-gvm-lemans += "meta-qti-bsp/meta-qti-base/recipes-kernel/oot-dtbo/oot-dtbo.bb"
BBMASK:quin-gvm-lemans += "meta-qti-bsp/meta-qti-base/recipes-kiumd/dspfirmware-mount/dspfirmware-mount_git.bb"
BBMASK:quin-gvm-lemans += "meta-qti-bsp/meta-qti-base/recipes-kiumd/gvm-net-config/gvm-net-config_git.bb"
BBMASK:quin-gvm-lemans += "meta-qti-bsp/meta-qti-base/recipes-kiumd/kiumd-headers/kiumd-headers_git.bb"
BBMASK:quin-gvm-lemans += "meta-qti-bsp/meta-qti-base/recipes-kiumd/safelinux-cfg-modules/safelinux-cfg-modules_git.bb"
BBMASK:quin-gvm-lemans += "meta-qti-bsp/meta-qti-base/recipes-multimedia/media/media_0.1.bb"
BBMASK:quin-gvm-lemans += "meta-qti-bsp/meta-qti-base/recipes-safelinux-dbg-modules/safelinux-dbg-modules/safelinux-dbg-modules_git.bb"
BBMASK:quin-gvm-lemans += "meta-qti-bsp/meta-qti-base/recipes-security/security-modules/safelinux-sec-modules_git.bb"
BBMASK:quin-gvm-lemans += "meta-qti-bsp/meta-qti-base/recipes-virt/gunyah-drivers/gunyah-drivers_git.bb"
BBMASK:quin-gvm-lemans += "meta-qti-bsp/meta-qti-base/recipes-virt/hyp-udmabuf/hyp-udmabuf_git.bb"
BBMASK:quin-gvm-lemans += "meta-qti-bsp/meta-qti-base/recipes-virt/msmhab/msmhab_git.bb"
BBMASK:quin-gvm-lemans += "meta-qti-bsp/meta-qti-base/recipes-virt/qcrosvm/qcrosvm_git.bb"
BBMASK:quin-gvm-lemans += "meta-qti-bsp/meta-qti-base/recipes-virt/safelinux-system-cfg/safelinux-system-cfg_git.bb"
BBMASK:quin-gvm-lemans += "meta-qti-bsp/meta-qti-base/recipes-virt/vhost-device/vhost-device-i2c_0.1.0.bb"
BBMASK:quin-gvm-lemans += "meta-qti-bsp/meta-qti-base/recipes-virt/vhost-user-lib/vhost-user-lib_git.bb"
BBMASK:quin-gvm-lemans += "meta-qti-bsp/meta-qti-base/recipes-virt/vhost-user-q/vhost-user-q_git.bb"
BBMASK:quin-gvm-lemans += "meta-qti-bsp/meta-qti-base/recipes-virt/vhost-user-scmi/vhost-user-scmi_git.bb"
BBMASK:quin-gvm-lemans += "meta-qti-bsp/meta-qti-extra/recipes-containers/softwarecontainer/softwarecontainer_git.bb"
BBMASK:quin-gvm-lemans += "meta-qti-bsp/meta-qti-extra/recipes-location/location/gps-utils_git.bb"
BBMASK:quin-gvm-lemans += "meta-qti-bsp/meta-qti-extra/recipes-location/location/loc-api-v02_git.bb"
BBMASK:quin-gvm-lemans += "meta-qti-bsp/meta-qti-extra/recipes-location/location/location-api_git.bb"
BBMASK:quin-gvm-lemans += "meta-qti-bsp/meta-qti-extra/recipes-location/location/location-api-iface_git.bb"
BBMASK:quin-gvm-lemans += "meta-qti-bsp/meta-qti-extra/recipes-location/location/location-api-msg-proto_git.bb"
BBMASK:quin-gvm-lemans += "meta-qti-bsp/meta-qti-extra/recipes-location/location/location-client-api_git.bb"
BBMASK:quin-gvm-lemans += "meta-qti-bsp/meta-qti-extra/recipes-location/location/location-client-api-hdr_git.bb"
BBMASK:quin-gvm-lemans += "meta-qti-bsp/meta-qti-extra/recipes-location/location/location-client-api-testapp_git.bb"
BBMASK:quin-gvm-lemans += "meta-qti-bsp/meta-qti-extra/recipes-location/location/location-hal-daemon_git.bb"
BBMASK:quin-gvm-lemans += "meta-qti-bsp/meta-qti-extra/recipes-location/location/location-integration-api_git.bb"
BBMASK:quin-gvm-lemans += "meta-qti-bsp/meta-qti-extra/recipes-location/location/loc-core_git.bb"
BBMASK:quin-gvm-lemans += "meta-qti-bsp/meta-qti-extra/recipes-location/location/loc-hal_git.bb"
BBMASK:quin-gvm-lemans += "meta-qti-bsp/meta-qti-extra/recipes-location/location/loc-pla-hdr_git.bb"
BBMASK:quin-gvm-lemans += "meta-qti-bsp/meta-qti-extra/recipes-location/location/loc-sll-if_git.bb"
BBMASK:quin-gvm-lemans += "meta-qti-bsp/meta-qti-extra/recipes-location/location/ntrip-client-integration-api-hdr_git.bb"
BBMASK:quin-gvm-lemans += "meta-qti-bsp/meta-qti-extra/recipes-location/location/synergy-loc-api_git.bb"
BBMASK:quin-gvm-lemans += "meta-qti-bsp/meta-qti-extra/recipes-security/selinux-policy/selinux-policy.bb"
BBMASK:quin-gvm-lemans += "meta-qti-bsp/meta-qti-extra/recipes-test/khab-test/khab-unit-test.bb"
BBMASK:quin-gvm-lemans += "meta-qti-bsp/meta-qti-extra/recipes-test/virt-clk-ut/virt-clk-ut.bb"
BBMASK:quin-gvm-lemans += "meta-qti-bsp/meta-qti-extra/recipes-test/virt-fastrpc-ut/virt-fastrpc-ut_git.bb"
BBMASK:quin-gvm-lemans += "meta-qti-bsp/meta-qti-extra/recipes-test/virtio-i2c-test/virtio-i2c-test.bb"
BBMASK:quin-gvm-lemans += "meta-qti-bsp/meta-qti-extra/recipes-test/virt-reg-ut/virt-reg-ut.bb"
BBMASK:quin-gvm-lemans += "meta-qti-bsp/meta-qti-extra/recipes-test/virt-spmi-ut/virt-spmi-ut.bb"
BBMASK:quin-gvm-lemans += "meta-qti-bsp/meta-qti-base/recipes-multimedia/virtio-video/virtio-video-header_git.bb"
BBMASK:quin-gvm-lemans += "meta-qti-bsp/meta-qti-base/recipes-wlan"
BBMASK:quin-gvm-lemans += "meta-qti-base/recipes-connectivity/bt-dlkm/bt-dlkm_git.bb"
BBMASK:quin-gvm-lemans += "meta-qti-base/recipes-connectivity/synergy-opensource"
BBMASK:quin-gvm-lemans += "meta-qti-bsp/meta-qti-base/recipes-kernel/linux-msm/linux-msm_6.1.bb"

# BBMASK drops some recipe that checksum file not found in quin-gvm-gen4-5 target
BBMASK:quin-gvm-gen4-5 += "meta-qti-bsp/meta-qti-base/recipes-audio/audiolite-dlkm/audiolite-devicetree_git.bb"
BBMASK:quin-gvm-gen4-5 += "meta-qti-bsp/meta-qti-base/recipes-audio/audiolite-dlkm/audiolite-dlkm_git.bb"
BBMASK:quin-gvm-gen4-5 += "meta-qti-bsp/meta-qti-base/recipes-camera/cameradlkm/cameradlkm_0.1.bb"
BBMASK:quin-gvm-gen4-5 += "meta-qti-bsp/meta-qti-base/recipes-camera/cameradlkm/cameradlkm_0.2.bb"
BBMASK:quin-gvm-gen4-5 += "meta-qti-bsp/meta-qti-base/recipes-core/bootkpi-logging/bootkpi-logging.bb"
BBMASK:quin-gvm-gen4-5 += "meta-qti-bsp/meta-qti-base/recipes-core/reboot-daemon/reboot-daemon_2.0.bb"
BBMASK:quin-gvm-gen4-5 += "meta-qti-bsp/meta-qti-base/recipes-data/aurix-can/aurix-can_git.bb"
BBMASK:quin-gvm-gen4-5 += "meta-qti-bsp/meta-qti-base/recipes-data/avb-utils/avb-utils_1.0.bb"
BBMASK:quin-gvm-gen4-5 += "meta-qti-bsp/meta-qti-base/recipes-data/dataeth-dlkm/dataeth-dlkm_git.bb"
BBMASK:quin-gvm-gen4-5 += "meta-qti-bsp/meta-qti-base/recipes-data/eavb/eavb-fe-virtio_git.bb"
BBMASK:quin-gvm-gen4-5 += "meta-qti-bsp/meta-qti-base/recipes-data/emac-dwc-eqos/emac-dwc-eqos_git.bb"
BBMASK:quin-gvm-gen4-5 += "meta-qti-bsp/meta-qti-base/recipes-kernel/edk2/edk2_git.bb"
BBMASK:quin-gvm-gen4-5 += "meta-qti-bsp/meta-qti-base/recipes-kernel/linux-msm/linux-msm_5.15.bb"
BBMASK:quin-gvm-gen4-5 += "meta-qti-bsp/meta-qti-base/recipes-kernel/oot-dtbo/oot-dtbo.bb"
BBMASK:quin-gvm-gen4-5 += "meta-qti-bsp/meta-qti-base/recipes-kiumd/dspfirmware-mount/dspfirmware-mount_git.bb"
BBMASK:quin-gvm-gen4-5 += "meta-qti-bsp/meta-qti-base/recipes-kiumd/gvm-net-config/gvm-net-config_git.bb"
BBMASK:quin-gvm-gen4-5 += "meta-qti-bsp/meta-qti-base/recipes-kiumd/kiumd-headers/kiumd-headers_git.bb"
BBMASK:quin-gvm-gen4-5 += "meta-qti-bsp/meta-qti-base/recipes-kiumd/safelinux-cfg-modules/safelinux-cfg-modules_git.bb"
BBMASK:quin-gvm-gen4-5 += "meta-qti-bsp/meta-qti-base/recipes-multimedia/media/media_0.1.bb"
BBMASK:quin-gvm-gen4-5 += "meta-qti-bsp/meta-qti-base/recipes-safelinux-dbg-modules/safelinux-dbg-modules/safelinux-dbg-modules_git.bb"
BBMASK:quin-gvm-gen4-5 += "meta-qti-bsp/meta-qti-base/recipes-security/security-modules/safelinux-sec-modules_git.bb"
BBMASK:quin-gvm-gen4-5 += "meta-qti-bsp/meta-qti-base/recipes-virt/gunyah-drivers/gunyah-drivers_git.bb"
BBMASK:quin-gvm-gen4-5 += "meta-qti-bsp/meta-qti-base/recipes-virt/hyp-udmabuf/hyp-udmabuf_git.bb"
BBMASK:quin-gvm-gen4-5 += "meta-qti-bsp/meta-qti-base/recipes-virt/msmhab/msmhab_git.bb"
BBMASK:quin-gvm-gen4-5 += "meta-qti-bsp/meta-qti-base/recipes-virt/qcrosvm/qcrosvm_git.bb"
BBMASK:quin-gvm-gen4-5 += "meta-qti-bsp/meta-qti-base/recipes-virt/safelinux-system-cfg/safelinux-system-cfg_git.bb"
BBMASK:quin-gvm-gen4-5 += "meta-qti-bsp/meta-qti-base/recipes-virt/vhost-device/vhost-device-i2c_0.1.0.bb"
BBMASK:quin-gvm-gen4-5 += "meta-qti-bsp/meta-qti-base/recipes-virt/vhost-user-lib/vhost-user-lib_git.bb"
BBMASK:quin-gvm-gen4-5 += "meta-qti-bsp/meta-qti-base/recipes-virt/vhost-user-q/vhost-user-q_git.bb"
BBMASK:quin-gvm-gen4-5 += "meta-qti-bsp/meta-qti-base/recipes-virt/vhost-user-scmi/vhost-user-scmi_git.bb"
BBMASK:quin-gvm-gen4-5 += "meta-qti-bsp/meta-qti-extra/recipes-containers/softwarecontainer/softwarecontainer_git.bb"
BBMASK:quin-gvm-gen4-5 += "meta-qti-bsp/meta-qti-extra/recipes-location/location/gps-utils_git.bb"
BBMASK:quin-gvm-gen4-5 += "meta-qti-bsp/meta-qti-extra/recipes-location/location/loc-api-v02_git.bb"
BBMASK:quin-gvm-gen4-5 += "meta-qti-bsp/meta-qti-extra/recipes-location/location/location-api_git.bb"
BBMASK:quin-gvm-gen4-5 += "meta-qti-bsp/meta-qti-extra/recipes-location/location/location-api-iface_git.bb"
BBMASK:quin-gvm-gen4-5 += "meta-qti-bsp/meta-qti-extra/recipes-location/location/location-api-msg-proto_git.bb"
BBMASK:quin-gvm-gen4-5 += "meta-qti-bsp/meta-qti-extra/recipes-location/location/location-client-api_git.bb"
BBMASK:quin-gvm-gen4-5 += "meta-qti-bsp/meta-qti-extra/recipes-location/location/location-client-api-hdr_git.bb"
BBMASK:quin-gvm-gen4-5 += "meta-qti-bsp/meta-qti-extra/recipes-location/location/location-client-api-testapp_git.bb"
BBMASK:quin-gvm-gen4-5 += "meta-qti-bsp/meta-qti-extra/recipes-location/location/location-hal-daemon_git.bb"
BBMASK:quin-gvm-gen4-5 += "meta-qti-bsp/meta-qti-extra/recipes-location/location/location-integration-api_git.bb"
BBMASK:quin-gvm-gen4-5 += "meta-qti-bsp/meta-qti-extra/recipes-location/location/loc-core_git.bb"
BBMASK:quin-gvm-gen4-5 += "meta-qti-bsp/meta-qti-extra/recipes-location/location/loc-hal_git.bb"
BBMASK:quin-gvm-gen4-5 += "meta-qti-bsp/meta-qti-extra/recipes-location/location/loc-pla-hdr_git.bb"
BBMASK:quin-gvm-gen4-5 += "meta-qti-bsp/meta-qti-extra/recipes-location/location/loc-sll-if_git.bb"
BBMASK:quin-gvm-gen4-5 += "meta-qti-bsp/meta-qti-extra/recipes-location/location/ntrip-client-integration-api-hdr_git.bb"
BBMASK:quin-gvm-gen4-5 += "meta-qti-bsp/meta-qti-extra/recipes-location/location/synergy-loc-api_git.bb"
BBMASK:quin-gvm-gen4-5 += "meta-qti-bsp/meta-qti-extra/recipes-security/selinux-policy/selinux-policy.bb"
BBMASK:quin-gvm-gen4-5 += "meta-qti-bsp/meta-qti-extra/recipes-test/khab-test/khab-unit-test.bb"
BBMASK:quin-gvm-gen4-5 += "meta-qti-bsp/meta-qti-extra/recipes-test/virt-clk-ut/virt-clk-ut.bb"
BBMASK:quin-gvm-gen4-5 += "meta-qti-bsp/meta-qti-extra/recipes-test/virt-fastrpc-ut/virt-fastrpc-ut_git.bb"
BBMASK:quin-gvm-gen4-5 += "meta-qti-bsp/meta-qti-extra/recipes-test/virtio-i2c-test/virtio-i2c-test.bb"
BBMASK:quin-gvm-gen4-5 += "meta-qti-bsp/meta-qti-extra/recipes-test/virt-reg-ut/virt-reg-ut.bb"
BBMASK:quin-gvm-gen4-5 += "meta-qti-bsp/meta-qti-extra/recipes-test/virt-spmi-ut/virt-spmi-ut.bb"
BBMASK:quin-gvm-gen4-5 += "meta-qti-bsp/meta-qti-base/recipes-multimedia/virtio-video/virtio-video-header_git.bb"
BBMASK:quin-gvm-gen4-5 += "meta-qti-bsp/meta-qti-base/recipes-kernel/linux-msm/linux-msm_6.1.bb"

# BBMASK drops some recipe that checksum file not found in this target
BBMASK:qtiquingvm8295 += "meta-qti-bsp/meta-qti-extra/recipes-location/"
BBMASK:qtiquingvm8295 += "meta-qti-bsp/meta-qti-base/recipes-audio/audiolite-dlkm/audiolite-devicetree_git.bb"
BBMASK:qtiquingvm8295 += "meta-qti-bsp/meta-qti-base/recipes-audio/audiolite-dlkm/audiolite-dlkm_git.bb"
BBMASK:qtiquingvm8295 += "meta-qti-bsp/meta-qti-base/recipes-camera/cameradlkm/cameradlkm_0.2.bb"
BBMASK:qtiquingvm8295 += "meta-qti-bsp/meta-qti-base/recipes-core/bootkpi-logging/bootkpi-logging.bb"
BBMASK:qtiquingvm8295 += "meta-qti-bsp/meta-qti-base/recipes-core/reboot-daemon/reboot-daemon_2.0.bb"
BBMASK:qtiquingvm8295 += "meta-qti-bsp/meta-qti-base/recipes-data/aurix-can/aurix-can_git.bb"
BBMASK:qtiquingvm8295 += "meta-qti-bsp/meta-qti-base/recipes-data/dataeth-dlkm/dataeth-dlkm_git.bb"
BBMASK:qtiquingvm8295 += "meta-qti-bsp/meta-qti-base/recipes-data/emac-dwc-eqos/emac-dwc-eqos_git.bb"
BBMASK:qtiquingvm8295 += "meta-qti-bsp/meta-qti-base/recipes-graphics/wayland/weston_10.0.%.bbappend"
BBMASK:qtiquingvm8295 += "meta-qti-bsp/meta-qti-base/recipes-kernel/edk2/edk2_git.bb"
BBMASK:qtiquingvm8295 += "meta-qti-bsp/meta-qti-base/recipes-kernel/oot-dtbo/oot-dtbo.bb"
BBMASK:qtiquingvm8295 += "meta-qti-bsp/meta-qti-base/recipes-kernel/linux-msm/linux-msm-headers_6.12.bb"
BBMASK:qtiquingvm8295 += "meta-qti-bsp/meta-qti-base/recipes-kiumd/dspfirmware-mount/dspfirmware-mount_git.bb"
BBMASK:qtiquingvm8295 += "meta-qti-bsp/meta-qti-base/recipes-kiumd/gvm-net-config/gvm-net-config_git.bb"
BBMASK:qtiquingvm8295 += "meta-qti-bsp/meta-qti-base/recipes-kiumd/kiumd-headers/kiumd-headers_git.bb"
BBMASK:qtiquingvm8295 += "meta-qti-bsp/meta-qti-base/recipes-kiumd/safelinux-cfg-modules/safelinux-cfg-modules_git.bb"
BBMASK:qtiquingvm8295 += "meta-qti-bsp/meta-qti-base/recipes-multimedia/ffmpeg/ffmpeg_5.0.%.bbappend"
BBMASK:qtiquingvm8295 += "meta-qti-bsp/meta-qti-base/recipes-multimedia/media/media_0.1.bb"
BBMASK:qtiquingvm8295 += "meta-qti-bsp/meta-qti-base/recipes-multimedia/virtio-video/virtio-video-header_git.bb"
BBMASK:qtiquingvm8295 += "meta-qti-bsp/meta-qti-base/recipes-safelinux-dbg-modules/safelinux-dbg-modules/safelinux-dbg-modules_git.bb"
BBMASK:qtiquingvm8295 += "meta-qti-bsp/meta-qti-base/recipes-security/security-modules/safelinux-sec-modules_git.bb"
BBMASK:qtiquingvm8295 += "meta-qti-bsp/meta-qti-base/recipes-virt/gunyah-drivers/gunyah-drivers_git.bb"
BBMASK:qtiquingvm8295 += "meta-qti-bsp/meta-qti-base/recipes-virt/hyp-udmabuf/hyp-udmabuf_git.bb"
BBMASK:qtiquingvm8295 += "meta-qti-bsp/meta-qti-base/recipes-virt/msmhab/msmhab_git.bb"
BBMASK:qtiquingvm8295 += "meta-qti-bsp/meta-qti-base/recipes-virt/qcrosvm/qcrosvm_git.bb"
BBMASK:qtiquingvm8295 += "meta-qti-bsp/meta-qti-base/recipes-virt/safelinux-system-cfg/safelinux-system-cfg_git.bb"
BBMASK:qtiquingvm8295 += "meta-qti-bsp/meta-qti-base/recipes-virt/vhost-device/vhost-device-i2c_0.1.0.bb"
BBMASK:qtiquingvm8295 += "meta-qti-bsp/meta-qti-base/recipes-virt/vhost-user-lib/vhost-user-lib_git.bb"
BBMASK:qtiquingvm8295 += "meta-qti-bsp/meta-qti-base/recipes-virt/vhost-user-q/vhost-user-q_git.bb"
BBMASK:qtiquingvm8295 += "meta-qti-bsp/meta-qti-base/recipes-virt/vhost-user-scmi/vhost-user-scmi_git.bb"
BBMASK:qtiquingvm8295 += "meta-qti-bsp/meta-qti-extra/recipes-devtools/gtest/googletest_git.bbappend"
BBMASK:qtiquingvm8295 += "meta-qti-bsp/meta-qti-extra/recipes-security/refpolicy/refpolicy-mcs_%.bbappend"
BBMASK:qtiquingvm8295 += "meta-qti-bsp/meta-qti-extra/recipes-security/selinux/libsemanage_%.bbappend"
BBMASK:qtiquingvm8295 += "meta-qti-bsp/meta-qti-extra/recipes-security/selinux-policy/selinux-policy.bb"
BBMASK:qtiquingvm8295 += "meta-qti-bsp/meta-qti-extra/recipes-test/khab-test/khab-unit-test.bb"
BBMASK:qtiquingvm8295 += "meta-qti-bsp/meta-qti-extra/recipes-test/virt-clk-ut/virt-clk-ut.bb"
BBMASK:qtiquingvm8295 += "meta-qti-bsp/meta-qti-extra/recipes-test/virt-fastrpc-ut/virt-fastrpc-ut_git.bb"
BBMASK:qtiquingvm8295 += "meta-qti-bsp/meta-qti-extra/recipes-test/virtio-i2c-test/virtio-i2c-test.bb"
BBMASK:qtiquingvm8295 += "meta-qti-bsp/meta-qti-extra/recipes-test/virt-reg-ut/virt-reg-ut.bb"
BBMASK:qtiquingvm8295 += "meta-qti-bsp/meta-qti-extra/recipes-test/virt-spmi-ut/virt-spmi-ut.bb"
BBMASK:qtiquingvm8295 += "meta-qti-bsp/meta-qti-base/recipes-kernel/linux-msm/linux-msm_5.15.bb"
```
