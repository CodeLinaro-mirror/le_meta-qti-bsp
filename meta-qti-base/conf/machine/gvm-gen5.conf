## meta-qti-base/conf/machine/sa81x5.conf
```bitbake
#@TYPE: Machine
#@NAME: sa81x5
#@DESCRIPTION: Machine configuration for QTI sa81x5

BASEMACHINE = "sa81x5"
include conf/machine/include/auto-common.inc

#sa81x5 board chip belongs to cortexa76-cortexa55
include conf/machine/include/tune-cortexa76-cortexa55.inc

PREFERRED_PROVIDER_mkbootimg-native = "mkbootimg-gki-native"
PREFERRED_PROVIDER_dtc-native = "dtc-gki-native"

PREFERRED_VERSION_linux-msm = "5.15"
PREFERRED_VERSION_linux-msm-headers = "5.15"

PREFERRED_VERSION_adsprpc = "2.0"
PREFERRED_VERSION_edk2 = "4.0"

RECOVERY_IMAGE = "0"

KERNEL_ARCH = "gen3auto"
KERNEL_VARIANT = "${@bb.utils.contains_any('VARIANT', 'perf user', 'perf_', 'debug_', d)}"
KERNEL_BUILD_CONFIG = "msm-kernel/build.config.msm.${KERNEL_ARCH}.lxc"
KERNEL_IMAGE_HEADER_VERSION = "2"

KERNEL_BASE = "0x80000000"
KERNEL_TAGS_OFFSET = "0x1e00000"
EARLY_RAMDISK_MODE = "${@bb.utils.contains_any('VARIANT', 'perf user', '1', '0', d)}"
KERNEL_CMD_PARAMS = "console=ttyMSM0,115200n8 earlycon=qcom_geni,0xa90000 qcom_geni_serial.con_enabled=1 androidboot.first_stage_console=1 rootfstype=ext4 rw rootwait firmware_class.path=/firmware/image/ pd_ignore_unused pcie_ports=compat systemd.unified_cgroup_hierarchy=1 systemd.gpt_auto=0 "
KERNEL_CMD_PARAMS:append = " fsck.repair=yes "
KERNEL_CMD_PARAMS:append = "${@bb.utils.contains('MACHINE_FEATURES', 'early-ramdisk-init', ' rdinit=/sbin/early-ramdisk-init early-ramdisk.mode=${EARLY_RAMDISK_MODE} ', '', d)}"
KERNEL_CMD_PARAMS:append = "${@bb.utils.contains_any('VARIANT', 'perf user', 'no_hotplug_area=0x80000000,0x60000000 dyn_memhotplug ', '', d)}"
KERNEL_CMD_PARAMS:append = "${@bb.utils.contains('DISTRO_FEATURES', 'early_init', 'early_userspace ', '', d)}"
KERNEL_CMD_PARAMS:remove = "${@bb.utils.contains_any('VARIANT', 'perf user', 'console=ttyMSM0,115200n8', '', d)}"
KERNEL_CMD_PARAMS:remove = "${@bb.utils.contains_any('VARIANT', 'perf user', 'earlycon=qcom_geni,0xa90000', '', d)}"
KERNEL_CMD_PARAMS:remove = "${@bb.utils.contains_any('VARIANT', 'perf user', 'qcom_geni_serial.con_enabled=1', '', d)}"
KERNEL_CMD_PARAMS:remove = "${@bb.utils.contains('IMAGE_FEATURES', 'read-only-rootfs', 'rw', '', d)}"
KERNEL_CMD_PARAMS:append = "${@bb.utils.contains('DISTRO_FEATURES', 'qti-lxc', ' androidboot.android_dt_dir=/skip/ ', '', d)}"
KERNEL_CMD_PARAMS:append = "${@bb.utils.contains('DISTRO_FEATURES', 'qti-lxc', ' androidboot.console=tty30', '', d)}"
KERNEL_CMD_PARAMS:append = "${@bb.utils.contains('DISTRO_FEATURES', 'qti-lxc', ' androidboot.selinux=permissive', '', d)}"
KERNEL_CMD_PARAMS:append = "${@bb.utils.contains('DISTRO_FEATURES', 'qti-lxc', ' androidboot.hardware=qcom', '', d)}"
KERNEL_IMAGETYPE = "Image"

# bootloader configuration
EXTRA_IMAGEDEPENDS += "edk2"

IMAGE_FEATURES:append = " read-only-rootfs"

MACHINE_FEATURES += "\
    qti-adsp \
    qti-cdsp \
    qti-core \
    qti-extra \
    qti-lxc \
    qti-graphics \
    qti-camera \
    qti-security \
    dt-overlay \
    qti-audio \
    qti-display \
    qti-multimedia \
    qti-data \
    qti-tools \
    qti-vnw \
    goldcore-boot \
    qti-ml \
    early-ramdisk-init \
"

# Disable it on on sa81x5(kernel-5.15) as features are not ready
MACHINE_FEATURES:remove = "\
    qti-bluetooth \
    qti-location \
"
```

## meta-qti-base/conf/machine/sa8540.conf
```bitbake
#@TYPE: Machine
#@NAME: sa8540
#@DESCRIPTION: Machine configuration for QTI sa8540

BASEMACHINE = "sa8540"
include conf/machine/include/sa8540.inc

DEFAULTTUNE = "aarch64"
include conf/machine/include/arm/arch-armv8a.inc

RECOVERY_IMAGE = "0"

KERNEL_IMAGE_HEADER_VERSION = "1"
KERNEL_BASE = "0x80000000"
KERNEL_TAGS_OFFSET = "0x1e00000"
KERNEL_CONFIG = "defconfig"
KERNEL_MACHINE_DTB = "qcom/sa8540p-adp-ride.dtb"

KERNEL_CMD_PARAMS = "rw rootwait console=ttyMSM0,115200,n8 no_console_suspend=1 androidboot.hardware=qcom androidboot.console=ttyMSM0 lpm_levels.sleep_disabled=1 msm_rtb.filter=0x237 earlycon=qcom_geni,0x884000 fips=0 notests nokaslr ignore_loglevel firmware_class.path=/firmware "
KERNEL_CMD_PARAMS:append = "${@bb.utils.contains('MACHINE_FEATURES', 'early-ramdisk-init', ' rdinit=/sbin/early-ramdisk-init early-ramdisk.mode=0 ', '', d)}"

KERNEL_IMAGETYPE = "Image.gz"

IMAGE_FEATURES:append = " read-only-rootfs"

MACHINE_FEATURES += "\
    qti-core \
    qti-tools \
"
```
