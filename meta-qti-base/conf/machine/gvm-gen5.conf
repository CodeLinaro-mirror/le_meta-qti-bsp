## meta-qti-base/conf/machine/include/hgy-bbmask.inc
```bitbake
BBMASK:append = " ${MISSING_RECIPE_SRCLIST}"

# Missing recipes globally
MISSING_RECIPE_SRCLIST += "\
meta-qti-base-prop/recipes-android/libvmmem_headers/libvmmem-headers_git.bb \
meta-qti-base-prop/recipes-android/libvmmem/libvmmem_git.bb \
meta-qti-base-prop/recipes-audio/acdbdata/acdbdata_git.bb \
meta-qti-base-prop/recipes-audio/acdbloader/acdbloader_git.bb \
meta-qti-base-prop/recipes-audio/acdbloaderservice/acdbloaderservice_git.bb \
meta-qti-base-prop/recipes-audio/acdbrtac/acdbrtac_git.bb \
meta-qti-base-prop/recipes-audio/adiertac/adiertac_git.bb \
meta-qti-base-prop/recipes-audio/alsaucm-conf/alsaucm-conf_1.0.bb \
meta-qti-base-prop/recipes-audio/audcal/audcal_git.bb \
meta-qti-base-prop/recipes-audio/audcalparam/audcalparam_git.bb \
meta-qti-base-prop/recipes-audio/audiod/audiod_git.bb \
meta-qti-base-prop/recipes-audio/audio-devicetree/audio-devicetree_1.0.bb \
meta-qti-base-prop/recipes-audio/auto-casa-xml/auto-casa-xml_git.bb \
meta-qti-base-prop/recipes-audio/mm-audio-headers/mm-audio-headers_git.bb \
meta-qti-base-prop/recipes-bsp/msmirqbalance/msmirqbalance_git.bb \
meta-qti-base-prop/recipes-bsp/platform-devicetree/platform-devicetree_git.bb \
meta-qti-base-prop/recipes-camera/ais/ais_0.1.bb \
meta-qti-base-prop/recipes-camera/camera-devicetree/camera-devicetree_git.bb \
meta-qti-base-prop/recipes-camera/camx/camx_0.1.bb \
meta-qti-base-prop/recipes-camera/camx-lib/camx-lib_0.1.bb \
meta-qti-base-prop/recipes-camera/cdk/chi-cdk_0.1.bb \
meta-qti-base-prop/recipes-core/diag-reboot-app/diag-reboot-app_git.bb \
meta-qti-base-prop/recipes-core/libvirtdiag/libvirtdiag_git.bb \
meta-qti-base-prop/recipes-data/data/configdb_git.bb \
meta-qti-base-prop/recipes-data/data/dsutils_git.bb \
meta-qti-base-prop/recipes-data/qmi/qmi_git.bb \
meta-qti-base-prop/recipes-data/vnw-devicetree/vnw-devicetree_git.bb \
meta-qti-base-prop/recipes-data/xmllib/xmllib_git.bb \
meta-qti-base-prop/recipes-graphics/adreno/adreno.bb \
meta-qti-base-prop/recipes-graphics/graphics-devicetree/graphics-devicetree_git.bb \
meta-qti-base-prop/recipes-graphics/mm-gfx-auto-prop/mm-gfx-auto-prop_git.bb \
meta-qti-base-prop/recipes-kernel/guest-bootloader/guest-bootloader.bb \
meta-qti-base-prop/recipes-kernel/kernel-devicetree/kernel-devicetree.bb \
meta-qti-base-prop/recipes-ml/libnpu/libnpu_git.bb \
meta-qti-base-prop/recipes-multimedia/adsprpc/adsprpc_git.bb \
meta-qti-base-prop/recipes-multimedia/cvp-noship/cvp-noship_git.bb \
meta-qti-base-prop/recipes-multimedia/gstreamer/gstreamer1.0-qvconv_1.0.0.bb \
meta-qti-base-prop/recipes-multimedia/hyp-vpp/vpp-headers_git.bb \
meta-qti-base-prop/recipes-multimedia/media-codec2/codec2-service_auto.1.0.bb \
meta-qti-base-prop/recipes-multimedia/media-codec2/codec2-service_git.bb \
meta-qti-base-prop/recipes-multimedia/media-codec2/libvideotxr_auto.1.0.bb \
meta-qti-base-prop/recipes-multimedia/media-codec2/media-codec2_auto.1.0.bb \
meta-qti-base-prop/recipes-multimedia/media-codec2/media-codec2_git.bb \
meta-qti-base-prop/recipes-multimedia/media-external/media-external_auto.1.0.bb \
meta-qti-base-prop/recipes-multimedia/media-external/media-external_git.bb \
meta-qti-base-prop/recipes-multimedia/media-noship/media-noship_auto.1.0.bb \
meta-qti-base-prop/recipes-multimedia/media-noship/media-noship_git.bb \
meta-qti-base-prop/recipes-multimedia/mm-video-noship/mmvideo-common-headers_git.bb \
meta-qti-base-prop/recipes-multimedia/mm-video-noship/mm-video-noship_0.1.bb \
meta-qti-base-prop/recipes-multimedia/mm-video-utils/mm-video-utils_0.1.bb \
meta-qti-base-prop/recipes-multimedia/video-devicetree/video-devicetree_git.bb \
meta-qti-base-prop/recipes-wlan-prop/wlan-devicetree/wlan-devicetree_1.0.bb \
meta-qti-base/recipes-aosp/libdmabufheap/libdmabufheap_git.bb \
meta-qti-base/recipes-audio/agm/agm_git.bb \
meta-qti-base/recipes-audio/agm-alsa-plugin/agm-alsa-plugin_git.bb \
meta-qti-base/recipes-audio/agm_client/agm-client_git.bb \
meta-qti-base/recipes-audio/agm_server/agm-server_git.bb \
meta-qti-base/recipes-audio/agm-sndparser/agm-sndparser_git.bb \
meta-qti-base/recipes-audio/agm-test/agm-test_git.bb \
meta-qti-base/recipes-audio/agm-tinyalsa-plugin/agm-tinyalsa-plugin_git.bb \
meta-qti-base/recipes-audio/ar-audiodlkm/ar-audiodlkm_git.bb \
meta-qti-base/recipes-audio/ar-pal/ar-pal_git.bb \
meta-qti-base/recipes-audio/audiodlkm/audiodlkm_git.bb \
meta-qti-base/recipes-audio/pal-control-plugin/pal-control-plugin_git.bb \
meta-qti-base/recipes-audio/pulseaudio-module-acdb/pulseaudio-module-acdb_git.bb \
meta-qti-base/recipes-audio/pulseaudio-module-codec-control/pulseaudio-module-codec-control_git.bb \
meta-qti-base/recipes-audio/pulseaudio-module-codec-control/pulseaudio-module-codec-control-headers_git.bb \
meta-qti-base/recipes-bsp/libsensors/libsensors_git.bb \
meta-qti-base/recipes-bsp/platformdlkm/platformdlkm_git.bb \
meta-qti-base/recipes-camera/cameradlkm/cameradlkm_0.1.bb \
meta-qti-base/recipes-camera/cameradlkm/cameradlkm_0.2.bb \
meta-qti-base/recipes-core/reboot-daemon/reboot-daemon_2.0.bb \
meta-qti-base/recipes-data/avb-utils/avb-utils_1.0.bb \
meta-qti-base/recipes-data/dataeth-dlkm/dataeth-dlkm_git.bb \
meta-qti-base/recipes-data/eavb/eavb-fe-virtio_git.bb \
meta-qti-base/recipes-data/emac-dwc-eqos/emac-dwc-eqos_git.bb \
meta-qti-base/recipes-data/ptp-virtual/ptp-virtual_git.bb \
meta-qti-base/recipes-graphics/graphics-driver/graphicsdlkm_git.bb \
meta-qti-base/recipes-kernel/dtc/dtc-aosp.bb \
meta-qti-base/recipes-kernel/kernel-aosp-tools/kernel-aosp-tools-native.bb \
meta-qti-base/recipes-multimedia/codec2/codec2-app_git.bb \
meta-qti-base/recipes-multimedia/dsp-kernel/dsp-kernel_git.bb \
meta-qti-base/recipes-multimedia/gstreamer/drm-player-example_1.0.0.bb \
meta-qti-base/recipes-multimedia/gstreamer/gstreamer1.0-plugin-qvais_git.bb \
meta-qti-base/recipes-multimedia/gstreamer/gstreamer1.0-plugins-codec2_1.0.0.bb \
meta-qti-base/recipes-multimedia/gstreamer/gstreamer1.0-plugins-drmdecryptor_1.0.0.bb \
meta-qti-base/recipes-multimedia/gstreamer/gstreamer1.0-plugins-extpoolsink.bb \
meta-qti-base/recipes-multimedia/gstreamer/gstreamer1.0-plugins-qcarcamsrc_git.bb \
meta-qti-base/recipes-multimedia/gstreamer/gstreamer1.0-plugins-qeavb_1.0.bb \
meta-qti-base/recipes-multimedia/gstreamer/gstreamer1.0-plugins-qscreencapsrc_1.0.0.bb \
meta-qti-base/recipes-multimedia/gstreamer/gstreamer1.0-plugins-qvblend_1.0.bb \
meta-qti-base/recipes-multimedia/gstreamer/gstreamer1.0-plugins-qvdeinterlace_1.0.bb \
meta-qti-base/recipes-multimedia/gstreamer/gstreamer1.0-plugins-qvrate_git.bb \
meta-qti-base/recipes-multimedia/gstreamer/gstreamer1.0-plugins-vesdeliver_1.0.0.bb \
meta-qti-base/recipes-multimedia/gstreamer/mm-vdec-omx-test-lite_0.1.bb \
meta-qti-base/recipes-multimedia/gstreamer/mm-venc-omx-test-lite_0.1.bb \
meta-qti-base/recipes-multimedia/gstreamer/secure-video-app_1.0.0.bb \
meta-qti-base/recipes-multimedia/media/media_0.1.bb \
meta-qti-base/recipes-multimedia/videodlkm/videodlkm_git.bb \
meta-qti-base/recipes-security/securemsmdlkm/securemsmdlkm_git.bb \
meta-qti-extra-prop/recipes-containers/lxc-conf/lxc-conf.bb \
meta-qti-extra-prop/recipes-location/ \
meta-qti-extra-prop/recipes-tools/uhab-unit-test/uhab-unit-test.bb \
meta-qti-extra/recipes-containers/softwarecontainer/softwarecontainer_git.bb \
meta-qti-extra/recipes-location/location/ \
meta-qti-extra/recipes-test/khab-test/khab-unit-test.bb \
meta-qti-extra/recipes-test/virt-clk-ut/virt-clk-ut.bb \
meta-qti-extra/recipes-test/virt-fastrpc-ut/virt-fastrpc-ut_git.bb \
meta-qti-extra/recipes-test/virtio-i2c-test/virtio-i2c-test.bb \
meta-qti-extra/recipes-test/virt-reg-ut/virt-reg-ut.bb \
meta-qti-extra/recipes-test/virt-spmi-ut/virt-spmi-ut.bb \
meta-qti-upstream/recipes-multimedia/pulseaudio/agl-audio-plugin_0.1.bb \
"
```

## meta-qti-base/conf/machine/include/sa8775.inc
```bitbake
include conf/machine/include/basemachine.inc

SOC_FAMILY ?= "sa-common"
include conf/machine/include/soc-family.inc
PRODUCT = "${MACHINE}"
PREFERRED_PROVIDER_virtual/kernel = "linux-ark"
PREFERRED_PROVIDER_virtual/kernel-headers = "linux-ark-headers"
PREFERRED_VERSION_linux-ark = "5.14"

# Prefer Wayland/Weston version
PREFERRED_VERSION_weston = "8.0.0"
PREFERRED_VERSION_wayland = "1.18.0"
PREFERRED_VERSION_wayland-native = "1.18.0"
PREFERRED_VERSION_wayland-protocols = "1.20"
PREFERRED_VERSION_wayland-ivi-extension = "2.2.0"
preferred-kernel = "${@oe.utils.ifelse(d.getVar('PREFERRED_PROVIDER_virtual/kernel') == 'linux-ark', 'PREFERRED_VERSION_linux-ark', 'PREFERRED_VERSION_linux-msm')}"
kernel-version = "${@oe.utils.ifelse(d.getVar('PREFERRED_PROVIDER_virtual/kernel') == 'linux-ark', '5.14', '5.4')}"
# Prefer gbm
PREFERRED_PROVIDER_virtual/libgbm = "gbm"

# Prefer adreno
PREFERRED_PROVIDER_virtual/wayland-egl  = "adreno"
PREFERRED_PROVIDER_virtual/egl          = "adreno"
PREFERRED_PROVIDER_virtual/libgles1     = "adreno"
PREFERRED_PROVIDER_virtual/libgles2     = "adreno"

BBMASK += "meta-qti-bsp/meta-qti-base/recipes-wlan"
BBMASK += "meta-qti-bsp/meta-qti-base/recipes-kernel/edk2/edk2_4.0.bb"

# mesa provides these packags and others like virtual/libgl.
# This is to enable mesa, adreno and gbm work together, and pass
# yocot-check-layer script check.
MULTI_PROVIDER_WHITELIST += "virtual/wayland-egl virtual/egl virtual/libgles1 virtual/libgles2 virtual/libgbm"

SERIAL_CONSOLE ?= "${@['', '115200 ttyMSM0'][d.getVar('VARIANT', True) == ('' or 'debug')]}"
SERIAL_CONSOLES = "115200;ttyMSM0"

IMAGE_FSTYPES ?= "ext4"
PAGE_SIZE ?= '4096'
IMAGE_ROOTFS_ALIGNMENT = "4096"
EXTRA_IMAGECMD_ext4 += " -b 4096 "

IMAGE_CLASSES += "qimage"
```

## meta-qti-base/conf/machine/lemans.conf
```bitbake
#@TYPE: Machine
#@NAME: LeMans
#@DESCRIPTION: Machine configuration for QTI LeMans

BASEMACHINE = "lemans"
include conf/machine/include/auto-common.inc

DEFAULTTUNE = "aarch64"
include conf/machine/include/arm/arch-armv8a.inc
TUNE_CCARGS:append = " -march=armv8-a -mcpu=cortex-a57 -mtune=cortex-a57"

PREFERRED_PROVIDER_mkbootimg-native = "mkbootimg-gki-native"
PREFERRED_VERSION_linux-msm = "5.15"
PREFERRED_VERSION_linux-msm-headers = "5.15"

PREFERRED_VERSION_adsprpc = "2.0"
PREFERRED_VERSION_edk2 = "4.0"
EDK2_USE_PREBUILTS = "True"

RECOVERY_IMAGE = "0"

KERNEL_ARCH = "gen4auto"
KERNEL_VARIANT = "${@bb.utils.contains_any('VARIANT', 'perf user', 'perf_', 'debug_', d)}"
KERNEL_BUILD_CONFIG = "msm-kernel/build.config.msm.${KERNEL_ARCH}.lxc"
KERNEL_IMAGE_HEADER_VERSION = "2"

KERNEL_BASE = "0x80000000"
KERNEL_TAGS_OFFSET = "0x1e00000"
KERNEL_CONFIG = "${@['vendor/${KERNEL_ARCH}-qgki_defconfig', 'vendor/${KERNEL_ARCH}-qgki-debug_defconfig'][d.getVar('VARIANT', True) == ('' or 'debug')]}"
KERNEL_CMD_PARAMS = "console=ttyMSM0,115200n8 earlycon=qcom_geni,0xa8c000 qcom_geni_serial.con_enabled=1 no_console_suspend=1 lpm_levels.sleep_disabled=1 rw rootwait rootfstype=ext4 firmware_class.path=/firmware/image/ nokaslr service_locator.enable=1 pcie_ports=compat"
KERNEL_CMD_PARAMS:append = " fsck.repair=yes "
KERNEL_CMD_PARAMS:remove = "${@bb.utils.contains_any('VARIANT', 'perf user', 'console=ttyMSM0,115200n8', '', d)}"
KERNEL_CMD_PARAMS:remove = "${@bb.utils.contains_any('VARIANT', 'perf user', 'earlycon=qcom_geni,0xa8c000', '', d)}"
KERNEL_CMD_PARAMS:remove = "${@bb.utils.contains('IMAGE_FEATURES', 'read-only-rootfs', 'rw', '', d)}"
KERNEL_IMAGETYPE = "Image"

# bootloader configuration
EXTRA_IMAGEDEPENDS += "edk2"

IMAGE_FEATURES:append = " read-only-rootfs"

MACHINE_FEATURES += "\
    qti-adsp \
    qti-cdsp \
    qti-core \
    qti-extra \
    qti-tools \
    qti-lxc \
    qti-graphics \
    qti-display \
    qti-wlan \
    qti-data \
    qti-vnw \
    qti-bluetooth \
"
MACHINE_FEATURES += "dt-overlay"

#MACHINE_EXTRA_RDEPENDS += "vpu-firmware"

SECTOOLS_VERSION = "sectools-v2"
```

## meta-qti-base/conf/machine/qtigvmi3.conf
```bitbake
#@TYPE: Machine
#@NAME: qtigvmi3
#@DESCRIPTION: Machine configuration for QTI QUIN

BASEMACHINE ?= "qtigvmi3"
include conf/machine/include/auto-common.inc

DEFAULTTUNE = "aarch64"
include conf/machine/include/arm/arch-armv8a.inc

SERIAL_CONSOLE = "115200 ttyAMA0"

KERNEL_BASE = "0x80000000"
KERNEL_TAGS_OFFSET = "0x1e00000"
KERNEL_CONFIG = "${@['vendor/autogvm-qgki_defconfig', 'vendor/autogvm-qgki-debug_defconfig'][d.getVar('VARIANT', True) == ('' or 'debug')]}"
KERNEL_CMD_PARAMS = " "
KERNEL_IMAGETYPE = "Image"

MACHINE_FEATURES += "\
    qti-audio \
    qti-audio-ar \
    qti-bluetooth \
    qti-camera \
    qti-core \
    qti-data \
    qti-display \
    qti-dual-wlan \
    qti-extra \
    qti-graphics \
    qti-hypervisor \
    qti-ml \
    qti-multimedia \
    qti-security \
    qti-vnw \
    qti-wlan \
    qti-tools \
    qti-dual-cdsp \
"
```

## meta-qti-base/conf/machine/qtiquingvm.conf
```bitbake
#@TYPE: Machine
#@NAME: qtiquingvm
#@DESCRIPTION: Machine configuration for QTI QUIN

BASEMACHINE = "qtiquingvm"
include conf/machine/include/auto-common.inc

#sa8195 board chip belongs to cortexa76-cortexa55
include conf/machine/include/tune-cortexa76-cortexa55.inc

SERIAL_CONSOLE = "115200 ttyAMA0"

KERNEL_BASE = "0x80000000"
KERNEL_TAGS_OFFSET = "0x1e00000"
KERNEL_CONFIG = "${@['vendor/autogvm-qgki_defconfig', 'vendor/autogvm-qgki-debug_defconfig'][d.getVar('VARIANT', True) == ('' or 'debug')]}"
KERNEL_CMD_PARAMS = " "
KERNEL_IMAGETYPE = "Image"

#16GB emmc flash image size config
IMAGE_ROOTFS_SIZE ?= "1048576"
PERSIST_IMAGE_ROOTFS_SIZE ?= "64M"
USERDATA_SIZE_EXT4 ?= "524288000"

MACHINE_FEATURES += "\
    qti-bluetooth \
    qti-core \
    qti-data \
    qti-dual-wlan \
    qti-extra \
    qti-hypervisor \
    qti-ml \
    qti-security \
    qti-vnw \
    qti-wlan \
    qti-tools \
"

KERNEL_CMD_PARAMS:append = " console=ttyAMA0 loglevel=8 user_debug=31 print-fatal-signals=1 no_console_suspend firmware_class.path=/firmware/image/ fsck.repair=yes ip=192.168.1.2::192.168.1.10:255.255.255.0::eth0:none swiotlb=5120 kpti=1 pcie_ports=compat "
```

## meta-qti-base/conf/machine/qtiquingvm8295.conf
```bitbake
#@TYPE: Machine
#@NAME: qtiquingvm8295
#@DESCRIPTION: Machine configuration for QTI Quin

BASEMACHINE ?= "qtiquingvm8295"
include conf/machine/include/auto-common.inc

# sa8295 board chip belongs to Cortex-A78C-Cortex-X1C
# GCC and Clang do not support Cortex-A78C-Cortex-X1C configurations yet.
# The highest configuration currently supported is Cortex-A78C(kirkstone)
include conf/machine/include/tune-cortexa78c.inc

PREFERRED_PROVIDER_mkbootimg-native = "mkbootimg-aosp-native"
PREFERRED_PROVIDER_dtc-native = "dtc-aosp-native"

PREFERRED_VERSION_linux-msm = "5.15"
PREFERRED_VERSION_linux-msm-headers = "5.15"
PREFERRED_VERSION_adsprpc = "2.0"

KERNEL_ARCH = "autogvm"
KERNEL_VARIANT = "${@bb.utils.contains_any('VARIANT', 'perf user', 'perf_', 'debug_', d)}"
KERNEL_BUILD_CONFIG = "msm-kernel/build.config.msm.${KERNEL_ARCH}.lxc"
KERNEL_IMAGE_HEADER_VERSION = "2"

KERNEL_BASE = "0x80000000"
KERNEL_TAGS_OFFSET = "0x1e00000"
KERNEL_CONFIG = "${@['vendor/autogvm_defconfig', 'vendor/autogvm-debug_defconfig'][d.getVar('VARIANT', True) == ('' or 'debug')]}"
KERNEL_CMD_PARAMS = " "
KERNEL_IMAGETYPE = "Image"

MACHINE_FEATURES += "\
    qti-adsp \
    qti-bluetooth \
    qti-cdsp \
    qti-audio \
    qti-core \
    qti-extra \
    qti-tools \
    qti-hypervisor \
    qti-multimedia \
    qti-data \
    qti-display \
    qti-graphics \
    qti-security \
    qti-dual-wlan \
    qti-wlan \
    qti-camera \
    qti-vnw \
    qti-camera-qcc4 \
"
```
