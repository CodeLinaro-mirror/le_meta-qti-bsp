## meta-qti-base/conf/machine/quin-gvm-4gb.conf
```bitbake
#@TYPE: Machine
#@NAME: quin-gvm-4gb
#@DESCRIPTION: Machine configuration for QTI QUIN

BASEMACHINE = "quin-gvm-4gb"
include conf/machine/include/auto-common.inc

#sa8195 board chip belongs to cortexa76-cortexa55
include conf/machine/include/tune-cortexa76-cortexa55.inc

SERIAL_CONSOLE = "115200 ttyAMA0"

KERNEL_BASE = "0x80000000"
KERNEL_TAGS_OFFSET = "0x1e00000"
KERNEL_CONFIG = "${@['vendor/autogvm-qgki_defconfig', 'vendor/autogvm-qgki-debug_defconfig'][d.getVar('VARIANT', True) == ('' or 'debug')]}"
KERNEL_CMD_PARAMS = " "
KERNEL_IMAGETYPE = "Image"

MACHINE_FEATURES += "\
    qti-audio \
    qti-bluetooth \
    qti-camera \
    qti-core \
    qti-data \
    qti-display \
    qti-dual-wlan \
    qti-extra \
    qti-graphics \
    qti-hypervisor \
    qti-ml \
    qti-multimedia \
    qti-security \
    qti-vnw \
    qti-wlan \
    qti-tools \
"

KERNEL_CMD_PARAMS:append = " console=ttyAMA0 loglevel=8 user_debug=31 print-fatal-signals=1 no_console_suspend firmware_class.path=/firmware/image/ fsck.repair=yes ip=192.168.1.2::192.168.1.10:255.255.255.0::eth0:none swiotlb=5120 kpti=1 pcie_ports=compat "
```

## meta-qti-base/conf/machine/quin-gvm-gen4-5.conf
```bitbake
#@TYPE: Machine
#@NAME: quin-gvm-gen4-5
#@DESCRIPTION: Machine configuration for QTI Quin GVM GEN4.5 Platform

BASEMACHINE ?= "quin-gvm-gen4-5"
include conf/machine/include/auto-common.inc

#MASK unused recipe in target
include conf/machine/include/gvm-bbmask.inc
include conf/distro/include/gvm-bbmask-prop.inc

include conf/machine/include/tune-cortexa78c.inc

PREFERRED_PROVIDER_dtc-native = "dtc-aosp-native"

PREFERRED_VERSION_linux-msm = "6.12"
PREFERRED_VERSION_linux-msm-headers = "6.12"
PREFERRED_VERSION_adsprpc = "2.0"
PREFERRED_VERSION_media-codec2 = "auto.1.0"
PREFERRED_VERSION_media-external = "auto.1.0"
PREFERRED_VERSION_media-noship = "auto.1.0"
PREFERRED_VERSION_codec2-service = "auto.1.0"

TUNE_CCARGS:remove:toolchain-clang = "-mbranch-protection=standard"

# gvm prefer camx
PREFERRED_VERSION_cameradlkm = "0.2"

KERNEL_ARCH = "autogvm"
KERNEL_VARIANT = "${@bb.utils.contains_any('VARIANT', 'perf user', 'perf_', 'debug_', d)}"
KERNEL_BUILD_CONFIG = "msm-kernel/build.config.msm.${KERNEL_ARCH}.lxc"
KERNEL_IMAGE_HEADER_VERSION = "2"

KERNEL_BASE = "0x80000000"
KERNEL_TAGS_OFFSET = "0x1e00000"
KERNEL_CONFIG = "${@['vendor/autogvm_defconfig', 'vendor/autogvm-debug_defconfig'][d.getVar('VARIANT', True) == ('' or 'debug')]}"
KERNEL_CMD_PARAMS = " "
KERNEL_IMAGETYPE = "Image"

KERNEL_CMD_PARAMS:append = "${@bb.utils.contains('MACHINE_FEATURES', 'early-ramdisk-init', ' rdinit=/sbin/early-ramdisk-init early-ramdisk.mode=1 ', '', d)}"

EARLY_RAMDISK_KERNEL_MODULES = "\
    kernel-module-virtio-mmio-${KERNEL_VERSION} \
    kernel-module-failover-${KERNEL_VERSION} \
    kernel-module-net-failover-${KERNEL_VERSION} \
    kernel-module-virtio-net-${KERNEL_VERSION} \
    kernel-module-msm-hab-${KERNEL_VERSION} \
    kernel-module-crypto-qti-virt-${KERNEL_VERSION} \
    kernel-module-virtio-blk-${KERNEL_VERSION} \
    kernel-module-virtio-blk-qti-crypto-${KERNEL_VERSION} \
"

MACHINE_FEATURES += "\
    qti-core \
    qti-tools \
    qti-hypervisor \
    qti-data \
    qti-dlkm \
    qti-multimedia \
    qti-security \
    qti-bluetooth \
    qti-adsp \
    qti-cdsp \
    qti-cdsp1 \
    qti-extra \
    qti-wlan \
    qti-wlan-hsp \
    qti-wlan-genoa \
    qti-camera \
    qti-graphics \
    qti-display \
    qti-audio-ar \
    qti-vnw \
    early-ramdisk-init \
"

MACHINE_FEATURES:remove = "\
    qti-lxc \
    qti-multimedia \
    qti-security \
    qti-bluetooth \
    qti-wlan \
    qti-wlan-hsp \
    qti-wlan-genoa \
    qti-camera \
    qti-graphics \
    qti-display \
    qti-audio-ar \
    qti-vnw \
"
```

## meta-qti-base/conf/machine/quin-gvm-gen4.conf
```bitbake
#@TYPE: Machine
#@NAME: quin-gvm-gen4
#@DESCRIPTION: Machine configuration for QTI QUIN

BASEMACHINE ?= "quin-gvm-gen4"
include conf/machine/include/auto-common.inc

#sa8295 board chip belongs to Cortex-A78C-Cortex-X1C
#GCC and Clang do not support Cortex-A78C-Cortex-X1C configurations yet.The highest configuration currently supported is Cortex-A78C(yocto.4.0).
include conf/machine/include/tune-cortexa78c.inc

PREFERRED_PROVIDER_dtc-native = "dtc-aosp-native"

PREFERRED_VERSION_linux-msm = "6.1"
PREFERRED_VERSION_adsprpc = "2.0"

KERNEL_ARCH = "autogvm"
KERNEL_VARIANT = "${@bb.utils.contains_any('VARIANT', 'perf user', 'perf_', 'debug_', d)}"
KERNEL_BUILD_CONFIG = "msm-kernel/build.config.msm.${KERNEL_ARCH}.lxc"
KERNEL_IMAGE_HEADER_VERSION = "2"

KERNEL_BASE = "0x80000000"
KERNEL_TAGS_OFFSET = "0x1e00000"
KERNEL_CONFIG = "${@['vendor/autogvm_defconfig', 'vendor/autogvm-debug_defconfig'][d.getVar('VARIANT', True) == ('' or 'debug')]}"
KERNEL_CMD_PARAMS = " "
KERNEL_IMAGETYPE = "Image"

MACHINE_FEATURES += "\
    qti-core \
    qti-data \
    qti-dlkm \
    qti-hypervisor \
    qti-multimedia \
    qti-tools \
    qti-graphics \
    qti-display \
    qti-wlan \
    qti-wlan-hsp \
    qti-adsp \
    qti-cdsp \
    qti-cdsp1 \
    qti-extra \
    qti-security \
    qti-camera \
    qti-audio-ar \
"

SECTOOLS_VERSION = "sectools-v1"
```

## meta-qti-base/conf/machine/quin-gvm-monaco.conf
```bitbake
#@TYPE: Machine
#@NAME: quin-gvm-monaco
#@DESCRIPTION: Machine configuration for QTI quin-gvm-monaco

BASEMACHINE = "quin-gvm-monaco"
include conf/machine/include/auto-common.inc

# Monaco board chip belongs to Cortex-A55-Cortex-a78C
# GCC and Clang do not support Cortex-A55-Cortex-a78C configurations yet.
# The highest big.LITTLE system currently supported is cortex-a76.cortex-a55.
include conf/machine/include/arm/armv8-2a/tune-cortexa76-cortexa55.inc

PREFERRED_PROVIDER_dtc-native = "dtc-aosp-native"

PREFERRED_VERSION_linux-msm = "6.1"
PREFERRED_VERSION_adsprpc = "2.0"
PREFERRED_VERSION_media-codec2 = "auto.1.0"
PREFERRED_VERSION_media-external = "auto.1.0"
PREFERRED_VERSION_media-noship = "auto.1.0"
PREFERRED_VERSION_codec2-service = "auto.1.0"

# monaco gvm prefer camx
PREFERRED_VERSION_cameradlkm = "0.2"

KERNEL_ARCH = "autogvm"
KERNEL_VARIANT = "${@bb.utils.contains_any('VARIANT', 'perf user', 'perf_', 'debug_', d)}"
KERNEL_BUILD_CONFIG = "msm-kernel/build.config.msm.${KERNEL_ARCH}.lxc"
KERNEL_IMAGE_HEADER_VERSION = "2"

KERNEL_BASE = "0x80000000"
KERNEL_TAGS_OFFSET = "0x1e00000"
KERNEL_CONFIG = "${@['vendor/autogvm_defconfig', 'vendor/autogvm-debug_defconfig'][d.getVar('VARIANT', True) == ('' or 'debug')]}"
KERNEL_CMD_PARAMS = " "
KERNEL_IMAGETYPE = "Image"

MACHINE_FEATURES += "\
    qti-core \
    qti-tools \
    qti-hypervisor \
    qti-data \
    qti-dlkm \
    qti-security \
    qti-bluetooth \
    qti-graphics \
    qti-wlan \
    qti-wlan-genoa \
    qti-camera \
    qti-display \
    qti-multimedia \
    qti-cdsp \
    qti-extra \
    qti-audio-ar \
    qti-vnw \
"
MACHINE_FEATURES:remove = "\
    qti-adsp \
    qti-cdsp1 \
    qti-bluetooth \
    qti-fastcv \
    qti-lxc \
"
```

## meta-qti-base/conf/machine/sa6155.conf
```bitbake
#@TYPE: Machine
#@NAME: sa6155
#@DESCRIPTION: Machine configuration for QTI sa6155

BASEMACHINE = "sa6155"
include conf/machine/include/auto-common.inc

#sa6155 board chip belongs to cortexa76-cortexa55
include conf/machine/include/tune-cortexa76-cortexa55.inc

KERNEL_BASE = "0x80000000"
KERNEL_TAGS_OFFSET = "0x1e00000"
KERNEL_CONFIG = "${@['vendor/sdmsteppeauto-qgki_defconfig', 'vendor/sdmsteppeauto-qgki-debug_defconfig'][d.getVar('VARIANT', True) == ('' or 'debug')]}"
KERNEL_CMD_PARAMS = "console=ttyMSM0,115200n8 lpm_levels.sleep_disabled=1 msm_rtb.filter=0x237 service_locator.enable=1 rootfstype=ext4 rw firmware_class.path=/firmware/image/ pcie_ports=compat "
KERNEL_CMD_PARAMS:append = " fsck.repair=yes "
KERNEL_CMD_PARAMS:append = "${@bb.utils.contains_any('VARIANT', 'perf user', ' no_hotplug_area=0x80000000,0x60000000 dyn_memhotplug ', '', d)}"
KERNEL_CMD_PARAMS:append = "${@bb.utils.contains('DISTRO_FEATURES', 'early_init', ' early_userspace ', '', d)}"
KERNEL_CMD_PARAMS:remove = "${@bb.utils.contains_any('VARIANT', 'perf user', 'console=ttyMSM0,115200n8', '', d)}"
KERNEL_CMD_PARAMS:remove = "${@bb.utils.contains_any('VARIANT', 'perf user', 'earlycon=msm_geni_serial,0x880000', '', d)}"
KERNEL_CMD_PARAMS:remove = "${@bb.utils.contains_any('VARIANT', 'perf user', 'androidboot.console=ttyMSM0', '', d)}"
# Workaround for current serial driver
KERNEL_CMD_PARAMS:append = "${@bb.utils.contains('VARIANT', 'debug', ' quiet systemd.log_target=null ', '', d)}"
KERNEL_CMD_PARAMS:remove = "${@bb.utils.contains('IMAGE_FEATURES', 'read-only-rootfs', 'rw', '', d)}"
KERNEL_CMD_PARAMS:append = "${@bb.utils.contains('COMBINED_FEATURES', 'qti-lxc', ' androidboot.android_dt_dir=/skip/ ', '', d)}"
KERNEL_CMD_PARAMS:append = "${@bb.utils.contains('COMBINED_FEATURES', 'qti-lxc', ' androidboot.console=tty30 ', '', d)}"
KERNEL_CMD_PARAMS:append = "${@bb.utils.contains('COMBINED_FEATURES', 'qti-lxc', ' androidboot.selinux=permissive ', '', d)}"
KERNEL_IMAGETYPE = "Image"

# bootloader configuration
EXTRA_IMAGEDEPENDS += "edk2"

MACHINE_FEATURES += "\
    qti-audio \
    qti-bluetooth \
    qti-camera \
    qti-core \
    qti-data \
    qti-display \
    qti-extra \
    qti-graphics \
    qti-ml \
    qti-multimedia \
    qti-security \
    qti-tools \
    qti-vnw \
    qti-wlan \
    qti-location \
"

MACHINE_FEATURES += "dt-overlay"
MACHINE_FEATURES += "goldcore-boot"
```

## meta-qti-base/conf/machine/sa7255-ivi.conf
```bitbake
#@TYPE: Machine
#@NAME: sa7255-ivi
#@DESCRIPTION: Machine configuration for QTI sa7255-ivi

BASEMACHINE = "sa7255-ivi"
include conf/machine/include/sa7255.inc

DEFAULTTUNE = "aarch64"
include conf/machine/include/arm/arch-armv8a.inc

RECOVERY_IMAGE = "0"

EXTRA_IMAGEDEPENDS += "edk2"
CLANG_BIN="${SRC_DIR_ROOT}/prebuilts/clang/host/linux-x86/clang-r416183b/bin/"

PREFERRED_PROVIDER_virtual/kernel = "linux-qcom-custom-rt"
PREFERRED_PROVIDER_virtual/kernel-headers = "linux-kernel-qcom-headers"
PREFERRED_VERSION_linux-qcom-custom-rt = "6.6"
preferred-kernel = "PREFERRED_VERSION_linux-qcom-custom-rt"
kernel-version = "${PREFERRED_VERSION_linux-qcom-custom-rt}"

KERNEL_ARCH = "gen4auto"
KERNEL_IMAGE_HEADER_VERSION = "2"
KERNEL_BASE = "0x80000000"
KERNEL_TAGS_OFFSET = "0x1e00000"
KERNEL_CONFIG = "defconfig"
KERNEL_MACHINE_DTB = "arch/arm64/boot/dts/qcom/sa8775p-ride.dtb"

KERNEL_CMD_PARAMS = "rw rootwait console=ttyMSM0,115200,n8 no_console_suspend=1 androidboot.hardware=qcom androidboot.console=ttyMSM0 lpm_levels.sleep_disabled=1 msm_rtb.filter=0x237 earlycon=qcom_geni,0x99c000 qcom_geni_serial.con_enabled=1 fips=0 notests nokaslr ignore_loglevel firmware_class.path=/firmware/vm/boot systemd.gpt_auto=0 cgroup.memory=nokmem,nosocket rcupdate.rcu_expedited=1 rcu_nocbs=0-7 rcupdate.rcu_normal_after_boot=0 "
KERNEL_CMD_PARAMS:append = "${@bb.utils.contains('MACHINE_FEATURES', 'early-ramdisk-init', ' rdinit=/sbin/early-ramdisk-init early-ramdisk.mode=0 ', '', d)}"
KERNEL_CMD_PARAMS:remove = "${@bb.utils.contains_any('VARIANT', 'perf user', 'console=ttyMSM0,115200,n8', '', d)}"
KERNEL_CMD_PARAMS:remove = "${@bb.utils.contains_any('VARIANT', 'perf user', 'earlycon=qcom_geni,0x99c000 qcom_geni_serial.con_enabled=1', '', d)}"
KERNEL_CMD_PARAMS:remove = "${@bb.utils.contains('IMAGE_FEATURES', 'read-only-rootfs', 'rw', '', d)}"
KERNEL_CMD_PARAMS:append = "${@bb.utils.contains('IMAGE_FEATURES', 'read-only-rootfs', 'ro', '', d)}"

KERNEL_IMAGETYPE = "Image"

MACHINE_FEATURES:remove = "\
    qti-vmm \
    qti-gunyah \
    early-ramdisk-init \
    qti-umd \
    qti-display \
    qti-multimedia \
    qti-camera \
    qti-security \
    qti-audio-ar \
"
```

## meta-qti-base/conf/machine/sa7255.conf
```bitbake
#@TYPE: Machine
#@NAME: sa7255
#@DESCRIPTION: Machine configuration for QTI sa7255

BASEMACHINE = "sa7255"
include conf/machine/include/sa7255.inc

DEFAULTTUNE = "aarch64"
include conf/machine/include/arm/arch-armv8a.inc

RECOVERY_IMAGE = "0"

PREFERRED_PROVIDER_mkbootimg-native = "mkbootimg-gki-native"
PREFERRED_VERSION_mkbootimg-gki-native = "5.14"

EXTRA_IMAGEDEPENDS += "edk2"
CLANG_BIN="${SRC_DIR_ROOT}/prebuilts/clang/host/linux-x86/clang-r416183b/bin/"

KERNEL_IMAGE_HEADER_VERSION = "2"
KERNEL_BASE = "0x80000000"
KERNEL_TAGS_OFFSET = "0x1e00000"
KERNEL_CONFIG = "defconfig"

KERNEL_CMD_PARAMS = "rw rootwait console=ttyMSM0,115200,n8 no_console_suspend=1 androidboot.hardware=qcom androidboot.console=ttyMSM0 lpm_levels.sleep_disabled=1 msm_rtb.filter=0x237 earlycon=qcom_geni,0x99c000 qcom_geni_serial.con_enabled=1 fips=0 notests nokaslr ignore_loglevel firmware_class.path=/firmware/vm/boot systemd.gpt_auto=0 cgroup.memory=nokmem,nosocket"
KERNEL_CMD_PARAMS:append = "${@bb.utils.contains('MACHINE_FEATURES', 'early-ramdisk-init', ' rdinit=/sbin/early-ramdisk-init early-ramdisk.mode=0 ', '', d)}"
KERNEL_CMD_PARAMS:remove = "${@bb.utils.contains_any('VARIANT', 'perf user', 'console=ttyMSM0,115200,n8', '', d)}"
KERNEL_CMD_PARAMS:remove = "${@bb.utils.contains_any('VARIANT', 'perf user', 'earlycon=qcom_geni,0x99c000 qcom_geni_serial.con_enabled=1', '', d)}"
KERNEL_CMD_PARAMS:remove = "${@bb.utils.contains('IMAGE_FEATURES', 'read-only-rootfs', 'rw', '', d)}"
KERNEL_CMD_PARAMS:append = "${@bb.utils.contains('IMAGE_FEATURES', 'read-only-rootfs', 'ro', '', d)}"

KERNEL_IMAGETYPE = "Image.gz"

IMAGE_FEATURES:append = " read-only-rootfs"

OOT_DTBS = "\
    sa7255p-ride/sa7255p-ride.dtb \
    sa8620p-ride/sa8620p-ride.dtb \
"

MACHINE_FEATURES += "\
    qti-vmm \
    qti-gunyah \
    qti-core \
    qti-tools \
    early-ramdisk-init \
    qti-umd \
    qti-display \
    qti-multimedia \
    qti-camera \
"

SECTOOLS_VERSION = "sectools-v2"

EARLY_RAMDISK_KERNEL_MODULES = "\
    kernel-module-spmi-pmic-arb-${KERNEL_VERSION} \
    kernel-module-pinctrl-spmi-gpio-${KERNEL_VERSION} \
    kernel-module-pinctrl-spmi-mpp-${KERNEL_VERSION} \
    kernel-module-nvmem-qcom-spmi-sdam-${KERNEL_VERSION} \
    kernel-module-marvell-${KERNEL_VERSION} \
    kernel-module-camcc-sa8775p-${KERNEL_VERSION} \
    kernel-module-dispcc-sa7255p-${KERNEL_VERSION} \
    kernel-module-gpucc-sa8775p-${KERNEL_VERSION} \
    kernel-module-videocc-sa8775p-${KERNEL_VERSION} \
"
```

## meta-qti-base/conf/machine/sa81x5-rt.conf
```bitbake
#@TYPE: Machine
#@NAME: sa81x5-rt
#@DESCRIPTION: Machine configuration for QTI sa81x5 RT

BASEMACHINE = "sa81x5"
include conf/machine/include/auto-common.inc

#sa81x5 board chip belongs to cortexa76-cortexa55
include conf/machine/include/tune-cortexa76-cortexa55.inc

RECOVERY_IMAGE = "0"

KERNEL_BASE = "0x80200000"
KERNEL_TAGS_OFFSET = "0x07D00000"
PAGE_SIZE = "2048"
KERNEL_RAMDISK_OFFSET = "0x00B00000"

KERNEL_CONFIG = "${@['vendor/gen3auto-qgki_defconfig', 'vendor/gen3auto-qgki-debug_defconfig'][d.getVar('VARIANT', True) == ('' or 'debug')]}"
KERNEL_CMD_PARAMS = "root=/dev/ram0 rw rootwait console=ttyMSM0,115200,n8 no_console_suspend=1 androidboot.hardware=qcom androidboot.console=ttyMSM0  lpm_levels.sleep_disabled=1 msm_rtb.filter=0x237 earlycon=qcom_geni,0xa90000 fips=0 notests nokaslr ignore_loglevel"

KERNEL_IMAGETYPE = "Image"

# bootloader configuration
EXTRA_IMAGEDEPENDS += "edk2"

IMAGE_FEATURES:append = " read-only-rootfs"

MACHINE_SUPPORTS_INIT_RAMDISK = "True"

MACHINE_FEATURES += "\ 
    qti-core \
    qti-audio \
    qti-bluetooth \
    qti-data \
    qti-display \
    qti-extra \
    qti-ml \
    qti-multimedia \
    qti-camera \
    qti-graphics \
    qti-security \
    qti-vnw \
    qti-wlan \
    qti-tools \
    qti-location \
"
```
