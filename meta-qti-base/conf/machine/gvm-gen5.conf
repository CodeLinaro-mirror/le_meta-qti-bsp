## meta-qti-base/conf/machine/gvm-gen5.conf
```bitbake
#@TYPE: Machine
#@NAME: gvm-gen5
#@DESCRIPTION: Machine configuration for QTI SH GVM NORD(GEN5) Platform

BASEMACHINE ?= "gvm-gen5"
include conf/machine/include/auto-common.inc

#MASK unused recipe in target
include conf/machine/include/gvm-bbmask.inc
include conf/distro/include/gvm-bbmask-prop.inc

include conf/machine/include/tune-cortexa78c.inc

EXTRA_IMAGEDEPENDS += "edk2"
BBMASK += "meta-qti-bsp/meta-qti-base/recipes-kernel/edk2/edk2_git.bb"
BBMASK += "meta-qti-bsp/meta-qti-base/recipes-kernel/edk2/edk2_5.0.bb"

PREFERRED_PROVIDER_dtc-native = "dtc-aosp-native"

PREFERRED_VERSION_linux-msm = "6.12"
PREFERRED_VERSION_linux-msm-headers = "6.12"
PREFERRED_VERSION_adsprpc = "2.0"
PREFERRED_VERSION_media-codec2 = "auto.1.0"
PREFERRED_VERSION_media-external = "auto.1.0"
PREFERRED_VERSION_media-noship = "auto.1.0"
#PREFERRED_VERSION_codec2-service = "auto.1.0"

# gvm prefer camx
PREFERRED_VERSION_cameradlkm = "0.2"

KERNEL_ARCH = "autogvm"
KERNEL_VARIANT = "${@bb.utils.contains_any('VARIANT', 'perf user', 'perf_', 'debug_', d)}"
KERNEL_BUILD_CONFIG = "soc-repo/build.config.msm.${KERNEL_ARCH}.lv"
KERNEL_IMAGE_HEADER_VERSION = "2"

KERNEL_BASE = "0x80000000"
KERNEL_TAGS_OFFSET = "0x1e00000"
KERNEL_CONFIG = "${@['vendor/autogvm_defconfig', 'vendor/autogvm-debug_defconfig'][d.getVar('VARIANT', True) == ('' or 'debug')]}"
KERNEL_CMD_PARAMS = " "
KERNEL_IMAGETYPE = "Image"

MACHINE_FEATURES += "\
    qti-core \
    qti-hypervisor \
    qti-gvm \
    dt-overlay \
"

SECTOOLS_VERSION = "sectools-v2"
SECTOOLS_SECURITY_PROFILE = "lemans_tz_security_profile.xml"
```

## meta-qti-base/conf/machine/include/auto-common.inc
```bitbake
include conf/machine/include/basemachine.inc

SOC_FAMILY ?= "sa-common"
include conf/machine/include/soc-family.inc

PREFERRED_PROVIDER_virtual/kernel = "linux-msm"
PREFERRED_VERSION_linux-msm = "5.4"

# Prefer gbm
PREFERRED_PROVIDER_virtual/libgbm = "gbm"

# Prefer adreno
PREFERRED_PROVIDER_virtual/wayland-egl  = "adreno"
PREFERRED_PROVIDER_virtual/egl          = "adreno"
PREFERRED_PROVIDER_virtual/libgles1     = "adreno"
PREFERRED_PROVIDER_virtual/libgles2     = "adreno"

# Prefer GStreamer 1.18.5 by default
PREFERRED_VERSION_gstreamer1.0              ?= "1.18.5"
PREFERRED_VERSION_gstreamer1.0-plugins-bad  ?= "1.18.5"
PREFERRED_VERSION_gstreamer1.0-plugins-base ?= "1.18.5"
PREFERRED_VERSION_gstreamer1.0-plugins-good ?= "1.18.5"
PREFERRED_VERSION_gstreamer1.0-plugins-ugly ?= "1.18.5"
PREFERRED_VERSION_gstreamer1.0-libav        ?= "1.18.5"
PREFERRED_VERSION_gstreamer1.0-omx          ?= "1.18.5"

# mesa provides these packags and others like virtual/libgl.
# This is to enable mesa, adreno and gbm work together, and pass
# yocot-check-layer script check.
MULTI_PROVIDER_WHITELIST += "virtual/wayland-egl virtual/egl virtual/libgles1 virtual/libgles2 virtual/libgbm"
BB_MULTI_PROVIDER_ALLOWED += "virtual/wayland-egl virtual/egl virtual/libgles1 virtual/libgles2 virtual/libgbm"

SERIAL_CONSOLE ?= "${@['', '115200 ttyMSM0'][d.getVar('VARIANT', True) == ('' or 'debug')]}"
SERIAL_CONSOLES = "115200;ttyMSM0"

IMAGE_FSTYPES ?= "ext4"
PAGE_SIZE ?= '4096'
IMAGE_ROOTFS_ALIGNMENT = "4096"
EXTRA_IMAGECMD:ext4 += " -b 4096 "

IMAGE_CLASSES += "qimage"
```
