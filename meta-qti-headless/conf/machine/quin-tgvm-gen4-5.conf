## meta-qti-headless/conf/machine/quin-tgvm-gen4-5.conf
```bitbake
#@TYPE: Machine
#@NAME: quin-tgvm-gen4-5
#@DESCRIPTION: Machine configuration for QTI QUIN

# Default Image names
BOOTIMAGE_TARGET ?= "${PRODUCT}-boot.img"
PERSISTIMAGE_TARGET ?= "${PRODUCT}-persist.ext4"
USERDATAIMAGE_TARGET ?= "${PRODUCT}-usrfs.ext4"
VBMETAIMAGE_TARGET ?= "${PRODUCT}-vbmeta.img"

BASEMACHINE ?= "quin-tgvm-gen4-5"

# Flag to Enable QPermissions
QPERMISSIONS_ENABLE ?= "0"

include conf/machine/include/tune-cortexa78c.inc

PREFERRED_PROVIDER_virtual/kernel = "linux-msm"
PREFERRED_PROVIDER_virtual/kernel-headers = "linux-msm-headers"
PREFERRED_PROVIDER_dtc-native = "dtc-aosp-native"
preferred-kernel = "PREFERRED_VERSION_linux-msm"
PREFERRED_VERSION_linux-msm = "6.12"
PREFERRED_VERSION_linux-msm-headers = "6.12"

TUNE_CCARGS:remove:toolchain-clang = "-mbranch-protection=standard"

KERNEL_ARCH = "autogvm"
KERNEL_VARIANT = "${@bb.utils.contains_any('VARIANT', 'perf user', 'perf_', 'debug_', d)}"
KERNEL_DEFCONFIG_VARIANT = "${@bb.utils.contains_any('VARIANT', 'perf user', 'defconfig', 'debug-defconfig', d)}"
KERNEL_OUT_VARIANT = "${@bb.utils.contains_any('VARIANT', 'perf user', '', 'debug_', d)}"
KERNEL_BUILD_CONFIG = "soc-repo/build.config.msm.${KERNEL_ARCH}.lv"
KERNEL_IMAGE_HEADER_VERSION = "2"

KERNEL_BASE = "0x80000000"
KERNEL_TAGS_OFFSET = "0x1e00000"
KERNEL_CONFIG = "${@['vendor/autogvm-qgki_defconfig', 'vendor/autogvm-qgki-debug_defconfig'][d.getVar('VARIANT', True) == ('' or 'debug')]}"
KERNEL_CMD_PARAMS = " "
KERNEL_IMAGETYPE = "Image"

KERNEL_CMD_PARAMS:append = "${@bb.utils.contains('MACHINE_FEATURES', 'early-ramdisk-init', ' rdinit=/sbin/early-ramdisk-init early-ramdisk.mode=3 ', '', d)}"
KERNEL_CMD_PARAMS:append = " ro "

EARLY_RAMDISK_KERNEL_MODULES = "\
    kernel-module-virtio-mmio-${KERNEL_VERSION} \
    kernel-module-failover-${KERNEL_VERSION} \
    kernel-module-net-failover-${KERNEL_VERSION} \
    kernel-module-virtio-net-${KERNEL_VERSION} \
    kernel-module-msm-hab-${KERNEL_VERSION} \
    kernel-module-crypto-qti-virt-${KERNEL_VERSION} \
    kernel-module-virtio-block-${KERNEL_VERSION} \
    kernel-module-virtio-blk-qti-crypto-${KERNEL_VERSION} \
    kernel-module-gh-dbl-${KERNEL_VERSION} \
    kernel-module-gh-msgq-${KERNEL_VERSION} \
    kernel-module-gh-arm-drv-${KERNEL_VERSION} \
    kernel-module-gh-rm-drv-${KERNEL_VERSION} \
    kernel-module-socinfo-dt-${KERNEL_VERSION} \
    kernel-module-boot-marker-${KERNEL_VERSION} \
"

USERDATA_SIZE_EXT4 = "1000000000"

SOC_FAMILY ?= "sa-common"
include conf/machine/include/soc-family.inc

# Enables timestamping functionality during building the kernel
KERNEL_DEBUG_TIMESTAMPS = "1"

SERIAL_CONSOLES = "115200;ttyMSM0"

IMAGE_FSTYPES ?= "ext4"
PAGE_SIZE ?= '4096'
IMAGE_ROOTFS_ALIGNMENT = "4096"
EXTRA_IMAGECMD:ext4 += " -b 4096 "

IMAGE_CLASSES += "qimage"

EXTRA_IMAGEDEPENDS += "qti-image-boot:do_sign_boot_img"

MACHINE_FEATURES += "\
    qti-hypervisor \
    early-ramdisk-init \
"
```

## meta-qti-headless/conf/machine/quin-tgvm-gen4.conf
```bitbake
#@TYPE: Machine
#@NAME: quin-tgvm-gen4
#@DESCRIPTION: Machine configuration for QTI QUIN

# Default Image names
BOOTIMAGE_TARGET ?= "${PRODUCT}-boot.img"
PERSISTIMAGE_TARGET ?= "${PRODUCT}-persist.ext4"
USERDATAIMAGE_TARGET ?= "${PRODUCT}-usrfs.ext4"
VBMETAIMAGE_TARGET ?= "${PRODUCT}-vbmeta.img"

# Flag to Enable QPermissions
QPERMISSIONS_ENABLE ?= "0"

include conf/machine/include/tune-cortexa78c.inc

PREFERRED_PROVIDER_mkbootimg-native = "mkbootimg-gki-native"
PREFERRED_PROVIDER_dtc-native = "dtc-gki-native"

PREFERRED_VERSION_linux-msm = "5.15"
PREFERRED_VERSION_linux-msm-headers = "5.15"

KERNEL_ARCH = "autogvm"
KERNEL_VARIANT = "${@bb.utils.contains_any('VARIANT', 'perf user', 'perf_', 'debug_', d)}"
KERNEL_BUILD_CONFIG = "msm-kernel/build.config.msm.${KERNEL_ARCH}.lxc"
KERNEL_IMAGE_HEADER_VERSION = "2"

KERNEL_BASE = "0x80000000"
KERNEL_TAGS_OFFSET = "0x1e00000"
KERNEL_CONFIG = "${@['vendor/autogvm-qgki_defconfig', 'vendor/autogvm-qgki-debug_defconfig'][d.getVar('VARIANT', True) == ('' or 'debug')]}"
KERNEL_CMD_PARAMS = " "
KERNEL_IMAGETYPE = "Image"

USERDATA_SIZE_EXT4 = "1000000000"

SOC_FAMILY ?= "sa-common"
include conf/machine/include/soc-family.inc

PREFERRED_PROVIDER_virtual/kernel = "linux-msm"

# Enables timestamping functionality during building the kernel
KERNEL_DEBUG_TIMESTAMPS = "1"

SERIAL_CONSOLES = "115200;ttyMSM0"

IMAGE_FSTYPES ?= "ext4"
PAGE_SIZE ?= '4096'
IMAGE_ROOTFS_ALIGNMENT = "4096"
EXTRA_IMAGECMD:ext4 += " -b 4096 "

IMAGE_CLASSES += "qimage"

IMAGE_CLASSES += "${@oe.utils.version_less_or_equal('PREFERRED_VERSION_linux-msm', '5.14', '', 'qimage-boot', d)}"

MACHINE_FEATURES += "\
    qti-hypervisor \
"
```

## meta-qti-lxc/conf/distro/auto-lxc.conf
```bitbake
require ${QTI_METAPATH_BASE}/conf/distro/auto.conf

DISTRO_FEATURES_append = " qti-bluetooth qti-wlan qti-lxc"

PRODUCT = "${BASEMACHINE}lxc"
```

## meta-qti-lxc/conf/layer.conf
```bitbake
BBFILES += "${LAYERDIR}/recipes/*/*.bb ${LAYERDIR}/recipes/*/*.bbappend ${LAYERDIR}/recipes-*/*/*.bb ${LAYERDIR}/recipes-*/*/*.bbappend"
BBPATH .= ":${LAYERDIR}"
BBFILE_COLLECTIONS += "qti-lxc"
BBFILE_PRIORITY_qti-lxc = "11"
BBFILE_PATTERN_qti-lxc := "^${LAYERDIR}/"
QTI_METAPATH_LXC := '${@os.path.normpath("${LAYERDIR}/")}'
```
