## conf/machine/mdm9650-4k.conf
```bitbake
#@TYPE: Machine
#@NAME: MDM9650
#@DESCRIPTION: Machine configuration for QTI MDM9650-4K

require conf/machine/include/mdm9650.inc

# Sizes for UBI volumes
SYSTEM_VOLUME_SIZE ?= "120MiB"
CACHE_VOLUME_SIZE ?= "15MiB"
SYSTEMRW_VOLUME_SIZE ?= "6MiB"
PERSIST_VOLUME_SIZE ?= "6MiB"

PAGE_SIZE = '4096'
UBINIZE_ARGS = "-m 4096 -p 256KiB -s 4096"
MKUBIFS_ARGS = "-m 4096 -e 253952 -c 2146 -F"
MKUBIFS_USERFS_ARGS = "-m 4096 -e 253952 -c 2146 -F"
```

## conf/machine/mdm9650.conf
```bitbake
#@TYPE: Machine
#@NAME: MDM9650
#@DESCRIPTION: Machine configuration for QTI MDM9650

require conf/machine/include/mdm9650.inc

# Sizes for UBI volumes
SYSTEM_VOLUME_SIZE ?= "120MiB"
CACHE_VOLUME_SIZE ?= "15MiB"
SYSTEMRW_VOLUME_SIZE ?= "6MiB"
PERSIST_VOLUME_SIZE ?= "6MiB"

PAGE_SIZE = '2048'
UBINIZE_ARGS = "-m 2048 -p 128KiB -s 2048"
MKUBIFS_ARGS = "-m 2048 -e 126976 -c 2047 -F"
MKUBIFS_USERFS_ARGS = "-m 2048 -e 126976 -c 2047 -F"
```

## conf/machine/nf-32.conf
```bitbake
#@TYPE: Machine
#@DESCRIPTION: Machine configuration for QTI nf-32
require conf/machine/include/qcs40x.inc
# TARGET TO SUPPORT 32-bit kernel
DISTRO = "qsap"

#boot image
BOOTIMAGE_TARGET = "boot.img"

#EXT4 FILES NAME
CACHEIMAGE_TARGET    = "cache.img"
PERSISTIMAGE_TARGET  = "persist.img"
RECOVERYIMAGE_TARGET = "recoveryfs.img"
SYSTEMIMAGE_TARGET   = "system.img"
SYSTEMRWIMAGE_TARGET = "systemrw.img"
USERDATAIMAGE_TARGET = "usrdata.img"
KERNEL_IMAGETYPE   = "zImage"
KERNEL_DTB_NAMES    = "qcs403-iot-sku1.dtb \
                       qcs403-iot-sku2.dtb \
                       qcs403-iot-sku3.dtb \
                       qcs403-iot-sku5.dtb \
                       qcs401-iot-sku5.dtb \
                       qcs404-iot-sku2.dtb \
                       qcs404-iot-sku3.dtb \
                       qcs404-iot-sku5.dtb \
                       qcs404-iot-sku6.dtb "

#defconfig to be used for nf-32
KERNEL_CONFIG = "${@['vendor/qcs403-perf_defconfig', 'vendor/qcs403_defconfig'][d.getVar('VARIANT', True) == ('' or 'debug')]}"

# Sizes for EXT4 (in bytes)
SYSTEM_SIZE_EXT4 ?= "681574400"
SYSTEMRW_SIZE_EXT4 ?= "8388608"
USERDATA_SIZE_EXT4 ?= "5014746624"
CACHE_SIZE_EXT4 ?= "80000000"

#Enable verity feature
DISTRO_FEATURES += "dm-verity"

MACHINE_MNT_POINTS = "/firmware /persist /cache /dsp /bt_firmware"

# Set ab-boot-support feature for native tools as well,
# as some native tools have workflow chnages for AB builds.
DISTRO_FEATURES += "ab-boot-support"
DISTRO_FEATURES_NATIVE_append = " ab-boot-support "

# Formats of root filesystem images.
IMAGE_FSTYPES += "ext4"
#Disable ssd listener
DISTRO_FEATURES_append = " no-ssd-listener-support"
#Disable rpmb listener
DISTRO_FEATURES_append = " no-rpmb-listener-support"
# enable audio as a loadable kernel module
DISTRO_FEATURES_append = " audio-dlkm"
DISTRO_FEATURES_append = " persist-volume"
DEFAULTTUNE = "armv7ahf-neon"

#Need for compiling UEFI for aarch64
require conf/multilib.conf
MULTILIBS = "multilib:lib64"
DEFAULTTUNE_virtclass-multilib-lib64 = "aarch64"

#Config to be used for persist.ext4
PERSISTFS_CONFIG = "-C ${WORKDIR}/persist_fsconfig.conf"
MAKEEXT4_MOUNT_OPT = "-a /"

#no-test-bundle ensures reduced size package installation.
#qti-audiopd ensures audiopd is supported by adsp"
DISTRO_FEATURES_append = " no-test-bundle qti-audiopd "

#qti-cdsp ensures cdsp subsystem is supported.
#wlan ensures wlan functionality is supported.
#wlan-1x1 ensures wlan chip is 1x1, enable it only if wlan is enabled
MACHINE_FEATURES_append = " qti-cdsp wlan wlan-1x1 "

#wlan-perf build wlan driver with perf config
DISTRO_FEATURES_append  = " ${@bb.utils.contains("MACHINE_FEATURES", "wlan", "wlan-perf", "", d)} "

PREFERRED_PROVIDER_virtual/libgles1 = "adreno"
PREFERRED_PROVIDER_virtual/libgles2 = "adreno"
PREFERRED_PROVIDER_virtual/egl      = "adreno"
PREFERRED_VERSION_libdrm = "2.4.83"

# Enable coedump
SYSTEMD_ENABLE_COREDUMP = "1"
SYSTEMD_COREDUMP_PATH = "/var/tmp"
```
