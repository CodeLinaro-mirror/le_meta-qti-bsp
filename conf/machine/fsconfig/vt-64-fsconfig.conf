## conf/machine/include/auto-common.inc
```bitbake
require conf/distro/include/security_flags.inc
require conf/machine/include/basemachine.inc

# For new yocto UNINATIVE_CHECKSUM
UNINATIVE_CHECKSUM[x86_64] = "26d46c61ad88cc245e31c88549717c0092a838d111b93ec169d88b08cc027581"

SOC_FAMILY ?= "msm8996"
include conf/machine/include/soc-family.inc

# Use non-perf settings for the perf build.
BASEMACHINE = "${@d.getVar('MACHINE', True).replace('-perf', '')}"
MACHINEGROUP = "auto"

TMPDIR = "${TOPDIR}/tmp-glibc"

require conf/machine/include/arm/arch-armv8.inc

SERIAL_CONSOLE ?= "115200 ttyHSL0"

DISTRO_FEATURES_BACKFILL_remove = "gobject-introspection-data"
DISTRO_FEATURES_BACKFILL_CONSIDERED_remove = "gobject-introspection-data"
DISTRO_FEATURES_append = " emmc-boot "
DISTRO_FEATURES_append = " persist-image "

PAGE_SIZE ?= '4096'

# Max supported inodes
#EXTRA_IMAGECMD ?= "-N 2048"

# Sizes for EXT4 (in bytes)
#SYSTEM_SIZE_EXT4 ?= "3000000000"
USERDATA_SIZE_EXT4 ?= "5000000000"
CACHE_SIZE_EXT4 ?= "65536000"

KERNEL_DEFCONFIG = "msm-auto_defconfig"
KERNEL_PERF_DEFCONFIG = "msm-auto-perf_defconfig"

# Sizes for EXT4 (in bytes)
USERDATA_SIZE_EXT4 = "2000000000"
CACHE_SIZE_EXT4 = "80000000"

#
# Multilib configuration
#
# This sets any packages preprended with lib32- to be built with
# the armv7a tuning (32 bit) instead of 64 bit aarch.
require conf/multilib.conf
MULTILIBS = "multilib:lib32"
DEFAULTTUNE_virtclass-multilib-lib32 = "armv7a"

EXTRA_IMAGE_FEATURES = "debug-tweaks"

#Krogoth default GCC version
GCCVERSION = "5.3.0"

IMAGE_FSTYPES += "tar.bz2 ext4"

# Graphics driver essentials
PREFERRED_PROVIDER_virtual/wayland-egl  = "adreno"
PREFERRED_PROVIDER_virtual/egl          = "adreno"
PREFERRED_PROVIDER_virtual/libgles1     = "adreno"
PREFERRED_PROVIDER_virtual/libgles2     = "adreno"

PREFERRED_VERSION_weston = "1.9.0"
PREFERRED_VERSION_wayland = "1.9.0"
PREFERRED_VERSION_wayland-native = "1.9.0"
PREFERRED_VERSION_wayland-ivi-extension = "1.9.1"
PREFERRED_VERSION_libdrm = "2.4.62"
PREFERRED_VERSION_gtest = "1.7.0"

# Prefer GStreamer 1.8.x by default
PREFERRED_VERSION_gstreamer1.0              ?= "1.8.%"
PREFERRED_VERSION_gstreamer1.0-plugins-bad  ?= "1.8.%"
PREFERRED_VERSION_gstreamer1.0-plugins-base ?= "1.8.%"
PREFERRED_VERSION_gstreamer1.0-plugins-good ?= "1.8.%"
PREFERRED_VERSION_gstreamer1.0-plugins-ugly ?= "1.8.%"
PREFERRED_VERSION_gstreamer1.0-libav        ?= "1.8.%"
PREFERRED_VERSION_gstreamer1.0-omx          ?= "1.2.%"

LICENSE_FLAGS_WHITELIST = "commercial_gstreamer1.0-libav commercial_gstreamer1.0-omx"
LICENSE_FLAGS_WHITELIST += "commercial_gstreamer1.0-plugins-ugly commercial_opencore-amr"
LICENSE_FLAGS_WHITELIST += "commercial_libomxil"

# Smack
OVERRIDES .= ":smack"
DISTRO_FEATURES_append = " smack"

BB_SIGNATURE_HANDLER = "OEBasicHash"
BB_HASHBASE_WHITELIST = "TMPDIR FILE PATH PWD BB_TASKHASH BBPATH DL_DIR \
    SSTATE_DIR THISDIR FILESEXTRAPATHS FILE_DIRNAME HOME LOGNAME SHELL TERM \
    USER FILESPATH STAGING_DIR_HOST STAGING_DIR_TARGET COREBASE PRSERV_HOST \
    PRSERV_DUMPDIR PRSERV_DUMPFILE PRSERV_LOCKDOWN PARALLEL_MAKE \
    CCACHE_DIR EXTERNAL_TOOLCHAIN CCACHE CCACHE_DISABLE LICENSE_PATH SDKPKGSUFFIX \
    WARN_QA ERROR_QA WORKDIR STAMPCLEAN PKGDATA_DIR BUILD_ARCH SSTATE_PKGARCH \
    BB_WORKERCONTEXT"
```

## conf/machine/include/basemachine.inc
```bitbake
BASEMACHINE ??= ""

# Add BASEMACHINE to machine overrides
MACHINEOVERRIDES =. "${@['', '${BASEMACHINE}:']['${BASEMACHINE}' != '']}"

# Define BASEMACHINE_ARCH
BASEMACHINE_ARCH = "${@['${MACHINE_ARCH}', '${BASEMACHINE}']['${BASEMACHINE}' != '']}"

# Add BASEMACHINE_ARCH to PACKAGE_ARCHS. 
# This variable is originally set in bitbake.conf
PACKAGE_ARCHS .= "${@['', ' ${BASEMACHINE_ARCH}']['${BASEMACHINE_ARCH}' != '${MACHINE_ARCH}']}"
PACKAGE_ARCHS[vardepsexclude] += "BASEMACHINE_ARCH"

# Default Image names
BOOTIMAGE_TARGET ?= "${MACHINE}-boot.img"
CACHEIMAGE_TARGET ?= "${MACHINE}-cache.ext4"
PERSISTIMAGE_TARGET ?= "${MACHINE}-persist.ext4"
RECOVERYIMAGE_TARGET ?= "${MACHINE}-recovery.ext4"
SYSTEMIMAGE_TARGET ?= "${MACHINE}-sysfs.ext4"
SYSTEMRWIMAGE_TARGET ?= "${MACHINE}-systemrw.ext4"
USERDATAIMAGE_TARGET ?= "${MACHINE}-usrfs.ext4"
```

## conf/machine/include/mdm9607-openssl.inc
```bitbake
PREFERRED_VERSION_openssl_forcevariable = "3.0.12"
PREFERRED_VERSION_openssl-native_forcevariable = "3.0.12"
PREFERRED_VERSION_nativesdk-openssl_forcevariable = "3.0.12"

IMAGE_INSTALL += "openssl-bin"
```

## conf/machine/include/qcs610.inc
```bitbake
BASEMACHINE ?= "sdmsteppe"
require conf/machine/include/basemachine.inc

SOC_FAMILY ?= "qcs610"
include conf/machine/include/soc-family.inc

include conf/machine/include/arm/arch-armv8a.inc

require recipes-kernel/linux-msm/msm-common.inc

MSM_KERNEL_VERSION = "6.6"

PREFERRED_PROVIDER_gtest = "googletest"
PREFERRED_VERSION_synx-kernel ?= "1.0"

# Max supported inodes
EXTRA_IMAGECMD ?= "-N 2048"

MACHINE_MNT_POINTS = "/firmware \
                      /overlay \
                      /dsp \
                      /bt_firmware \
                      /persist \
                     "

# Sizes for EXT4 (in bytes)
SYSTEM_SIZE_EXT4  ?= "1073741824"
USERDATA_SIZE ?= "8589934592"

# Formats of root filesystem images.
IMAGE_FSTYPES += "ext4 squashfs"

# On msm-5.4 or above ufs driver supports BSG Device.
UFS_BSG_DEV_USAGE = "True"

# On msm-5.4 abl supports DMMOD.
DM_MOD_FOR_KERNEL = "1"

# Disable some default features supported from upstream
MACHINE_FEATURES_BACKFILL_CONSIDERED += "qemu-usermode rtc"
```

## conf/machine/include/sa515m.inc
```bitbake
# Sizes for UBI volumes
SYSTEM_VOLUME_SIZE_qti-distro-tele-debug = "138MiB"
SYSTEM_VOLUME_SIZE_qti-distro-tele-perf = "125MiB"

MACHINE_FEATURES:remove = "qti-wlan qti-bluetooth"
```

## conf/machine/include/sa525m-apq.inc
```bitbake
MACHINE_FEATURES_append = " qti-eap"
MACHINE_FEATURES_remove += "qti-wwan-plus-cv2x qti-cv2x-compensator"
```

## conf/machine/kalama-robotics-vm.conf
```bitbake
#@TYPE: Machine
#@NAME: TRUSTEDVM-V3
#@DESCRIPTION: Machine configuration for QTI MTP with TRUSTEDVM

BASEMACHINE = "kalama-robotics-vm"
require conf/machine/include/basemachine.inc

DEFAULTTUNE = "aarch64"
include conf/machine/include/arm/arch-armv8a.inc

PREFERRED_PROVIDER_virtual/mkbootimg = "mkbootimg-gki"
PREFERRED_PROVIDER_virtual/mkdtimg   = "mkdtimg-gki"
PREFERRED_PROVIDER_virtual/kernel   = "linux-msm"
#PREFERRED_PROVIDER_virtual/dtc-native = "dtc-android-build-native"
PREFERRED_VERSION_linux-msm = "5.15"
PREFERRED_VERSION_linux-msm-headers ?= "${PREFERRED_VERSION_linux-msm}"
PREFERRED_VERSION_kernel-toolchain ?= "${PREFERRED_VERSION_linux-msm}"
PREFERRED_VERSION_kernel-toolchain-native = "${PREFERRED_VERSION_linux-msm}"
PREFERRED_VERSION_dtc-android-build ?= "${PREFERRED_VERSION_linux-msm}"
PREFERRED_VERSION_mkbootimg-gki ?= "${PREFERRED_VERSION_linux-msm}"
PREFERRED_VERSION_mod-signing-keys ?= "${PREFERRED_VERSION_linux-msm}"
PREFERRED_VERSION_coreutils ?= "6.9"
PREFERRED_PROVIDER_virtual/refpolicy = "refpolicy-mls-vm"
PREFERRED_VERSION_gtest = "gtest"

PAGE_SIZE ?= '4096'

EXTRA_IMAGECMD ?= "-N 2048"

KERNEL_IMAGETYPE = "Image"
KERNEL_CMD_PARAMS = ""
KERNEL_BASE = "0x80000000"

KERNEL_VARIANT = ""
KERNEL_VARIANT:qti-distro-base-debug = "debug"
SERIAL_CONSOLE = "115200 hvc0"

VM_TARGET = "kalamale"
SUPPORTED_VM_VARIANTS = "kailua"
MACHINE_USES_KERNEL_PREBUILTS = "True"
KERNEL_PLATFORM_PATH ?= "${WORKSPACE}/kernel-${PREFERRED_VERSION_linux-msm}/kernel_platform/"
KERNEL_PREBUILT_PATH ?= "${WORKSPACE}/kernel-${PREFERRED_VERSION_linux-msm}/out/msm-kernel-${VM_TARGET}-roboticsvm-${KERNEL_VARIANT}/"
KERNEL_PREBUILT_DISTDIR ?= "${WORKSPACE}/kernel-${PREFERRED_VERSION_linux-msm}/out/msm-kernel-${VM_TARGET}-roboticsvm-${KERNEL_VARIANT}/dist"

#### KERNEL ####
KERNEL_VARIANT:qti-distro-debug ?= "debug"
KERNEL_VARIANT:qti-distro-perf ?= ""
# Check for msm-kernel or gki_kernel
KERNEL_TYPE = "msm-kernel"


#KERNEL_DEFCONFIG = "msm-kernel-kalamale_roboticsvm1-${KERNEL_VARIANT}"
KERNEL_OUT_PATH = "${KERNEL_PREBUILT_PATH}"
KERNEL_CONFIG  ?= "build.config.msm.kalamale.roboticsvm"
KERNEL_BUILD_CONFIG = "msm-kernel/${KERNEL_CONFIG}"
ENABLE_DDK_BUILD="true"

#### dtb ####
KERNEL_DTB_NAMES = "kalamale_roboticsvm1-dvt.dtb kalamale_roboticsvm2-dvt.dtb"

# filesystem configurations to be applied on image.
MACHINE_FSCONFIG_CONF = "trustedvm-fsconfig.conf"
MACHINE_SUPPORTS_USB = "False"
MACHINE_SUPPORTS_ANDROID_PROPERTIES = "False"
MACHINE_SUPPORTS_OEMVM = "True"
MACHINE_SUPPORTS_PDMAPPER = "False"

MACHINE_MNT_POINTS = " "
ENABLE_ADB = "False"
# Formats of root filesystem images.
IMAGE_FSTYPES += "ext4"
IMAGE_INIT_MANAGER = "systemd"

VALG = 'False'

SYSTEMIMAGE_TARGET = "system.img"
VMUSERDATAIMAGE_TARGET = "vm-userdata.img"
VMIMAGE_TARGET = "vm-bootsys.img"
VMPERSIST_TARGET = "vm-persist.img"
DTB_TARGET = "vm.dtb"
KERNEL_OFFSET_TRUSTEDVM = "0x0"
DTB_OFFSET_TRUSTEDVM = "0x2000000"
RAMDISK_OFFSET_TRUSTEDVM = "0x2100000"
CMDLINE_OFFSET_TRUSTEDVM = "0x2100000"

KERNEL_OFFSET_OEMVM = "0x0"
DTB_OFFSET_OEMVM = "0x2000000"
RAMDISK_OFFSET_OEMVM = "0x2100000"
CMDLINE_OFFSET_OEMVM = "0x2100000"

# Ramdisk size is 8 MB
RAMDISK_SIZE = "10388608"

SYSTEM_SIZE_EXT4 ?= "235000000"
USERDATA_SIZE_EXT4 ?= "25000000"
PERSIST_IMAGE_ROOTFS_SIZE = "119000000"
PERSIST_SIZE_EXT4 = "119000000"
VM_PERSIST_SIZE_EXT4 ?= "125829120"
VM_SIZE_EXT4 ?= "560000000"

MACHINE_FEATURES:append = " dm-verity-none qti-multivm qti-vm qti-vm-persist qti-vm-split "

PREFERRED_PROVIDER_virtual/base-utils = "toybox"
VIRTUAL-RUNTIME_base-utils = "toybox"
#VIRTUAL-RUNTIME_base-utils-hwclock = ""
#VIRTUAL-RUNTIME_base-utils-syslog = ""
#VIRTUAL-RUNTIME_login_manager = ""
INIT_MANAGER = "systemd"
TOYBOX_RAMDISK = "True"

# On msm-5.4 or above ufs driver supports BSG Device.
UFS_BSG_DEV_USAGE = "True"

MACHINE_FEATURES += " gh-loader "
```

## conf/machine/mdm9150-cv2x.conf
```bitbake
#@TYPE: Machine
#@NAME: MDM9150-CV2X
#@DESCRIPTION: Machine configuration for MDM9150 CV2X

require ${COREBASE}/meta-qti-bsp/conf/machine/mdm9650.conf

# Change UBI commands for 2K NAND
PAGE_SIZE = '2048'
UBINIZE_ARGS = "-m 2048 -p 128KiB -s 2048"
MKUBIFS_ARGS = "-m 2048 -e 126976 -c 2047 -F"

MACHINE_FEATURES += "cv2x"
MACHINEOVERRIDES =. "cv2x:"

PREFERRED_VERSION_iproute2 = "4.4.0"

BBMASK .= "|meta-qti-audio|meta-qti-bt|meta-qti-wlan"
```

## conf/machine/mdm9607.conf
```bitbake
#@TYPE: Machine
#@NAME: MDM9607
#@DESCRIPTION: Machine configuration for QTI MDM9607

BASEMACHINE ?= "mdm9607"
require conf/machine/include/basemachine.inc

SOC_FAMILY ?= "mdm9x07"
include conf/machine/include/soc-family.inc

#32 bit
DEFAULTTUNE ?= "armv7athf-neon"
include conf/machine/include/arm/arch-armv7a.inc


PREFERRED_PROVIDER_virtual/mkbootimg = "mkbootimg"
PREFERRED_PROVIDER_virtual/mkbootimg-native = "mkbootimg-native"
PREFERRED_PROVIDER_virtual/kernel = "linux-msm"
PREFERRED_VERSION_linux-msm ?= "6.1"
PREFERRED_VERSION_linux-msm-headers ?= "6.1"
PREFERRED_VERSION_kernel-toolchain ?= "6.1"
PREFERRED_VERSION_dtc-android-build ?= "6.1"
PREFERRED_VERSION_kernel-toolchain-native = "6.1.32bit"

#### KERNEL ####
MACHINE_USES_KERNEL_PREBUILTS = "True"
KERNEL_VARIANT:qti-distro-debug ?= "-debug_defconfig"
#KERNEL_VARIANT:qti-distro-perf ?= "_defconfig"
#With bazel
KERNEL_VARIANT:qti-distro-perf ?= "-perf_defconfig"
KERNEL_MODULES_LIST = "modules.list.msm.mdm9607.le"
KERNEL_MODULES_BLACKLIST = "" 

#extra module blacklist
EXTRA_BLACKLIST_MOD ?= ""
KERNEL_DEFCONFIG = "mdm9607${KERNEL_VARIANT}"

#Various kernel directories
KERNEL_PLATFORM_PATH = "${WORKSPACE}/kernel-6.1/kernel_platform"
# With KbDev
#KERNEL_PREBUILT_PATH = "${WORKSPACE}/kernel-6.1/out/${KERNEL_DEFCONFIG}"
#KERNEL_PREBUILT_DISTDIR = "${KERNEL_PREBUILT_PATH}/dist"
#KERNEL_TYPE = "msm-kernel"

# With bazel
KERNEL_PREBUILT_PATH = "${KERNEL_PLATFORM_PATH}/out/msm-kernel-${KERNEL_DEFCONFIG}"
KERNEL_PREBUILT_DISTDIR = "${KERNEL_PREBUILT_PATH}/dist"
KERNEL_TYPE = "dist"

KERNEL_OUT_PATH = "${KERNEL_PREBUILT_PATH}"
KERNEL_BUILD_CONFIG = "msm-kernel/build.config.msm.mdm9607"

# Set sectool5 as preffered provider for signing
PREFERRED_PROVIDER_virtual/signtools-native = "sectool5-native"
ENABLE_SIGNED_IMAGES = "1"
SECTOOLS_PY_DIR = "${KERNEL_PLATFORM_PATH}/prebuilts/qcom_boot_artifacts/sectools/sectoolsv1"
KERNEL_CONFIG = "vendor/${KERNEL_DEFCONFIG}"
ENABLE_DDK_BUILD="true"
TARGET_BOARD_PLATFORM="mdm9607"

#### dtb ####
KERNEL_DTB_NAMES = "mdm9607-mtp.dtb \
                    mdm9607-cdp.dtb \
                    mdm9607-rcm.dtb \
		    "

MACHINE_SUPPORTS_DTBO= "False"
SKIP_VENDOR_BOOT = "True"
# Set selinux in permissive state by default
DEFAULT_ENFORCING = "permissive"
QIMGEXTENSION   += "qsigning"

SERIAL_CONSOLES ?= "115200;ttyMSM0"
KERNEL_IMAGETYPE = "zImage"
#KERNEL_IMAGETYPE = "Image"
KERNEL_BASE = "0x80000000"
KERNEL_TAGS_OFFSET = "0x81E00000"
BOOT_HEADER_VERSION = "1"

KERNEL_CMD_PARAMS = "noinitrd ro rootwait earlycon=msm_serial_dm,0x78b3000 console=ttyMSM0,115200,n8 \
                     no_console_suspend=1 androidboot.hardware=qcom androidboot.console=ttyMSM0 \
                     lpm_levels_legacy.sleep_disabled=1 service_locator.enable=1 \
                     firmware_class.path=/lib/firmware/updates msm_rtb.filter=0x237 \
                     "

#### systemd ####
SERIAL_CONSOLE ?= "115200;ttyMSM0"

# Bootloader configuration
EXTRA_IMAGEDEPENDS += "lk"

# MACHINE_FEATURES ##
# qti-security:           Machine supports QTI security solution
# qti-wifi:               Machine supports QTI WiFi solution
# qti-audio:              Machine supports QTI audio solution
# qti-bluetooth:          Machine supports QTI bluetooth solution
# qti-location:           Machine supports Location solution
# qti-data-modem:         Machine supports QTI data modem solution

MACHINE_FEATURES += "qti-security dm-verity-none nand-boot qti-data-modem qti-modem qti-location qti-wifi qti-bluetooth qti-audio qti-qseecom qti-tzlog qti-recovery "

MACHINE_MNT_POINTS = " \
    /firmware \
    /persist \
    /cache \
    /data \
 "

# Formats of root filesystem images
IMAGE_FSTYPES += "ubi"

# Sizes for UBI volumes
SYSTEM_VOLUME_SIZE ?= "74MiB"
SYSTEM_VOLUME_SIZE_2K ?= "57MiB"
CACHE_VOLUME_SIZE ?= "37MiB"
CACHE_VOLUME_SIZE_2K ?= "1MiB"
SYSTEMRW_VOLUME_SIZE ?= "1MiB"
PERSIST_VOLUME_SIZE ?= "6MiB"

PAGE_SIZE ?= '4096'
PAGE_SIZE_2K ?= '2048'
UBINIZE_ARGS ?= "-m 4096 -p 256KiB -s 4096"
UBINIZE_ARGS_2K ?= "-m 2048 -p 131072 -s 2048"
MKUBIFS_ARGS ?= "-m 4096 -e 253952 -c 2146 -F"
MKUBIFS_ARGS_2K ?= "-m 2048 -e 126976 -c 2146 -F"

MACHINE_SUPPORTS_PDMAPPER = "False"
MACHINE_SUPPORTS_INIT_RAMDISK = "False"
#MACHINE_SUPPORTS_ANDROID_PROPERTIES = "False"

# Disable autosuspend for USB peripheral mode
MACHINE_SUPPORTS_USB_AUTOSUSPEND = "False"

# File indicating firmware residing places on device.
MACHINE_FILESMAP_CONF = "mdm9607-filesmap"
MACHINE_FSCONFIG_CONF = "mdm9607-fsconfig.conf"

USBCOMPOSITION = "9025"

# On msm-5.4 or above ufs driver supports BSG Device.
UFS_BSG_DEV_USAGE = "True"

PREFERRED_VERSION_protobuf = "3.11.4"
PREFERRED_VERSION_protobuf-native = "3.11.4"
PREFERRED_VERSION_iproute2 = "5.5.0"

DISTRO_FEATURES:remove = " qti-fastcv"
DISTRO_FEATURES:append  = " qti-audio"
IMAGE_FEATURES:remove:mdm9607 = " read-only-rootfs"
IMAGE_FEATURES:remove:mdm9607 = "nand2x"
CORE_IMAGE_EXTRA_INSTALL:remove:mdm9607 = "packagegroup-qti-data-1g"
CORE_IMAGE_EXTRA_INSTALL:remove:mdm9607 = "packagegroup-qti-qcc-prop"
CORE_IMAGE_EXTRA_INSTALL:remove:mdm9607 = "packagegroup-qti-ril-prop"
CORE_IMAGE_EXTRA_INSTALL:append = " packagegroup-qti-ppat"
RDEPENDS:packagegroup-qti-debug-tools:remove:mdm9607 = "valgrind"
RDEPENDS:packagegroup-qti-securemsm:remove:mdm9607 = "trustedui-noship trustedui securemsm-internal"
MACHINE_SUPPORTS_DISPLAY = "False"
```
