## conf/machine/sdxprairie.conf
```bitbake
#@TYPE: Machine
#@NAME: SDXPRAIRIE
#@DESCRIPTION: Machine configuration for QTI sdxprairie

require conf/machine/include/sdxprairie.inc

KERNEL_IMAGETYPE = "zImage-dtb"
KERNEL_DTS_NAME = "sdxprairie"
KERNEL_BASE = "0x80000000"
KERNEL_TAGS_OFFSET = "0x82000000"

KERNEL_CONFIG = "${@['sdxprairie-perf_defconfig', 'sdxprairie_defconfig'][d.getVar('VARIANT', True) == ('' or 'debug')]}"

KERNEL_CMD_PARAMS = "noinitrd ro rootwait console=ttyMSM0,115200,n8 androidboot.hardware=qcom msm_rtb.filter=0x237 androidboot.console=ttyMSM0 lpm_levels.sleep_disabled=1 firmware_class.path=/lib/firmware/updates service_locator.enable=1 net.ifnames=0 atlantic_fwd.rx_ring_size=1024"
KERNEL_CMD_PARAMS_remove = "${@bb.utils.contains_any('VARIANT', 'perf user', 'console=ttyMSM0,115200,n8 androidboot.console=ttyMSM0', '', d)}"

LLVM_VERSION = "6.0"

#Enable audio kernel
DISTRO_FEATURES += "audiodlkm audio-dlkm"

#Uncomment the below line to enable recovery upgrade for nand devices
#DISTRO_FEATURES += "nand-recovery-upgrade"

DISTRO_FEATURES_append += " selinux"
DISTRO_FEATURES_append += " cmnlib-preload"
#Uncomment the below line to enable OTA package verification feature
#DISTRO_FEATURES_append += " ota-package-verification"
DISTRO_FEATURES_FILTER_NATIVE += " selinux"
DEFAULT_ENFORCING = "enforcing"
MACHINE_MNT_POINTS = "/firmware /persist /cache"

# Enable early USB init
DISTRO_FEATURES_append = " early-usb-init"

# Whitelist packages having commercial license.
LICENSE_FLAGS_WHITELIST  += "commercial_ffmpeg"
```

## conf/machine/sxrneo-ar-sg1.conf
```bitbake
#@TYPE: Machine
#@NAME: AR-Gen1
#@DESCRIPTION: Machine configuration for Neo

require conf/machine/sxrneo.conf

KERNEL_DTB_NAMES += " \
    neo_la.dtb \
    neo_luna-v2.dtb \
"

MACHINE_FEATURES:remove = "qti-abc-boot"
MACHINE_FEATURES += "qti-ab-boot"
```

## conf/machine/trustedvm-v3-1.conf
```bitbake
# Copyright (c) 2024 Qualcomm Innovation Center, Inc. All rights reserved.
# SPDX-License-Identifier: BSD-3-Clause-Clear

#@TYPE: Machine
#@NAME: TRUSTEDVM-V3-1
#@DESCRIPTION: Machine configuration for MTP with TRUSTEDVM

BASEMACHINE = "trustedvm-v3-1"
require conf/machine/include/basemachine.inc

DEFAULTTUNE = "aarch64"
include conf/machine/include/arm/arch-armv8a.inc

PREFERRED_PROVIDER_virtual/mkbootimg = "mkbootimg-gki"
PREFERRED_PROVIDER_virtual/mkdtimg   = "mkdtimg-gki"
PREFERRED_PROVIDER_virtual/kernel   = "linux-msm"
#PREFERRED_PROVIDER_virtual/dtc-native = "dtc-android-build-native"
PREFERRED_VERSION_linux-msm = "${VM_KERNEL_VERSION}"
PREFERRED_VERSION_linux-msm-headers ?= "${PREFERRED_VERSION_linux-msm}"
PREFERRED_VERSION_kernel-toolchain ?= "${PREFERRED_VERSION_linux-msm}"
PREFERRED_VERSION_kernel-toolchain-native = "${PREFERRED_VERSION_linux-msm}"
PREFERRED_VERSION_dtc-android-build ?= "${PREFERRED_VERSION_linux-msm}"
PREFERRED_VERSION_mkbootimg-gki ?= "${PREFERRED_VERSION_linux-msm}"
PREFERRED_VERSION_coreutils ?= "6.9"
PREFERRED_PROVIDER_virtual/refpolicy = "refpolicy-mls-vm"

LLVM_VERSION = "8.0"

PAGE_SIZE ?= '4096'

EXTRA_IMAGECMD ?= "-N 2048"

KERNEL_IMAGETYPE = "Image"
KERNEL_CMD_PARAMS = ""
KERNEL_VARIANT = ""
KERNEL_VARIANT:qti-distro-base-debug = "debug_"
SERIAL_CONSOLE = "115200 hvc0"
VM_TARGET = "${VM_KERNEL_TARGET}"

MACHINE_USES_KERNEL_PREBUILTS = "True"
KERNEL_PLATFORM_PATH ?= "${WORKSPACE}/kernel-${PREFERRED_VERSION_linux-msm}/kernel_platform/"
KERNEL_PREBUILT_PATH ?= "${WORKSPACE}/kernel-${PREFERRED_VERSION_linux-msm}/out/msm-kernel-${VM_TARGET}_tuivm-${KERNEL_VARIANT}defconfig/"
KERNEL_PREBUILT_DISTDIR ?= "${WORKSPACE}/kernel-${PREFERRED_VERSION_linux-msm}/out/msm-kernel-${VM_TARGET}_tuivm-${KERNEL_VARIANT}defconfig/dist"
KERNEL_TYPE = "dist"

#### KERNEL ####
KERNEL_VARIANT:qti-distro-debug ?= "debug"
KERNEL_VARIANT:qti-distro-perf ?= ""
# Check for msm-kernel or gki_kernel
KERNEL_TYPE = "dist"


KERNEL_DEFCONFIG = "msm-kernel-kalama_le-${KERNEL_VARIANT}"
KERNEL_OUT_PATH = "${KERNEL_PREBUILT_PATH}"
KERNEL_BUILD_CONFIG = "msm-kernel/${KERNEL_CONFIG}"
ENABLE_DDK_BUILD="true"

#### dtb ####
KERNEL_CONFIG  ?= "build.config.msm.parrot.vm"
TARGET_BOARD_PLATFORM="parrot-vms"
KERNEL_DTB_NAMES = "parrot-vm-qrd-wcn6750.dtb parrot-vm-qrd.dtb parrot-vm-idp-wcn6750-amoled-rcm.dtb parrot-vm-idp-wcn6750-amoled.dtb parrot-vm-idp-wcn3990-amoled-rcm.dtb parrot-vm-idp-wcn3990.dtb  parrot-vm-rumi.dtb parrot-vm-atp.dtb parrot-vm-idp.dtb"


# filesystem configurations to be applied on image.
MACHINE_FSCONFIG_CONF = "trustedvm-fsconfig.conf"
MACHINE_SUPPORTS_USB = "False"
MACHINE_SUPPORTS_ANDROID_PROPERTIES = "False"
MACHINE_SUPPORTS_DISPLAY = "True"
MACHINE_SUPPORTS_MINK = "True"
MACHINE_SUPPORTS_SECUREMSM = "True"
MACHINE_SUPPORTS_TOUCH = "True"
MACHINE_SUPPORTS_OEMVM = "True"
MACHINE_MNT_POINTS = " "
ENABLE_ADB = "False"
# Formats of root filesystem images.
IMAGE_FSTYPES += "ext4"
IMAGE_INIT_MANAGER = "systemd"

VALG = 'False'

SYSTEMIMAGE_TARGET = "system.img"
VMUSERDATAIMAGE_TARGET = "vm-userdata.img"
VMIMAGE_TARGET = "vm-bootsys.img"
VMPERSIST_TARGET = "vm-persist.img"
DTB_TARGET = "vm.dtb"
KERNEL_OFFSET_TRUSTEDVM = "0xE0C00000"
DTB_OFFSET_TRUSTEDVM = "0xE2C00000"
RAMDISK_OFFSET_TRUSTEDVM = "0xE2F00000"
CMDLINE_OFFSET_TRUSTEDVM = "0xE2F00000"
# ZRAM
SWAP_MEMTOTAL_PCT = "200"

KERNEL_OFFSET_OEMVM = "0x0"
DTB_OFFSET_OEMVM = "0x2000000"
RAMDISK_OFFSET_OEMVM = "0x2100000"
CMDLINE_OFFSET_OEMVM = "0x2100000"

# Ramdisk size is 8 MB
RAMDISK_SIZE = "10388608"

SYSTEM_SIZE_EXT4 ?= "258000000"
USERDATA_SIZE_EXT4 ?= "25000000"
PERSIST_IMAGE_ROOTFS_SIZE = "119000000"
PERSIST_OEMVM_IMAGE_ROOTFS_SIZE = "70000000"
PERSIST_SIZE_EXT4 = "119000000"
VM_PERSIST_SIZE_EXT4 ?= "220000000"
VM_SIZE_EXT4 ?= "562000000"

MACHINE_FEATURES:append = " qti-multivm dm-verity-cpio-cmdline qti-vm qti-vm-tui qti-vm-persist qti-smmu-proxy vm-dynamic-memresize qti-vm-target qti-vm-mink qti-vm-ipp qti-vm-c2pa "

PREFERRED_PROVIDER_virtual/base-utils = "toybox"
VIRTUAL-RUNTIME_base-utils = "toybox"
#VIRTUAL-RUNTIME_base-utils-hwclock = ""
#VIRTUAL-RUNTIME_base-utils-syslog = ""
#VIRTUAL-RUNTIME_login_manager = ""
INIT_MANAGER = "systemd"
TOYBOX_RAMDISK = "True"

# On msm-5.4 or above ufs driver supports BSG Device.
UFS_BSG_DEV_USAGE = "True"

MACHINE_FEATURES += " gh-loader "
```

## conf/machine/vienna.conf
```bitbake
#@TYPE: Machine
#@NAME: vienna
#@DESCRIPTION: Machine configuration for QTI HDK with vienna
BASEMACHINE ?= "vienna"
require conf/machine/include/basemachine.inc

DEFAULTTUNE ?= "aarch64"
include conf/machine/include/arm/arch-armv8a.inc

PREFERRED_PROVIDER_virtual/mkbootimg = "mkbootimg-gki"
PREFERRED_PROVIDER_virtual/mkdtimg   = "mkdtimg-gki"
PREFERRED_PROVIDER_virtual/kernel   = "linux-soc-repo"
PREFERRED_VERSION_linux-msm ?= "6.12"
PREFERRED_VERSION_linux-msm-headers ?= "${PREFERRED_VERSION_linux-msm}"
PREFERRED_VERSION_kernel-toolchain ?= "${PREFERRED_VERSION_linux-msm}"
PREFERRED_VERSION_kernel-toolchain-native ?= "${PREFERRED_VERSION_linux-msm}"
PREFERRED_VERSION_dtc-android-build ?= "1.6.0"
PREFERRED_VERSION_mkbootimg-gki ?= "${PREFERRED_VERSION_linux-msm}"
PREFERRED_VERSION_mkbootimg-gki-native ?= "${PREFERRED_VERSION_linux-msm}"
PREFERRED_VERSION_mod-signing-keys ?= "${PREFERRED_VERSION_linux-msm}"
PREFERRED_VERSION_synx-kernel ?= "1.0"
PREFERRED_VERSION_securemsmdlkm ?= "1.1"
PREFERRED_VERSION_touchdlkm = "1.0"

# clang version for kernel toolchain 6.12
CLANG_VERSION = "r536225"

#### KERNEL ####
MACHINE_USES_KERNEL_PREBUILTS = "True"
KERNEL_VARIANT:qti-distro-debug ?= "debug-defconfig"
KERNEL_VARIANT:qti-distro-perf ?= "defconfig"
KERNEL_MODULES_LIST = "modules-lists/modules.list.msm.vienna-le"

# Check for soc-repo or gki_kernel
KERNEL_TYPE = "dist"

#extra module blacklist
EXTRA_BLACKLIST_MOD ?= ""

INITRAMFS_IMAGE = "qti-ramdisk-image"
INITRAMFS_FSTYPES = "cpio.lz4"
VENDOR_INITRAMFS_IMAGE = "qti-vendor-ramdisk-image"

KERNEL_DEFCONFIG:qti-distro-debug ?= "msm-kernel-vienna_le-debug_defconfig"
KERNEL_DEFCONFIG:qti-distro-perf ?= "msm-kernel-vienna_le-${KERNEL_VARIANT}"

#Various kernel directories
KERNEL_PLATFORM_PATH = "${WORKSPACE}/kernel-${PREFERRED_VERSION_linux-msm}/kernel_platform"
KERNEL_PREBUILT_PATH = "${WORKSPACE}/kernel-${PREFERRED_VERSION_linux-msm}/out/${KERNEL_DEFCONFIG}"
KERNEL_PREBUILT_DISTDIR = "${KERNEL_PREBUILT_PATH}/dist"

KERNEL_OUT_PATH = "${KERNEL_PREBUILT_PATH}"

KERNEL_CONFIG  ?= "build.config.msm.vienna.le"
KERNEL_BUILD_CONFIG = "soc-repo/${KERNEL_CONFIG}"
KERNEL_IS_SOC_REPO = "True"

#### dtb ####
KERNEL_DTB_NAMES = "vienna.dtb viennap.dtb"

MACHINE_SUPPORTS_DTBO= "True"
BUILD_WITH_TECHPACKS = "1"
SKIP_VENDOR_BOOT = "False"
# Enable Device Development Kit for bazel build
DDK_BUILD = "true"
# Define target board platform for build system
TARGET_BOARD_PLATFORM="${BASEMACHINE}-le"

#### boot.img ####
KERNEL_IMAGETYPE = "Image"
KERNEL_BASE = "0x80000000"
KERNEL_TAGS_OFFSET = "0x80000000"
BOOT_HEADER_VERSION = "2"

#### systemd ####
SERIAL_CONSOLE ?= "115200;ttyMSM0"

#### cmdline ####
CONSOLE_PARAM:qti-distro-perf  = ""
CONSOLE_PARAM:qti-distro-debug = ""
CONSOLE_PARAM += " lpm_levels.sleep_disabled=1 video=vfb:640x400,bpp=32,memsize=3072000 msm_rtb.filter=0x237 service_locator.enable=1 swiotlb=noforce kpti=off cgroup.memory=nokmem,nosocket loop.max_part=7 qcom_geni_serial.con_enabled=0"
HIBERNATION_PARAMS = "hibernate=nocompress"
KERNEL_CMD_PARAMS = "${CONSOLE_PARAM}"

#### others ####
PAGE_SIZE ?= '4096'
SDCARD_DEVICE = "mmcblk1p1"

#Abl would be enabled later
EXTRA_IMAGEDEPENDS += "edk2"
PREFERRED_VERSION_edk2 ?= "4.0"

# TODO: Temporary change to override BB_SIGNATURE_HANDLER set in local.conf.
# Other machines are already supporting OEEquivHash as hashing signature.
# Fix build issues observed in this machine and remove this override.
BB_SIGNATURE_HANDLER = "OEBasicHash"

#QSEEComCompat and QSEECom are mutually exlusive and QSEEComCompat depends on  smcinvoke
#lv-build builds the required listernes , le_qseecom enables qseecomd
MACHINE_FEATURES += "dm-verity-none"

MACHINE_MNT_POINTS = " \
	/persist \
	/firmware \
	/bt_firmware \
	/dsp \
	/overlay \
"

SYSTEM_SIZE_EXT4   ?= "1073741824"
PERSIST_SIZE_EXT4 ?= "7MiB"
# Define userdata dir, size to be used
USERDATA_DIR = "${@bb.utils.contains('MACHINE_MNT_POINTS', '/overlay', 'overlay', 'data', d)}"
USERDATA_SIZE ?= "8589934592"

# Formats of root filesystem images
IMAGE_FSTYPES += "ext4"
MACHINE_SUPPORTS_PDMAPPER = "True"
MACHINE_SUPPORTS_ANDROID_PROPERTIES = "True"
MACHINE_SUPPORTS_DISPLAY = "False"
MACHINE_FSCONFIG_CONF = "vienna-fsconfig.conf"
MACHINE_SUPPORTS_SSR = "True"

USBCOMPOSITION = "901D"

# Partition conf
MACHINE_PARTITION_CONF = "vienna-partition.conf"

# File indicating firmware residing places on device.
MACHINE_FILESMAP_CONF = "vienna-filesmap"

### MACHINE_FEATURES ###
MACHINE_FEATURES += "qti-ab-boot qti-adsp qti-cdsp fastrpc qti-tzlog qti-qseecom qti-crypto qti-smmu-proxy qti-security smcinvoke qti-smciqseecomd"

# On msm-5.4 or above ufs driver supports BSG Device.
UFS_BSG_DEV_USAGE = "True"

DISTRO_FEATURES:remove = "virtualization ros2 qirp-sdk qti-ib2c qti-uvc qti-umd-gadget qti-auto-framing-stabilization tensorflow-lite"

QPERMISSIONS_ENABLE = "1"

# pack for installation of ESDK
COREBASE_FILES:append = " meta-poky"
```

## conf/machine/vt-64.conf
```bitbake
#@TYPE: Machine
#@NAME: VT-64
require conf/machine/include/qcs40x.inc

PREFERRED_PROVIDER_virtual/mkbootimg = "mkbootimg-gki"

PREFERRED_VERSION_linux-msm ?= "5.15"
PREFERRED_VERSION_linux-msm-headers ?= "5.15"
PREFERRED_VERSION_kernel-toolchain ?= "5.15"
PREFERRED_VERSION_dtc-android-build ?= "5.15"
PREFERRED_VERSION_mkbootimg-gki ?= "5.15"
PREFERRED_VERSION_mkbootimg-gki-native ?= "5.15"

#### KERNEL ####
MACHINE_USES_KERNEL_PREBUILTS = "True"
KERNEL_VARIANT:qti-distro-debug ?= "debug_defconfig"
KERNEL_VARIANT:qti-distro-perf ?= "perf_defconfig"

#extra module blacklist
EXTRA_BLACKLIST_MOD ?= ""

INITRAMFS_IMAGE = "qti-ramdisk-image"
INITRAMFS_FSTYPES = "cpio.lz4"
VENDOR_INITRAMFS_IMAGE = "qti-vendor-ramdisk-image"

KERNEL_DEFCONFIG = "msm-kernel-qcs405-${KERNEL_VARIANT}"

#Various kernel directories
KERNEL_PLATFORM_PATH = "${WORKSPACE}/kernel-5.15/kernel_platform"
KERNEL_PREBUILT_PATH = "${WORKSPACE}/kernel-5.15/out/${KERNEL_DEFCONFIG}"
KERNEL_PREBUILT_DISTDIR = "${KERNEL_PREBUILT_PATH}/dist"

KERNEL_OUT_PATH = "${KERNEL_PREBUILT_PATH}"
KERNEL_CONFIG  ?= "build.config.msm.qcs405"
KERNEL_BUILD_CONFIG = "msm-kernel/${KERNEL_CONFIG}"

#### dtb ####
KERNEL_DTB_NAMES = "qcs405.dtb"

MACHINE_SUPPORTS_DTBO= "True"
BUILD_WITH_TECHPACKS = "1"
SKIP_VENDOR_BOOT = "False"

#### boot.img ####
KERNEL_IMAGETYPE = "Image"
KERNEL_BASE = "0x80000000"
KERNEL_TAGS_OFFSET = "0x80000000"
BOOT_HEADER_VERSION = "2"

#### cmdline ####
CONSOLE_PARAM:qti-distro-perf  = "console=ttyMSM0,115200n8"
CONSOLE_PARAM:qti-distro-debug = "console=ttyMSM0,115200n8 earlycon=msm_serial_dm,0x78b1000 loglevel=6"

KERNEL_CMD_PARAMS = "${CONSOLE_PARAM} kpti=0 log_buf_len=256K kernel.panic_on_rcu_stall=1 rcupdate.rcu_expedited=1 rcu_nocbs=0-7 ftrace_dump_on_oops fw_devlink.strict=1 cpufreq.default_governor=performance printk.console_no_auto_verbose=1 kasan=off"

#### systemd ####
SERIAL_CONSOLE ?= "115200;ttyMSM0"

#### others ####
PAGE_SIZE ?= '4096'

#Abl would be enabled later
EXTRA_IMAGEDEPENDS += "edk2"
PREFERRED_VERSION_edk2 ?= "4.0"

# TODO: Temporary change to override BB_SIGNATURE_HANDLER set in local.conf.
# Other machines are already supporting OEEquivHash as hashing signature.
# Fix build issues observed in this machine and remove this override.
BB_SIGNATURE_HANDLER = "OEBasicHash"

#QSEEComCompat and QSEECom are mutually exlusive and QSEEComCompat depends on  smcinvoke
#lv-build builds the required listernes , le_qseecom enables qseecomd
MACHINE_FEATURES += "dm-verity-none"


##############################################################

# SElinux enablement in enforcing mode

#############################################################

#DEFAULT_ENFORCING = "permissive"
MACHINE_MNT_POINTS = " \
	/persist \
	/firmware \
	/bt_firmware \
	/dsp \
	/overlay \
"

SYSTEM_SIZE_EXT4   ?= "1610612736"

# Define userdata dir, size to be used
USERDATA_DIR = "${@bb.utils.contains('MACHINE_MNT_POINTS', '/overlay', 'overlay', 'data', d)}"
USERDATA_SIZE ?= "104857600"

# Formats of root filesystem images
IMAGE_FSTYPES += "ext4"
MACHINE_SUPPORTS_PDMAPPER = "True"
MACHINE_SUPPORTS_ANDROID_PROPERTIES = "True"
MACHINE_FSCONFIG_CONF = "vt-64-fsconfig.conf"

MACHINE_SUPPORTS_SSR = "True"

USBCOMPOSITION = "901D"

# Partition conf
# MACHINE_PARTITION_CONF = "vt-64-partition.conf"

# File indicating firmware residing places on device.
MACHINE_FILESMAP_CONF = "qcs40x-filesmap"

# On msm-5.4 or above ufs driver supports BSG Device.
UFS_BSG_DEV_USAGE = "True"

KERNEL_TYPE = "msm-kernel"
### MACHINE_FEATURES ###
MACHINE_FEATURES += "qti-ab-boot opencl"

GENERATE_AB_OTA_PACKAGE = "0"
```

## meta-qti-base/conf/distro/auto-gvm.conf
```bitbake
require conf/distro/include/auto-common.inc

DISTRO_NAME = "auto gvm"

DISTRO_FEATURES_append= " q-hypervisor"

DISTRO_FEATURES_append = " qti-core qti-audio qti-bluetooth qti-data qti-extra qti-security qti-display qti-multimedia qti-ml qti-camera qti-location"
```

## meta-qti-base/conf/distro/auto-pvm.conf
```bitbake
require conf/distro/include/auto-common.inc

DISTRO_NAME = "auto pvm"

DISTRO_FEATURES_append = " qti-pvm"

DISTRO_FEATURES_append = " qti-core qti-audio qti-data qti-extra qti-security qti-tools qti-graphics qti-display qti-camera qti-multimedia qti-ml qti-vnw"
```

## meta-qti-base/conf/distro/auto.conf
```bitbake
require conf/distro/include/auto-common.inc

DISTRO_NAME = "auto"

DISTRO_FEATURES_append = " qti-core qti-audio qti-data qti-extra qti-security qti-tools qti-graphics qti-display qti-camera qti-multimedia qti-ml qti-vnw"
```
