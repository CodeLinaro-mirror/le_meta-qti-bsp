## conf/machine/qrbx210-rbx.conf
```bitbake
#@TYPE: Machine
#@NAME: qrbx210-rbx
#@DESCRIPTION: Machine configuration for qrbx210-rbx

require conf/machine/include/qrbx210.inc

######################## Start of KERNEL ############################
# clang version for kernel toolchain 6.12
CLANG_VERSION = "r536225"

KERNEL_SRC_TYPE = "soc-repo"
MACHINE_USES_KERNEL_PREBUILTS = "True"
KERNEL_VARIANT:qti-distro-debug ?= "debug-defconfig"
KERNEL_VARIANT:qti-distro-perf ?= "defconfig"
BUILD_VARIANT:qti-distro-debug ?= "debug_defconfig"
BUILD_VARIANT:qti-distro-perf ?= "defconfig"
KERNEL_MODULES_LIST = "modules-lists/modules.list.msm.bengal-le"
KERNEL_MODULES_BLACKLIST = "\
    modules.vendor_blocklist.msm.bengal-le \
    modules.systemdlkm_blocklist.msm.bengal-le \
"
KERNEL_DEFCONFIG_VARIANT:qti-distro-debug ?= "debug-defconfig"
KERNEL_DEFCONFIG_VARIANT:qti-distro-perf ?= "defconfig"
KERNEL_DEFCONFIG = "msm-kernel-bengal_le-${BUILD_VARIANT}"

# Check for msm-kernel or gki_kernel
KERNEL_TYPE = "dist"

#extra module blacklist
EXTRA_BLACKLIST_MOD ?= ""

# enable DDK build
DDK_BUILD = "true"
TARGET_BOARD_PLATFORM = "bengal-le"
HOSTTOOLS += "${@bb.utils.contains('DDK_BUILD', 'true', 'rsync', '', d)}"

KERNEL_CONFIG  ?= "build.config.msm.bengal.le"
KERNEL_BUILD_CONFIG = "soc-repo/${KERNEL_CONFIG}"

#### dtb ####
KERNEL_DTB_NAMES = "qrb4210-rb2.dtb qrb4210-rb2-v2.dtb qrb4210-rb2-v3.dtb qrb4210-rb2-v4.dtb"

MACHINE_SUPPORTS_DTBO= "False"
BUILD_WITH_TECHPACKS = "1"
SKIP_VENDOR_BOOT = "True"

#### boot.img ####
KERNEL_IMAGETYPE = "Image"
KERNEL_BASE = "0x80000000"
KERNEL_TAGS_OFFSET = "0x80000000"
BOOT_HEADER_VERSION = "2"

#### systemd ####
SERIAL_CONSOLE ?= "115200;ttyMSM0"

#### cmdline ####
CONSOLE_PARAM:qti-distro-perf  = "nosoftlockup console=ttynull qcom_geni_serial.con_enabled=0 androidboot.serialconsole=0"
CONSOLE_PARAM:qti-distro-debug = "loglevel=8 console=ttyMSM0,115200n8 qcom_geni_serial.con_enabled=1 earlycon=qcom_geni,0x4a90000 androidboot.serialconsole=1"
KERNEL_CMD_PARAMS = "${CONSOLE_PARAM} verity=enabled"

#### others ####
PAGE_SIZE ?= '4096'
SDCARD_DEVICE = "mmcblk1p1"

#Abl would be enabled later
EXTRA_IMAGEDEPENDS += "edk2"
PREFERRED_VERSION_edk2 ?= "4.0"

require recipes-kernel/linux-msm/msm-common.inc
########################End of KERNEL ############################

# TODO: Temporary change to override BB_SIGNATURE_HANDLER set in local.conf.
# Other machines are already supporting OEEquivHash as hashing signature.
# Fix build issues observed in this machine and remove this override.
BB_SIGNATURE_HANDLER = "OEBasicHash"

# Sizes for EXT4 (in bytes)
SYSTEM_SIZE_EXT4 = "3221225472"
USERDATA_SIZE = "4294967296"
# Define userdata dir, size to be used
USERDATA_DIR = "${@bb.utils.contains('MACHINE_MNT_POINTS', '/overlay', 'overlay', 'data', d)}"

# Formats of root filesystem images
IMAGE_FSTYPES += "ext4"
MACHINE_SUPPORTS_PDMAPPER = "True"
MACHINE_SUPPORTS_ANDROID_PROPERTIES = "True"
MACHINE_FSCONFIG_CONF = "qrbx210-fsconfig.conf"
MACHINE_SUPPORTS_DISPLAY = "False"
MACHINE_SUPPORTS_SSR = "False"

USBCOMPOSITION = "901D"

# Partition conf
MACHINE_PARTITION_CONF = "qrbx210-rbx-partition.conf"

# File indicating firmware residing places on device.
MACHINE_FILESMAP_CONF = "bengal-filesmap"

# pack for installation of ESDK
COREBASE_FILES:append = " meta-poky"

PREFERRED_VERSION_mod-blacklist ?= "2.0"

### MACHINE_FEATURES ###
MACHINE_FEATURES += "qti-ab-boot qti-security qti-tzlog qti-qseecom smcinvoke qti-tmecom qti-rpmb gptee qti-crypto qti-gp-reqcancel"
MACHINE_FEATURES += "qti-adsp"
MACHINE_FEATURES += "qti-cdsp"
MACHINE_FEATURES += "fastrpc"
MACHINE_FEATURES += "dm-verity-initramfs-v3"
MACHINE_FEATURES += "qti-audio"
MACHINE_FEATURES += "qti-video"

#Temp change for bringup dry run
DISTRO_FEATURES:remove += "qti-sensors qti-sensors-prop qti-location"

DISTRO_FEATURES:remove = "ros2 qirp-sdk qti-ib2c qti-uvc qti-umd-gadget qti-auto-framing-stabilization"

DEFAULT_ENFORCING = "enforcing"
```

## conf/machine/sa415m.conf
```bitbake
#@TYPE: Machine
#@NAME: SA415M
#@DESCRIPTION: Machine configuration for QTI sa415m

require conf/machine/include/sdxpoorwills.inc

KERNEL_IMAGETYPE = "zImage-dtb"
KERNEL_DTS_NAME = "sdxpoorwills"
KERNEL_BASE = "0x80000000"
KERNEL_TAGS_OFFSET = "0x82000000"

KERNEL_CONFIG ?= "${@['sa415m-perf_defconfig', 'sa415m_defconfig'][d.getVar('VARIANT', True) == ('' or 'debug')]}"

KERNEL_CMD_PARAMS = "noinitrd ro rootwait console=ttyMSM0,115200,n8 androidboot.hardware=qcom msm_rtb.filter=0x37 androidboot.console=ttyMSM0 lpm_levels.sleep_disabled=1  firmware_class.path=/lib/firmware/updates service_locator.enable=1"
KERNEL_CMD_PARAMS_remove = "${@bb.utils.contains_any('VARIANT', 'perf user', 'console=ttyMSM0,115200,n8 androidboot.console=ttyMSM0', '', d)}"

BOOTIMAGE_TARGET = "${MACHINE}-boot.img"

# Limiting squashfs rootfs size to 60MiB (size should be multiple of LEB, LEB is 253952 bytes)
SYSTEM_SQUASHFS_VOLUME_SIZE ?= "62980096"

# Volume sizes
SYSTEM_VOLUME_SIZE = "110MiB"
CACHE_VOLUME_SIZE = "20MiB"
SYSTEMRW_VOLUME_SIZE = "6MiB"
PERSIST_VOLUME_SIZE = "6MiB"

# Enable recovery image generation.
RECOVERY_IMAGE ?= "1"

VIRTUAL-RUNTIME_dev_manager = "udev"
VIRTUAL-RUNTIME_init_manager = "systemd"

# Change Image features for systemd.
IMAGE_DEV_MANAGER = "udev"
IMAGE_INIT_MANAGER = "systemd"
IMAGE_INITSCRIPTS = ""

MACHINE_MNT_POINTS = "/firmware /persist /cache"

# Enable coredump
SYSTEMD_ENABLE_COREDUMP = "1"
SYSTEMD_COREDUMP_PATH = "${userfsdatadir}/coredump"

# Enable SDK feature
SDK_IMAGE = "1"

# Enable early USB init
DISTRO_FEATURES_append = " early-usb-init"

# Image names
UBIFS_UBI_IMAGE      = "${MACHINE}-sysfs-ubifs.ubi"
OUTPUT_FILE_FINAL_SQUASHFS_UBI = "${DEPLOY_DIR_IMAGE_NAND}/${MACHINE}-sysfs.ubi"
SQUASHFS_SYS_VOLUME = "system.squash"
RECOVERYFS_SQUASHFS_UBI_IMAGE = "${DEPLOY_DIR_IMAGE_NAND}/${MACHINE}-recoveryfs.ubi"
RECOVERYFS_SQUASHFS_IMAGE = "${DEPLOY_DIR_IMAGE_NAND}/recoveryfs.squash"
RECOVERYFS_UBIFS_UBI_IMAGE = "${DEPLOY_DIR_IMAGE_NAND}/${MACHINE}-recoveryfs-ubifs.ubi"
```

## conf/machine/sa515m-dual-nand-initramfs.conf
```bitbake
#@TYPE: Machine
#@NAME: SA515M-Dual-NAND-INITRAMFS
#@DESCRIPTION: Machine configuration for SA515M Initramfs

IMAGE_FSTYPES = "${INITRAMFS_FSTYPES}"

INITRAMFS_IMAGE = "qti-recovery-image"

BOOTIMAGE_TARGET = "${MACHINE}-recovery-boot.img"
BUNDLED_BOOTIMAGE_TARGET = "${MACHINE}-recovery-bundled-boot.img"

KERNEL_CMD_PARAMS_remove = "noinitrd"
KERNEL_CMD_PARAMS_append = " ramdisk_size=40960"

KERNEL_DTB_NAMES = "vendor/qcom/sa515m-v2-dsda-dual-nand-recovery-cdp.dtb"

DEFAULT_ENFORCING = "permissive"

## MACHINE_FEATURES ##
# dual-nand-recovery      Machine Support Dual NAND recovry support
MACHINE_FEATURES += "dual-nand-recovery"

KERNEL_IMAGENAME = "${@bb.utils.contains('MACHINE_FEATURES', 'dual-nand-recovery', '-nandrecovery', '', d)}"
```

## conf/machine/sa515m.conf
```bitbake
#@TYPE: Machine
#@NAME: SA515M
#@DESCRIPTION: Machine configuration for QTI sa515m

require conf/machine/include/sdxprairie.inc

KERNEL_IMAGETYPE = "zImage-dtb"
KERNEL_DTS_NAME = "sdxprairie"
KERNEL_BASE = "0x80000000"
KERNEL_TAGS_OFFSET = "0x82000000"
KERNEL_LOAD_ADDR = "0x85400000"

KERNEL_CONFIG = "${@['sa515m-perf_defconfig', 'sa515m_defconfig'][d.getVar('VARIANT', True) == ('' or 'debug')]}"

KERNEL_CMD_PARAMS = "ro rootwait console=ttyMSM0,115200,n8 androidboot.hardware=qcom msm_rtb.filter=0x237 androidboot.console=ttyMSM0 lpm_levels.sleep_disabled=1 firmware_class.path=/lib/firmware/updates service_locator.enable=1 net.ifnames=0"
KERNEL_CMD_PARAMS_remove = "${@bb.utils.contains_any('VARIANT', 'perf user', 'console=ttyMSM0,115200,n8 androidboot.console=ttyMSM0', '', d)}"

BOOTIMAGE_TARGET = "${MACHINE}-boot.img"

LLVM_VERSION = "6.0"

# Limiting squashfs rootfs size to 60MiB (size should be multiple of LEB, LEB is 253952 bytes)
SYSTEM_SQUASHFS_VOLUME_SIZE ?= "62980096"


# Volume sizes
SYSTEM_VOLUME_SIZE = "110MiB"
CACHE_VOLUME_SIZE = "${@bb.utils.contains('DISTRO_FEATURES', 'nad-prod', '10MiB', '20MiB', d)}"
SYSTEMRW_VOLUME_SIZE = "6MiB"
PERSIST_VOLUME_SIZE = "6MiB"

# Enable audio kernel
DISTRO_FEATURES += "audiodlkm audio-dlkm"

# Enable flashless feature
# Add squashfs-xz filesystem needed
DISTRO_FEATURES += "flashless"
IMAGE_FSTYPES += "squashfs-xz"

RAMDISK = "${IMGDEPLOYDIR}/machine-image-${MACHINE}-flashless.squashfs-xz"
RAMDISK_OFFSET = "0x02200000"

MACHINE_MNT_POINTS = "/firmware /persist /cache"

# Enable coredump
SYSTEMD_ENABLE_COREDUMP = "1"
SYSTEMD_COREDUMP_PATH = "${userfsdatadir}/coredump"

# Enable rootfs_flashless
IMAGE_ROOTFS_FLASHLESS = "${WORKDIR}/rootfs_flashless"
USERDATAIMAGE_TARGET   = "${MACHINE}-usrfs.ext4"
SYSTEMRWIMAGE_TARGET   = "${MACHINE}-systemrw.ext4"
PERSISTIMAGE_TARGET    = "${MACHINE}-persist.ext4"

# Create different label for this machine
MAKEEXT4_USRDATA_LABEL_OPT = "-L mdm_userdata"
SYSTEMRW_LABEL             = "mdm_systemrw"
PERSIST_LABEL              = "mdm_persist"

# Size of ext4 (in bytes)
USERDATA_SIZE_EXT4 = "73400320"
SYSTEMRW_SIZE_EXT4 = "8808038"
PERSIST_SIZE_EXT4  = "4404019"

# Enable early USB init
DISTRO_FEATURES_append = " early-usb-init"

# Enable SDK feature
SDK_IMAGE = "1"

# Image names
UBIFS_UBI_IMAGE      = "${MACHINE}-sysfs-ubifs.ubi"
OUTPUT_FILE_FINAL_SQUASHFS_UBI = "${DEPLOY_DIR_IMAGE_NAND}/${MACHINE}-sysfs.ubi"
SQUASHFS_SYS_VOLUME = "system.squash"
RECOVERYFS_SQUASHFS_UBI_IMAGE = "${DEPLOY_DIR_IMAGE_NAND}/${MACHINE}-recoveryfs.ubi"
RECOVERYFS_SQUASHFS_IMAGE = "${DEPLOY_DIR_IMAGE_NAND}/recoveryfs.squash"
RECOVERYFS_UBIFS_UBI_IMAGE = "${DEPLOY_DIR_IMAGE_NAND}/${MACHINE}-recoveryfs-ubifs.ubi"

# Enable system-integrity through IMA
DISTRO_FEATURES_append = " vbleima"
DISTRO_FEATURES_NATIVE_append = " vbleima"

# Enable system-integrity through EVM
DISTRO_FEATURES_append = " vbleevm"
```

## conf/machine/sa525m-emmc.conf
```bitbake
#@TYPE: Machine
#@NAME: SA525M-EMMC
#@DESCRIPTION: Machine configuration for SA525M EMMC

require conf/machine/include/sa525m.inc

# MACHINE_FEATURES ##
MACHINE_FEATURES += "emmc-boot qti-ab-boot dm-verity-none "

# Sizes for EXT4 (in bytes)
SYSTEM_SIZE_EXT4  ?= "268435456"
USERDATA_SIZE_EXT4 ?= "251658240"

SDCARD_DEVICE = "mmcblk1p1"
SLOT_A_SUFFIX = ""

# Formats of root filesystem images
IMAGE_FSTYPES += "ext4"
#MACHINE_SUPPORTS_INIT_RAMDISK = "True"
#TOYBOX_RAMDISK = "True"
MACHINE_FSCONFIG_CONF = "sa525m-emmc-fsconfig.conf"

# File indicating firmware residing places on device.
MACHINE_FILESMAP_CONF_EMMC = "sa525m-emmc-filesmap"

MACHINE_PARTITION_CONF = "sa525m-partition.conf"

MACHINE_FEATURES_remove += "qti-recovery qti-bluetooth qti-nad-telaf qti-nad-mrc dm-verity-initramfs-v4"

FLAVOR = "pvm"
```

## conf/machine/sdxpinn-ab.conf
```bitbake
#@TYPE: Machine
#@NAME: SDXPINN-AB
#@DESCRIPTION: Machine configuration for SDXPINN-AB
BASEMACHINE ?= "sdxpinn"

require ${COREBASE}/meta-qti-bsp/conf/machine/sdxpinn.conf

MACHINE_FEATURES += "qti-ab-boot qti-recoveryinfo"

MACHINE_FEATURES_remove += "qti-recovery"

MACHINE_PARTITION_CONF = "sdxpinn-ab-partition.conf"

GENERATE_AB_OTA_PACKAGE = "1"
```

## conf/machine/sdxpinn.conf
```bitbake
#@TYPE: Machine
#@NAME: SDXPINN
#@DESCRIPTION: Machine configuration for SDXPINN
BASEMACHINE ?= "sdxpinn"
require conf/machine/include/basemachine.inc

include conf/machine/include/arm/arch-armv8a.inc

PREFERRED_PROVIDER_virtual/kernel = "linux-msm"
PREFERRED_PROVIDER_virtual/mkbootimg = "mkbootimg-gki"
PREFERRED_PROVIDER_virtual/mkdtimg   = "mkdtimg-gki"
#PREFERRED_PROVIDER_virtual/dtc-native = "dtc-android-build-native"
PREFERRED_VERSION_linux-msm ?= "5.15"
PREFERRED_VERSION_linux-msm-headers ?= "5.15"
PREFERRED_VERSION_kernel-toolchain ?= "5.15"
PREFERRED_VERSION_dtc-android-build ?= "5.15"
PREFERRED_VERSION_mkbootimg-gki ?= "5.15"
PREFERRED_VERSION_mod-signing-keys ?= "5.15"
PREFERRED_VERSION:securemsmdlkm ?= "1.0"

#### KERNEL ####
MACHINE_USES_KERNEL_PREBUILTS = "True"
KERNEL_VARIANT = ""
KERNEL_VARIANT_qti-distro-nogplv3-debug = "debug_"
KERNEL_VARIANT_qti-distro-nogplv3-perf = "perf_"
KERNEL_VARIANT_qti-distro-nogplv3-user = "user_"
INITRAMFS_IMAGE = "qti-ramdisk-image"
INITRAMFS_FSTYPES = "cpio.lz4"
VENDOR_INITRAMFS_IMAGE = "qti-vendor-ramdisk-image"
KERNEL_DEFCONFIG = "msm-kernel-sdxpinn-cpe-wkk-${KERNEL_VARIANT}defconfig"
KERNEL_CONFIG = "build.config.msm.sdxpinn-cpe-wkk"

#Various kernel directories
KERNEL_PLATFORM_PATH = "${WORKSPACE}/kernel-5.15/kernel_platform"
KERNEL_PREBUILT_PATH = "${WORKSPACE}/kernel-5.15/out/${KERNEL_DEFCONFIG}"
KERNEL_PREBUILT_DISTDIR = "${WORKSPACE}/kernel-5.15/out/${KERNEL_DEFCONFIG}/dist"
KERNEL_BUILD_CONFIG = "msm-kernel/${KERNEL_CONFIG}"
KERNEL_OUT_PATH = "${KERNEL_PREBUILT_PATH}"

#### dtb ####
KERNEL_DTB_NAMES   = " \
        vendor/qcom/sdxpinn-idp-cpe.dtb \
        vendor/qcom/sdxpinn-idp-cpe-v2.dtb \
        vendor/qcom/sdxpinn-idp-mbb.dtb \
        vendor/qcom/sdxpinn-idp-mbb-v2.dtb \
"
MACHINE_SUPPORTS_DTBO = "0"
BUILD_WITH_TECHPACKS = "1"
SKIP_VENDOR_BOOT = "False"

#### boot.img ####
KERNEL_IMAGETYPE = "Image"
KERNEL_BASE = "0x80000000"
KERNEL_TAGS_OFFSET = "0x80000000"
BOOT_HEADER_VERSION = "2"

#### cmdline ####
# use no gpl V3
CONSOLE_PARAM:qti-distro-perf  = "console=ttyMSM0,115200n8"
CONSOLE_PARAM:qti-distro-debug = "ro rootwait console=ttyMSM0,115200,n8 androidboot.hardware=qcom msm_rtb.filter=0x237 androidboot.console=ttyMSM0 lpm_levels.sleep_disabled=1 firmware_class.path=/lib/firmware/updates service_locator.enable=1 net.ifnames=0 atlantic_fwd.rx_ring_size=512 atlantic_fwd.rx_linear=1 pcie_ports=compat pci=pcie_bus_perf"
KERNEL_CMD_PARAMS = "${CONSOLE_PARAM}"

#### systemd ####
SERIAL_CONSOLES ?= "115200;ttyMSM0"

#### others ####
PAGE_SIZE ?= '4096'

#Abl would be enabled later
EXTRA_IMAGEDEPENDS += "edk2"
PREFERRED_VERSION:edk2 ?= "4.0"

# TODO: Temporary change to override BB_SIGNATURE_HANDLER set in local.conf.
# Other machines are already supporting OEEquivHash as hashing signature.
# Fix build issues observed in this machine and remove this override.
BB_SIGNATURE_HANDLER = "OEBasicHash"

#QSEEComCompat and QSEECom are mutually exlusive and QSEEComCompat depends on  smcinvoke
#lv-build builds the required listernes , le_qseecom enables qseecomd
# qti-location:           Machine supports Location solution
MACHINE_FEATURES += "dm-verity-none emmc_boot nand_boot qti-recovery qti-location qwesd"

##############################################################

# SElinux enablement in enforcing mode

#############################################################

# DEFAULT_ENFORCING = "permissive"
MACHINE_MNT_POINTS = " \
        /persist \
        /cache \
        /data \
        /nvram \
        /rdklogs \
        /firmware \
        /systemrw \
"

PAGE_SIZE ?= '4096'
UBINIZE_ARGS ?= "-m 4096 -p 256KiB -s 4096"
MKUBIFS_ARGS ?= "-m 4096 -e 253952 -c 2146 -F"
# Sysfs ubi volume sizes
SYSTEM_VOLUME_SIZE ?= "110MiB"
# rootfs volume size for 1GB storage
SYSTEM_VOLUME_SIZE_G ?= "214MiB"
CACHE_VOLUME_SIZE ?= "15MiB"
SYSTEMRW_VOLUME_SIZE ?= "6MiB"
PERSIST_VOLUME_SIZE ?= "6MiB"
SYSTEM_SIZE_EXT4   ?= "268435456"
NVRAM_SIZE_EXT4   ?= "52428800"
# USERDATA_SIZE ?= "200GiB"

# Formats of root filesystem images
IMAGE_FSTYPES += "ext4 ubi"
MACHINE_SUPPORTS_PDMAPPER = "True"
MACHINE_SUPPORTS_ANDROID_PROPERTIES = "False"
# Subsystem Ramdump support
MACHINE_SUPPORTS_SSR = "True"

MACHINE_FSCONFIG_CONF = "sdxpinn-fsconfig.conf"

USBCOMPOSITION = "4EE7"

MACHINE_SUPPORTS_INIT_RAMDISK = "False"
MACHINE_SUPPORTS_ADB_OVER_PCIE = "True"
MACHINE_SUPPORTS_DIAG_OVER_PCIE = "True"

# Partition conf
MACHINE_PARTITION_CONF = "sdxpinn-partition.conf"

# File indicating firmware residing places on device.
MACHINE_FILESMAP_CONF_EMMC = "sdxpinn-filesmap"
MACHINE_FILESMAP_CONF = "sdxpinn-filesmap"

# On msm-5.4 or above ufs driver supports BSG Device.
UFS_BSG_DEV_USAGE = "True"

### MACHINE_FEATURES ###
DISTRO_FEATURES:remove = "selinux"

GENERATE_AB_OTA_PACKAGE = "0"
```
