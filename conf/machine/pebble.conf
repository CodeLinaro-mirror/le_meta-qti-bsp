## meta-qti-base/conf/layer.conf
```bitbake
# We have a conf and classes directory, add to BBPATH
BBPATH .= ":${LAYERDIR}"
BSPDIR := "${@os.path.abspath(os.path.dirname(d.getVar('FILE', True)) + '/../../..')}"

# We have recipes-* directories, add to BBFILES
BBFILES += "${LAYERDIR}/recipes-*/*/*.bb \
            ${LAYERDIR}/recipes-*/*/*.bbappend"

BBFILES_DYNAMIC += " \
    aglcore:${LAYERDIR}/dynamic-layers/meta-agl-core/*/*/*.bb \
    aglcore:${LAYERDIR}/dynamic-layers/meta-agl-core/*/*/*.bbappend \
    agldemo:${LAYERDIR}/dynamic-layers/meta-agl-demo/*/*/*.bb \
    agldemo:${LAYERDIR}/dynamic-layers/meta-agl-demo/*/*/*.bbappend \
    meta-qti-dpk:${LAYERDIR}/dynamic-layers/meta-qti-dpk/*/*/*.bb \
    meta-qti-dpk:${LAYERDIR}/dynamic-layers/meta-qti-dpk/*/*/*.bbappend \
"

BBFILE_COLLECTIONS += "qti"
BBFILE_PATTERN_qti = "^${LAYERDIR}/"
BBFILE_PRIORITY_qti = "10"

LAYERSERIES_COMPAT_qti = "kirkstone"

LAYERDEPENDS_qti = "core openembedded-layer networking-layer multimedia-layer qti-upstream qti-prop"

LICENSE_PATH += "${LAYERDIR}/files/common-licenses"

# Currently edk2 need python2 to support compilation
HOSTTOOLS_NONFATAL += "python python2"

QTI_METAPATH_BASE := '${@os.path.normpath("${LAYERDIR}/")}'
QTI_LICENSE_DIR = "${QTI_METAPATH_BASE}/files/common-licenses"
```

## meta-qti-base/conf/machine/gh-gvm-gen5.conf
```bitbake
#@TYPE: Machine
#@NAME: gh-gvm-gen5
#@DESCRIPTION: Machine configuration for QTI SH GVM NORD(GEN5) Platform

BASEMACHINE ?= "gh-gvm-gen5"
include conf/machine/include/auto-common.inc

#MASK unused recipe in target
include conf/machine/include/gvm-bbmask.inc
include conf/distro/include/gvm-bbmask-prop.inc

include conf/machine/include/tune-cortexa78c.inc

PREFERRED_PROVIDER_dtc-native = "dtc-aosp-native"

PREFERRED_VERSION_linux-msm = "6.12"
PREFERRED_VERSION_linux-msm-headers = "6.12"
PREFERRED_VERSION_adsprpc = "2.0"
PREFERRED_VERSION_media-codec2 = "auto.1.0"
PREFERRED_VERSION_media-external = "auto.1.0"
PREFERRED_VERSION_media-noship = "auto.1.0"
#PREFERRED_VERSION_codec2-service = "auto.1.0"

# lemans gvm prefer camx
PREFERRED_VERSION_cameradlkm = "0.2"

KERNEL_ARCH = "autoghgvm"
KERNEL_VARIANT = "${@bb.utils.contains_any('VARIANT', 'perf user', 'perf_', 'debug_', d)}"
KERNEL_BUILD_CONFIG = "msm-kernel/build.config.msm.${KERNEL_ARCH}.lxc"
KERNEL_IMAGE_HEADER_VERSION = "2"

KERNEL_BASE = "0x80000000"
KERNEL_TAGS_OFFSET = "0x1e00000"
KERNEL_CONFIG = "${@['vendor/autoghgvm_defconfig', 'vendor/autoghgvm-debug_defconfig'][d.getVar('VARIANT', True) == ('' or 'debug')]}"
KERNEL_CMD_PARAMS = " "
KERNEL_IMAGETYPE = "Image"

MACHINE_FEATURES += "\
    qti-core \
    qti-hypervisor \
"
```
