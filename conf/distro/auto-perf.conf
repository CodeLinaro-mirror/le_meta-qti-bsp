## conf/distro/include/security_flags.inc
```bitbake
# Pull in the default security flags
require ${COREBASE}/meta/conf/distro/include/security_flags.inc
# Modify the primary security flag definitions
SECURITY_PIE_CFLAGS = "-fstack-protector-strong -pie -fpie -Wa,--noexecstack -D_FORTIFY_SOURCE=2"
SECURITY_PIC_CFLAGS = "-fstack-protector-strong -fPIC -Wa,--noexecstack -D_FORTIFY_SOURCE=2"

SECURITY_CFLAGS = "${SECURITY_PIE_CFLAGS}"
SECURITY_LDFLAGS = "-Wl,-z,relro,-z,now,-z,noexecstack"

# GPS OSS packages to use -fPIC in security flags instead of -fpie
SECURITY_CFLAGS_pn-loc-core = "${SECURITY_PIC_CFLAGS}"
SECURITY_CFLAGS_pn-location-api = "${SECURITY_PIC_CFLAGS}"
SECURITY_CFLAGS_pn-location-client-api = "${SECURITY_PIC_CFLAGS}"
SECURITY_CFLAGS_pn-loc-socket = "${SECURITY_PIC_CFLAGS}"
SECURITY_CFLAGS_pn-location-api-iface = "${SECURITY_PIC_CFLAGS}"
SECURITY_CFLAGS_pn-location-integration-api = "${SECURITY_PIC_CFLAGS}"
SECURITY_CFLAGS_pn-location-api-msg-proto = "${SECURITY_PIC_CFLAGS}"
SECURITY_CFLAGS_pn-asn1c-rtx = "${SECURITY_PIC_CFLAGS}"
SECURITY_CFLAGS_pn-asn1c-crt = "${SECURITY_PIC_CFLAGS}"
SECURITY_CFLAGS_pn-loc-diag-iface = "${SECURITY_PIC_CFLAGS}"
SECURITY_CFLAGS_pn-asn1c-cper = "${SECURITY_PIC_CFLAGS}"
SECURITY_CFLAGS_pn-location-qapi = "${SECURITY_PIC_CFLAGS}"
SECURITY_CFLAGS_pn-loc-api-v02 = "${SECURITY_PIC_CFLAGS}"
SECURITY_CFLAGS_pn-loc-hal = "${SECURITY_PIC_CFLAGS}"
SECURITY_CFLAGS_pn-loc-pla = "${SECURITY_PIC_CFLAGS}"
SECURITY_CFLAGS_pn-loc-stub = "${SECURITY_PIC_CFLAGS}"
SECURITY_CFLAGS_pn-gps-utils = "${SECURITY_PIC_CFLAGS}"
SECURITY_CFLAGS_pn-loc-net-iface = "${SECURITY_PIC_CFLAGS}"
SECURITY_CFLAGS_pn-loc-base-util = "${SECURITY_PIC_CFLAGS}"
SECURITY_CFLAGS_pn-loc-mq-client = "${SECURITY_PIC_CFLAGS}"
SECURITY_CFLAGS_pn-izat-core = "${SECURITY_PIC_CFLAGS}"
SECURITY_CFLAGS_pn-lowi-client = "${SECURITY_PIC_CFLAGS}"
SECURITY_CFLAGS_pn-lbs-core = "${SECURITY_PIC_CFLAGS}"
SECURITY_CFLAGS_pn-drplugin-client = "${SECURITY_PIC_CFLAGS}"
SECURITY_CFLAGS_pn-drplugin = "${SECURITY_PIC_CFLAGS}"
SECURITY_CFLAGS_pn-ulp2 = "${SECURITY_PIC_CFLAGS}"
SECURITY_CFLAGS_pn-location-flp = "${SECURITY_PIC_CFLAGS}"
SECURITY_CFLAGS_pn-location-service = "${SECURITY_PIC_CFLAGS}"
SECURITY_CFLAGS_pn-loc-glue = "${SECURITY_PIC_CFLAGS}"
SECURITY_CFLAGS_pn-nlp-client-api = "${SECURITY_PIC_CFLAGS}"
SECURITY_CFLAGS_pn-xt-adapter = "${SECURITY_PIC_CFLAGS}"

# packages to use -fPIC in security flags instead of -fpie
SECURITY_CFLAGS_pn-gtest = "${SECURITY_PIC_CFLAGS}"
SECURITY_CFLAGS_pn-libcutils  = "${SECURITY_PIC_CFLAGS}"
SECURITY_CFLAGS_pn-liblog  = "${SECURITY_PIC_CFLAGS}"

# libutils to use -fPIC in security flags instead of -fpie
SECURITY_CFLAGS_pn-system-core = "${SECURITY_PIC_CFLAGS}"
SECURITY_CFLAGS_pn-lib32-system-core = "${SECURITY_PIC_CFLAGS}"
SECURITY_CFLAGS_pn-libbase = "${SECURITY_PIC_CFLAGS}"
SECURITY_CFLAGS_pn-lib32-libbase = "${SECURITY_PIC_CFLAGS}"
SECURITY_CFLAGS_pn-event-observer = "${SECURITY_PIC_CFLAGS}"
SECURITY_CFLAGS_pn-data-items = "${SECURITY_PIC_CFLAGS}"
# libbinder to use -fPIC in security flags instead of -fpie
SECURITY_CFLAGS_pn-native-frameworks  = "${SECURITY_PIC_CFLAGS}"
SECURITY_CFLAGS_pn-av-frameworks  = "${SECURITY_PIC_CFLAGS}"

# BT OSS packages to use -fPIC in security flags instead of -fpie
SECURITY_CFLAGS_pn-bt-property_mdm = "${SECURITY_PIC_CFLAGS}"
SECURITY_CFLAGS_pn-bt-app_mdm = "${SECURITY_PIC_CFLAGS}"
SECURITY_CFLAGS_pn-libbt-vendor_mdm = "${SECURITY_PIC_CFLAGS}"
SECURITY_CFLAGS_pn-fluoride = "${SECURITY_PIC_CFLAGS}"

SECURITY_CFLAGS_pn-display-hal = "${SECURITY_PIC_CFLAGS}"
SECURITY_CFLAGS_pn-media = "${SECURITY_PIC_CFLAGS}"
SECURITY_CFLAGS_pn-lib32-media = "${SECURITY_PIC_CFLAGS}"
SECURITY_CFLAGS_pn-qmmf-sdk = "${SECURITY_PIC_CFLAGS}"
SECURITY_CFLAGS_pn-lib32-qmmf-sdk = "${SECURITY_PIC_CFLAGS}"
```

## conf/distro/include/security_flags_msm8996.inc
```bitbake
SECURITY_CFLAGS_pn-liblog = ""
SECURITY_CFLAGS_pn-ext4-utils = ""
SECURITY_CFLAGS_pn-system-core = ""
SECURITY_CFLAGS_pn-dbus-c++ = ""

SECURITY_CFLAGS_pn-media = "${SECURITY_NO_PIE_CFLAGS}"
SECURITY_LDFLAGS_pn-iptables = "${SECURITY_X_LDFLAGS}"
SECURITY_CFLAGS_pn-gstreamer1.0-qcarcamsrc = "${SECURITY_NO_PIE_CFLAGS}"
SECURITY_CFLAGS_pn-pugixml = ""
SECURITY_CFLAGS_pn-data = ""
```

## conf/distro/nad.conf
```bitbake
BASEDISTRO ?= "auto"
require conf/distro/auto.conf

DISTRO_NAME = "nad-core"

PRODUCT = "auto"

# enable squahfs
DISTRO_FEATURES += "nand-squashfs"

DISTRO_FEATURES += "ab-boot-support"
DISTRO_FEATURES_NATIVE += "ab-boot-support"

# enable nand-ab
DISTRO_FEATURES += "nand-ab"

# NAD related partition changes are enabled under this distro
DISTRO_FEATURES += "nad-prod"

# enable modem-volume
DISTRO_FEATURES_append = " modem-volume"

# telaf specific features
DISTRO_FEATURES += "nad-telaf"

# Limiting squashfs rootfs size to 70MiB (size should be multiple of LEB, LEB is 253952 bytes)
SYSTEM_SQUASHFS_VOLUME_SIZE ?= "73646080"

CACHE_VOLUME_SIZE = "20MiB"

# Image names
UBIFS_UBI_IMAGE      = "${MACHINE}-sysfs-ubifs.ubi"
OUTPUT_FILE_FINAL_SQUASHFS_UBI = "${DEPLOY_DIR_IMAGE_NAND}/${MACHINE}-sysfs.ubi"
SQUASHFS_SYS_VOLUME = "system.squash"
RECOVERYFS_SQUASHFS_UBI_IMAGE = "${DEPLOY_DIR_IMAGE_NAND}/${MACHINE}-recoveryfs.ubi"
RECOVERYFS_SQUASHFS_IMAGE = "${DEPLOY_DIR_IMAGE_NAND}/recoveryfs.squash"
RECOVERYFS_UBIFS_UBI_IMAGE = "${DEPLOY_DIR_IMAGE_NAND}/${MACHINE}-recoveryfs-ubifs.ubi"

DISTRO_FEATURES_append = " nad-prod-test"
```

## conf/distro/robot-ros.conf
```bitbake
BASEDISTRO ?= "robot"
require conf/distro/msm.conf

DISTRO_NAME = "robot-ros"
DISTROOVERRIDES =. "robot-ros:"

SYSTEM_SIZE_EXT4 = "5368709120"

PRODUCT = "robot"
PREFERRED_VERSION_v4l-utils = "1.6.2"
```

## conf/layer.conf
```bitbake
BBPATH .= ":${LAYERDIR}"

BBFILE_COLLECTIONS        += "qti-bsp"
BBFILE_PRIORITY_qti-bsp    = "10"
BBFILE_PATTERN_qti-bsp    := "^${LAYERDIR}/"

LAYERSERIES_COMPAT_qti-bsp = "kirkstone scarthgap"

LICENSE_PATH += "${LAYERDIR}/files/common-licenses"

# Set a variable to get to the top of the metadata location
QTIBASE = '${@os.path.normpath("${LAYERDIR}/")}'

# Tools needed on the build host for usage within build tasks by recipes of this layer.
HOSTTOOLS_NONFATAL += "xgettext msgmerge msgfmt gmsgfmt java zip"

BBFILES += " ${LAYERDIR}/recipes-*/*/*.bb \
             ${LAYERDIR}/recipes-*/*/*.bbappend"

BBFILES_DYNAMIC += " \
    virtualization-layer:${LAYERDIR}/dynamic-layers/virtualization-layer/*/*/*.bbappend \
"

QCOM_COMMON_LICENSE_DIR = "${@os.path.normpath("${LAYERDIR}")+'/files/common-licenses/'}"

BBMASK += " \
      ${@bb.utils.contains('LAYERSERIES_COMPAT_core','kirkstone','meta-qti-bsp/recipes-core/systemd/systemd_255.%.bbappend','',d)} \
      ${@bb.utils.contains('LAYERSERIES_COMPAT_core','kirkstone','base-passwd_3.6.3.bbappend','',d)} \
"
```

## conf/machine/8x96auto.conf
```bitbake
#@TYPE: Machine
#@NAME: msm8996

#@DESCRIPTION: Machine configuration for msm systems

require conf/machine/include/8x96auto.inc

MACHINE_EXTRA_RRECOMMENDS = " kernel-modules kernel-devicetree"

IMAGE_FSTYPES += "tar.bz2 ext4"

PREFERRED_PROVIDER_virtual/kernel = "linux-quic"

#
# Graphics driver essentials
#
PREFERRED_PROVIDER_virtual/wayland-egl  = "adreno"
PREFERRED_PROVIDER_virtual/egl          = "adreno"
PREFERRED_PROVIDER_virtual/libgles1     = "adreno"
PREFERRED_PROVIDER_virtual/libgles2     = "adreno"

KERNEL_IMAGETYPE ?= "Image"
KERNEL_DEVICETREE ?= "qcom/apq8096pro-auto-cdp.dtb qcom/apq8096pro-v1.1-auto-adp.dtb qcom/apq8096pro-v1.1-auto-adp-lite.dtb qcom/apq8096pro-v1.1-auto-cdp.dtb qcom/apq8096-v2-auto-dragonboard.dtb qcom/apq8096-v3-auto-adp.dtb qcom/apq8096-v3-auto-cdp.dtb qcom/apq8096-v3-auto-dragonboard.dtb qcom/msm8996pro-auto-adp.dtb qcom/msm8996pro-auto-adp-lite.dtb qcom/msm8996pro-auto-cdp.dtb qcom/msm8996pro-v1.1-auto-cdp.dtb qcom/msm8996-v3-auto-adp.dtb qcom/msm8996-v3-auto-cdp.dtb"
KERNEL_DTS_NAME = "msm8996"
KERNEL_BASE = "0x80000000"
KERNEL_TAGS_OFFSET = "0x81900000"
KERNEL_CMD_PARAMS = "console=ttyHSL0,115200,n8 androidboot.console=ttyHSL0 androidboot.hardware=qcom user_debug=31 msm_rtb.filter=0x237 ehci-hcd.park=3 lpm_levels.sleep_disabled=1 cma=16M@0-0xffffffff rootwait rootfstype=ext4 root=/dev/mmcblk0p18"
RECOVERY_CMD_PARAMS ?= "console=ttyHSL0,115200,n8 androidboot.console=ttyHSL0 androidboot.hardware=qcom user_debug=31 msm_rtb.filter=0x237 ehci-hcd.park=3 lpm_levels.sleep_disabled=1 cma=16M@0-0xffffffff rootfstype=ramfs root=/dev/ram0 rdinit=/sbin/init"


KERNEL_DEFCONFIG = "msm-auto_defconfig"
KERNEL_PERF_DEFCONFIG = "msm-auto-perf_defconfig"

# Sizes for EXT4 (in bytes)
USERDATA_SIZE_EXT4 = "2000000000"
CACHE_SIZE_EXT4 = "80000000"

DISTRO_FEATURES_append = " persist-image"
```

## conf/machine/8x96auto44.conf
```bitbake
#@TYPE: Machine
#@NAME: 8x96auto44

#@DESCRIPTION: Machine configuration for 8x96auto kernel4.4

require conf/machine/include/8x96auto.inc

MACHINE_EXTRA_RRECOMMENDS = " kernel-modules kernel-devicetree"

IMAGE_FSTYPES += "tar.bz2 ext4"

PREFERRED_PROVIDER_virtual/kernel = "linux-msm-4.4-8996"

CONSOLE_DEVICE = "ttyMSM0"

#
# Graphics driver essentials
#
PREFERRED_PROVIDER_virtual/wayland-egl  = "adreno"
PREFERRED_PROVIDER_virtual/egl          = "adreno"
PREFERRED_PROVIDER_virtual/libgles1     = "adreno"
PREFERRED_PROVIDER_virtual/libgles2     = "adreno"

KERNEL_IMAGETYPE ?= "Image.gz-dtb"
KERNEL_DTS_NAME = "msm8996"
KERNEL_BASE = "0x80000000"
KERNEL_TAGS_OFFSET = "0x81900000"
KERNEL_CMD_PARAMS = "console=${CONSOLE_DEVICE},115200,n8 androidboot.console=${CONSOLE_DEVICE} androidboot.hardware=qcom user_debug=31 msm_rtb.filter=0x237 ehci-hcd.park=3 lpm_levels.sleep_disabled=1 cma=16M@0-0xffffffff rootwait rootfstype=ext4 root=/dev/mmcblk0p18"

KERNEL_DEFCONFIG = "msm-auto_defconfig"
KERNEL_PERF_DEFCONFIG = "msm-auto-perf_defconfig"

SERIAL_CONSOLE = "115200 ${CONSOLE_DEVICE}"
```

## conf/machine/8x96autocv2x.conf
```bitbake
#@TYPE: Machine
#@NAME: msm8996 cv2x

#@DESCRIPTION: Machine configuration for msm systems

require conf/machine/include/auto-common.inc

MACHINE_EXTRA_RRECOMMENDS = " kernel-modules kernel-devicetree"

PREFERRED_PROVIDER_virtual/kernel = "linux-msm-4.4"

CONSOLE_DEVICE = "ttyMSM0"

KERNEL_IMAGETYPE ?= "Image"
KERNEL_DEVICETREE ?= "qcom/msm8996pro-auto-cv2x.dtb"
KERNEL_DTS_NAME = "msm8996"
KERNEL_BASE = "0x80000000"
KERNEL_TAGS_OFFSET = "0x81900000"
KERNEL_CMD_PARAMS = "console=${CONSOLE_DEVICE},115200,n8 androidboot.console=${CONSOLE_DEVICE} androidboot.hardware=qcom user_debug=31 msm_rtb.filter=0x237 ehci-hcd.park=3 cma=16M@0-0xffffffff rootwait rootfstype=ext4 root=/dev/sde18 oops=panic"
RECOVERY_CMD_PARAMS = "console=${CONSOLE_DEVICE},115200,n8 androidboot.console=${CONSOLE_DEVICE} androidboot.hardware=qcom user_debug=31 msm_rtb.filter=0x237 ehci-hcd.park=3 lpm_levels.sleep_disabled=1 cma=16M@0-0xffffffff rootfstype=ramfs root=/dev/ram0 rdinit=/sbin/init"

SERIAL_CONSOLE = "115200 ${CONSOLE_DEVICE}"

PACKAGECONFIG_append_pn-connman = " vpnc ipsecvici"
PACKAGECONFIG_append_pn-strongswan = " swanctl systemd-charon"

PREFERRED_VERSION_qcacld-hl = "2.0"
```

## conf/machine/8x96autodvrs.conf
```bitbake
#@TYPE: Machine
#@NAME: msm8996

#@DESCRIPTION: Machine configuration for 8x96autodvrs kernel4.4

require conf/machine/include/auto-common.inc

MACHINE_FEATURES_BACKFILL_remove = "qemu-usermode"

# support early-ethernet feature
DISTRO_FEATURES_append += "early-ethernet"
MACHINE_EXTRA_RRECOMMENDS = " kernel-modules kernel-devicetree"

PREFERRED_PROVIDER_virtual/kernel = "linux-msm-4.4"

CONSOLE_DEVICE = "ttyMSM0"

KERNEL_IMAGETYPE ?= "Image"
KERNEL_DEVICETREE ?= "qcom/apq8096pro-auto-cdp.dtb qcom/apq8096pro-v1.1-auto-adp.dtb qcom/apq8096pro-v1.1-auto-adp-lite.dtb qcom/apq8096pro-v1.1-auto-cdp.dtb qcom/apq8096-v2-auto-dragonboard.dtb qcom/apq8096-v3-auto-adp.dtb qcom/apq8096-v3-auto-cdp.dtb qcom/apq8096-v3-auto-dragonboard.dtb qcom/msm8996pro-auto-adp.dtb qcom/msm8996pro-auto-adp-lite.dtb qcom/msm8996pro-auto-cdp.dtb qcom/msm8996pro-v1.1-auto-cdp.dtb qcom/msm8996-v3-auto-adp.dtb qcom/msm8996-v3-auto-cdp.dtb qcom/msm8996-v3-pm8004-agave-adp.dtb qcom/msm8996-v3-pm8004-agave-adp-lite.dtb qcom/msm8996-v3-pm8004-mmxf-adp.dtb"
KERNEL_DTS_NAME = "msm8996"
KERNEL_BASE = "0x80000000"
KERNEL_TAGS_OFFSET = "0x81900000"
KERNEL_CMD_PARAMS = "console=${CONSOLE_DEVICE},115200,n8 androidboot.console=${CONSOLE_DEVICE} androidboot.hardware=qcom user_debug=31 msm_rtb.filter=0x237 ehci-hcd.park=3 cma=16M@0-0xffffffff rootwait rootfstype=ext4 root=/dev/mmcblk0p18 fsck.repair=yes firmware_class.path=/firmware/image/ swiotlb=128 oops=panic"
KERNEL_PERF_CMD_PARAMS = "console=${CONSOLE_DEVICE},115200,n8 androidboot.console=${CONSOLE_DEVICE} androidboot.hardware=qcom user_debug=31 msm_rtb.filter=0x237 ehci-hcd.park=3 cma=16M@0-0xffffffff rootwait rootfstype=ext4 root=/dev/mmcblk0p18 fsck.repair=yes firmware_class.path=/firmware/image/ swiotlb=128 oops=panic"
RECOVERY_CMD_PARAMS = "console=${CONSOLE_DEVICE},115200,n8 androidboot.console=${CONSOLE_DEVICE} androidboot.hardware=qcom user_debug=31 msm_rtb.filter=0x237 ehci-hcd.park=3 lpm_levels.sleep_disabled=1 cma=16M@0-0xffffffff rootfstype=ramfs root=/dev/ram0 rdinit=/sbin/init firmware_class_path=/firmware/image/off_disp_ser"
SERIAL_CONSOLE = "115200 ${CONSOLE_DEVICE}"

PACKAGECONFIG_append_pn-connman = " vpnc ipsecvici"
PACKAGECONFIG_append_pn-strongswan = " swanctl systemd-charon"

BBMASK_append = "|meta-qti-display/recipes-products/images/machine-qsap-image.bbappend"
BBMASK_append = "|meta-qti-display/recipes-products/images/machine-image.bbappend"
BBMASK_append = "|meta-qti-display/recipes-products/images/machine-minimal-image.bbappend"
BBMASK_append = "|meta-qti-display/recipes/drm/libdrm_%.bbappend"
BBMASK_append = "|meta-qti-display/recipes/wayland/wayland_1.9.0.bb"
BBMASK_append = "|meta-qti-display/recipes/wayland/weston-init.bbappend"
BBMASK_append = "|meta-qti-display/recipes/wayland/weston_1.9.0.bbappend"
BBMASK_append = "|meta-qti-bsp/recipes-display/display-hal/display-hal-linux_git.bb"
BBMASK_append = "|meta-qti-bsp/recipes-display/display-hal/display-hal_git.bb"
BBMASK_append = "|meta-qti-bsp/recipes-display/sdm/sdm.bb"
BBMASK_append = "|meta-qti-bsp/recipes-graphics/wayland/weston_%.bbappend"
```

## conf/machine/8x96autofusion.conf
```bitbake
#@TYPE: Machine
#@NAME: msm8996

#@DESCRIPTION: Machine configuration for msm systems

require conf/machine/include/auto-common.inc

MACHINE_EXTRA_RRECOMMENDS = " kernel-modules kernel-devicetree"

PREFERRED_PROVIDER_virtual/kernel = "linux-msm-4.4"

CONSOLE_DEVICE = "ttyMSM0"

KERNEL_IMAGETYPE ?= "Image"

KERNEL_DEVICETREE ?= "qcom/msm8996pro-auto-fusion.dtb qcom/apq8096pro-auto-cdp.dtb qcom/apq8096pro-v1.1-auto-adp.dtb qcom/apq8096pro-v1.1-auto-adp-lite.dtb qcom/apq8096pro-v1.1-auto-cdp.dtb qcom/apq8096-v2-auto-dragonboard.dtb qcom/apq8096-v3-auto-adp.dtb qcom/apq8096-v3-auto-cdp.dtb qcom/apq8096-v3-auto-dragonboard.dtb qcom/msm8996pro-auto-adp.dtb qcom/msm8996pro-auto-adp-lite.dtb qcom/msm8996pro-auto-cdp.dtb qcom/msm8996pro-v1.1-auto-cdp.dtb qcom/msm8996-v3-auto-adp.dtb qcom/msm8996-v3-auto-cdp.dtb qcom/msm8996-v3-pm8004-agave-adp.dtb qcom/msm8996-v3-pm8004-agave-adp-lite.dtb qcom/msm8996-v3-pm8004-mmxf-adp.dtb"
KERNEL_DTS_NAME = "msm8996"
KERNEL_BASE = "0x80000000"
KERNEL_TAGS_OFFSET = "0x81900000"


PACKAGECONFIG_append_pn-connman = " vpnc ipsecvici"
PACKAGECONFIG_append_pn-strongswan = " swanctl systemd-charon"


KERNEL_CMD_PARAMS = "console=${CONSOLE_DEVICE},115200,n8 androidboot.console=${CONSOLE_DEVICE} androidboot.hardware=qcom user_debug=31 msm_rtb.filter=0x237 ehci-hcd.park=3 cma=16M@0-0xffffffff rootwait rootfstype=ext4 root=/dev/mmcblk0p18 oops=panic"
RECOVERY_CMD_PARAMS ?= "console=${CONSOLE_DEVICE},115200,n8 androidboot.console=${CONSOLE_DEVICE} androidboot.hardware=qcom user_debug=31 msm_rtb.filter=0x237 ehci-hcd.park=3 lpm_levels.sleep_disabled=1 cma=16M@0-0xffffffff rootfstype=ramfs root=/dev/ram0 rdinit=/sbin/init"

SERIAL_CONSOLE = "115200 ${CONSOLE_DEVICE}"
```
