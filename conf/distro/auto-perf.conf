## conf/machine/8x96autogvmga.conf
```bitbake
#@TYPE: Machine
#@NAME: msm8996

#@DESCRIPTION: Machine configuration for msm systems.

MACHINE_EXTRA_RRECOMMENDS = " kernel-modules kernel-devicetree"

require conf/machine/include/8x96autogvmga.inc

IMAGE_FSTYPES += "tar.bz2 ext4"

PREFERRED_PROVIDER_virtual/kernel = "linux-gvm-4.4"

#
# Graphics driver essentials
#
PREFERRED_PROVIDER_virtual/wayland-egl  = "adreno"
PREFERRED_PROVIDER_virtual/egl          = "adreno"
PREFERRED_PROVIDER_virtual/libgles1     = "adreno"
PREFERRED_PROVIDER_virtual/libgles2     = "adreno"

SERIAL_CONSOLE ?= "115200 hvc0"

KERNEL_IMAGETYPE ?= "Image"
KERNEL_DEVICETREE ?= "qcom/vplatform-lfv-msm8996.dtb"
KERNEL_DTS_NAME = "vplatform-lfv-msm8996"
KERNEL_BASE ?= "0x80000000"
#TODO: dynamically set root device based on board version
KERNEL_CMDLINE ?= "console=hvc0,115200"

KERNEL_DEFCONFIG = "msm-auto-gvm_defconfig"
KERNEL_PERF_DEFCONFIG = "msm-auto-gvm-perf_defconfig"
KERNEL_PATCH ?= ""
OVERRIDES .= "${@':kernelpatchok' if '${KERNEL_PATCH}' != 'conflict' else ''}"

# Sizes for EXT4 (in bytes)
USERDATA_SIZE_EXT4 = "2000000000"
CACHE_SIZE_EXT4 = "80000000"

DISTRO_FEATURES_append = " persist-image"

INCOMPATIBLE_LICENSE = "GPL-3.0 LGPL-3.0 AGPL-3.0 GPLv3+ LGPLv2.1+"

BBMASK_append = "|meta-qti-bsp/recipes-devtools/log4cxx/log4cxx_svn.bbappend"
BBMASK_append = "|meta-qti-bsp/recipes-devtools/yaml-cpp/yaml-cpp_%.bbappend"
BBMASK_append = "|meta-qti-bsp/recipes-ros/console-bridge/console-bridge_%.bbappend"
BBMASK_append = "|meta-qti-bsp/recipes-ros/pluginlib/pluginlib_1.10.%.bbappend"
```

## conf/machine/8x96autogvmquin.conf
```bitbake
#@TYPE: Machine
#@NAME: msm8996

#@DESCRIPTION: Machine configuration for msm systems

MACHINE_EXTRA_RRECOMMENDS = " kernel-modules kernel-devicetree"

require conf/machine/include/8x96autogvmquin.inc

IMAGE_FSTYPES += "tar.bz2 ext4"

PREFERRED_PROVIDER_virtual/kernel = "linux-gvm-4.4"

#
# Graphics driver essentials
#
PREFERRED_PROVIDER_virtual/wayland-egl  = "adreno"
PREFERRED_PROVIDER_virtual/egl          = "adreno"
PREFERRED_PROVIDER_virtual/libgles1     = "adreno"
PREFERRED_PROVIDER_virtual/libgles2     = "adreno"

# for dm-verity
ROOT_DEVICE = "/dev/vda"
KERNEL_ROOTDEVICE = "/dev/dm-0"


SERIAL_CONSOLE ?= "115200 ttyAMA0"

KERNEL_IMAGETYPE ?= "Image"
KERNEL_DEVICETREE ?= "qcom/vplatform-lfv-msm8996.dtb"
KERNEL_DTS_NAME = "vplatform-lfv-msm8996"
KERNEL_BASE ?= "0x80000000"
#TODO: dynamically set root device based on board version
KERNEL_CMDLINE ?= "console=ttyAMA0,115200"

KERNEL_DEFCONFIG = "msm-auto-gvm_defconfig"
KERNEL_PERF_DEFCONFIG = "msm-auto-gvm-perf_defconfig"

# Sizes for EXT4 (in bytes)
USERDATA_SIZE_EXT4 = "2000000000"
CACHE_SIZE_EXT4 = "80000000"

DISTRO_FEATURES_append = " persist-image"

BBMASK_append = "|meta-qti-display/recipes-products/images/machine-qsap-image.bbappend"
BBMASK_append = "|meta-qti-display/recipes-products/images/machine-image.bbappend"
BBMASK_append = "|meta-qti-display/recipes-products/images/machine-minimal-image.bbappend"
BBMASK_append = "|meta-qti-display/recipes/drm/libdrm_%.bbappend"
BBMASK_append = "|meta-qti-display/recipes/wayland/wayland_1.9.0.bb"
BBMASK_append = "|meta-qti-display/recipes/wayland/weston-init.bbappend"
BBMASK_append = "|meta-qti-display/recipes/wayland/weston_1.9.0.bbappend"
BBMASK_append = "|meta-qti-bsp/recipes-display/display-hal/display-hal-linux_git.bb"
BBMASK_append = "|meta-qti-bsp/recipes-display/display-hal/display-hal_git.bb"
BBMASK_append = "|meta-qti-bsp/recipes-display/sdm/sdm.bb"
BBMASK_append = "|meta-qti-bsp/recipes-graphics/wayland/weston_%.bbappend"
```

## conf/machine/8x96autogvmquintcu.conf
```bitbake
#@TYPE: Machine
#@NAME: msm8996

#@DESCRIPTION: Machine configuration for msm systems.

require conf/machine/include/auto-common.inc
#require conf/machine/include/8x96autogvmquintcu.inc

MACHINE_EXTRA_RRECOMMENDS = " kernel-modules kernel-devicetree"
IMAGE_FSTYPES += "tar.bz2 ext4"

PREFERRED_PROVIDER_virtual/kernel = "linux-gvm-4.4"



SERIAL_CONSOLE ?= "115200 ttyAMA0"

KERNEL_IMAGETYPE ?= "Image"
KERNEL_DEVICETREE ?= "qcom/vplatform-lfv-msm8996.dtb"
KERNEL_DTS_NAME = "vplatform-lfv-msm8996"
KERNEL_BASE ?= "0x80000000"
#TODO: dynamically set root device based on board version
KERNEL_CMDLINE ?= "console=ttyAMA0,115200"

KERNEL_DEFCONFIG = "msm-auto-gvm_defconfig"
KERNEL_PERF_DEFCONFIG = "msm-auto-gvm-perf_defconfig"

# Sizes for EXT4 (in bytes)
USERDATA_SIZE_EXT4 = "2000000000"
CACHE_SIZE_EXT4 = "80000000"

DISTRO_FEATURES_append = " persist-image"
```

## conf/machine/8x96autogvmred.conf
```bitbake
#@TYPE: Machine
#@NAME: msm8996

#@DESCRIPTION: Machine configuration for msm systems

MACHINE_EXTRA_RRECOMMENDS = " kernel-modules kernel-devicetree"

require conf/machine/include/arm/arch-armv8.inc

IMAGE_FSTYPES += "tar.bz2 ext4"

PREFERRED_PROVIDER_virtual/kernel = "linux-gvm"

MACHINE_SOC_NAME = "msm8996"

#
# Graphics driver essentials
#
PREFERRED_PROVIDER_virtual/wayland-egl  = "adreno"
PREFERRED_PROVIDER_virtual/egl          = "adreno"
PREFERRED_PROVIDER_virtual/libgles1     = "adreno"
PREFERRED_PROVIDER_virtual/libgles2     = "adreno"

SERIAL_CONSOLE ?= "115200 ttyAMA0"

KERNEL_IMAGETYPE ?= "Image.gz-dtb"
KERNEL_DEVICETREE ?= ""
KERNEL_BASE ?= "0x80000000"
#TODO: dynamically set root device based on board version
KERNEL_CMDLINE ?= ""

KBUILD_DEFCONFIG = "msm-auto-gvm_defconfig"
```

## conf/machine/8x96autonapier.conf
```bitbake
#@TYPE: Machine
#@NAME: msm8996

#@DESCRIPTION: Machine configuration for msm systems

require conf/machine/include/auto-common.inc

MACHINE_EXTRA_RRECOMMENDS = " kernel-modules kernel-devicetree"

PREFERRED_PROVIDER_virtual/kernel = "linux-quic"

KERNEL_IMAGETYPE ?= "Image"
KERNEL_DEVICETREE ?= "qcom/apq8096pro-auto-cdp.dtb qcom/apq8096pro-v1.1-auto-adp.dtb qcom/apq8096pro-v1.1-auto-adp-lite.dtb qcom/apq8096pro-v1.1-auto-cdp.dtb qcom/apq8096-v2-auto-dragonboard.dtb qcom/apq8096-v3-auto-adp.dtb qcom/apq8096-v3-auto-cdp.dtb qcom/apq8096-v3-auto-dragonboard.dtb qcom/msm8996pro-auto-adp.dtb qcom/msm8996pro-auto-adp-lite.dtb qcom/msm8996pro-auto-cdp.dtb qcom/msm8996pro-v1.1-auto-cdp.dtb qcom/msm8996-v3-auto-adp.dtb qcom/msm8996-v3-auto-cdp.dtb qcom/msm8996-v3-pm8004-agave-adp.dtb qcom/msm8996-v3-pm8004-agave-adp-lite.dtb qcom/msm8996-v3-pm8004-mmxf-adp.dtb"
KERNEL_DTS_NAME = "msm8996"
KERNEL_BASE = "0x80000000"
KERNEL_TAGS_OFFSET = "0x81900000"
KERNEL_CMD_PARAMS = "console=ttyHSL0,115200,n8 androidboot.console=ttyHSL0 androidboot.hardware=qcom user_debug=31 msm_rtb.filter=0x237 ehci-hcd.park=3 lpm_levels.sleep_disabled=1 cma=16M@0-0xffffffff rootwait rootfstype=ext4 root=/dev/mmcblk0p18"
RECOVERY_CMD_PARAMS ?= "console=ttyHSL0,115200,n8 androidboot.console=ttyHSL0 androidboot.hardware=qcom user_debug=31 msm_rtb.filter=0x237 ehci-hcd.park=3 lpm_levels.sleep_disabled=1 cma=16M@0-0xffffffff rootfstype=ramfs root=/dev/ram0 rdinit=/sbin/init"

BBMASK_append = "|meta-qti-bsp/recipes-connectivity/ofono/ofono_%.bbappend"
BBMASK_append = "|meta-qti-bsp/recipes-connectivity/connman/connman_1.31.bbappend"
```

## conf/machine/ar-sg1.conf
```bitbake
#@TYPE: Machine
#@NAME: AR-Gen1
#@DESCRIPTION: Machine configuration for Neo

require conf/machine/sxrneo.conf

PREFERRED_VERSION_linux-msm = "6.1"
PREFERRED_VERSION_linux-msm-headers = "6.1"
PREFERRED_VERSION_mod-signing-keys = "6.1"
PREFERRED_VERSION_kernel-toolchain-native = "6.1.32bit"
PREFERRED_VERSION_mkbootimg-gki = "6.1"
PREFERRED_VERSION_mkbootimg-gki-native = "6.1"
PREFERRED_VERSION_msm-bus = "6.1"
PREFERRED_VERSION_gki-kernel-modules = "6.1"
PREFERRED_VERSION_merge-dtbs-gki-native = "6.1"
PREFERRED_VERSION_displaydlkm = "6.1"
PREFERRED_VERSION_displaydevicetree = "6.1"
PREFERRED_VERSION_securemsmdlkm = "6.1"
PREFERRED_VERSION_mmrm-kernel = "6.1"
PREFERRED_VERSION_video-kernel = "6.1"
PREFERRED_VERSION_video-devicetree = "6.1"
PREFERRED_VERSION_audiodlkm = "6.1"
PREFERRED_VERSION_audiodevicetree= "6.1"
PREFERRED_VERSION_fastrpc-kernel = "6.1"
PREFERRED_VERSION_eva-kernel = "6.1"
PREFERRED_VERSION_qti-eva-kernel-headers = "6.1"
PREFERRED_VERSION_synx-kernel = "6.1"
PREFERRED_VERSION_wlan-platform = "6.1"
PREFERRED_VERSION_qcacld32-ar-sg1 = "6.1"
PREFERRED_VERSION_eva-devicetree = "6.1"
PREFERRED_VERSION_synx-kernel-header = "6.1"
PREFERRED_VERSION_graphicsdevicetree = "6.1"
PREFERRED_VERSION_graphicsdlkm = "6.1"
PREFERRED_VERSION_cameradlkm = "6.1"
PREFERRED_VERSION_cameradtb = "6.1"
PREFERRED_VERSION_edk2 = "6.1"

USE_CLANG = "True"

KERNEL_TYPE = "dist"

KERNEL_DTB_NAMES += " \
    neo_la.dtb \
    neo_luna-v2.dtb \
"

PREFERRED_PROVIDER_virtual/kernel = "linux-msm-src"
PREFERRED_PROVIDER_linux-msm-headers = "linux-msm-headers-src"
PREFERRED_PROVIDER_fastrpc-kernel = "fastrpc-kernel-src"

KERNEL_CMD_PARAMS  += "console=ttyMSM0,115200,n8"
MACHINE_USES_KERNEL_PREBUILTS = "False"

KERNEL_DEFCONFIG = "msm-kernel-neo_le-perf_defconfig"
KERNEL_DEFCONFIG:qti-distro-debug = "msm-kernel-neo_le-debug_defconfig"
KERNEL_PLATFORM_PATH = "${WORKSPACE}/kernel-6.1/kernel_platform"
#KERNEL_PREBUILT_PATH = "${WORKSPACE}/kernel-6.1/out/${KERNEL_DEFCONFIG}"
KERNEL_MODULES_LIST = "modules.list.msm.neo-le"
KERNEL_CONFIG     = "generic_sxr_defconfig"
KERNEL_CONFIG:qti-distro-debug = "generic_sxr_defconfig"

MACHINE_FEATURES:remove = "qti-abc-boot"
MACHINE_FEATURES += "qti-ab-boot qti-audio"
MACHINE_FEATURES += "qti-crypto qti-smmu-proxy"
```
